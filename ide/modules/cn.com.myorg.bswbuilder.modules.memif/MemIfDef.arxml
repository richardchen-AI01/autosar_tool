AUTOSAR XML (schema 00052)
package /AUTOSAR
  module definition MemIf [0..1]: variants pre-compile  # Configuration of the MemIf (Memory Abstraction Interface) module.
    container MemIfGeneral  # Configuration of the memory abstraction interface (Memif) module.
      boolean MemIfDevErrorDetect: set at pre-compile, default-value=false  # Switches the development error detection and notification on or off. | * true: detection and notification is enabled. * false: detection and notification is disabled.
      integer MemIfNumberOfDevices: 1..2, set at pre-compile  # Concrete number of underlying memory abstraction modules. | Calculation Formula: Count number of configured EA and FEE modules.
      boolean MemIfVersionInfoApi: set at pre-compile, default-value=false  # Pre-processor switch to enable / disable the API to read out the modules version information. | true: Version info API enabled. false: Version info API disabled.
      string MemIfModuleVersion: origin=VENDOR, set at pre-compile, default-value=TEST_PROBE_42_V25_10  # PROBE PARAMETER: experimental string to verify whether jar's MemIfDef.arxml drives the IDE form and whether the value reaches generated code.
