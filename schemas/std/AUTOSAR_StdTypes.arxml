AUTOSAR XML (schema 4-2-2)
standard types defined: Boolean, SInt8, SInt16, SInt32, UInt8, UInt16, UInt32, UInt64, Float32, Float64, boolean, uint8, uint16, uint32, uint64, sint8, sint16, sint32, sint64, float32, float64, Std_ReturnType, sint8_least, sint16_least, uint16_least, uint32_least, uint8_least, sint32_least
package /AUTOSAR/StdTypes
  9 x app type, all with category=VALUE:
    Appl_Boolean
    Appl_SINT8: range raw -128..127
    Appl_SINT16: range raw -32768..32767
    Appl_SINT32: range raw -2147483648..2147483647
    Appl_UINT8: range raw 0..255
    Appl_UINT16: range raw 0..65535
    Appl_UINT32: range raw 0..4294967295
    Appl_Float32: range raw -INF..INF
    Appl_Float64: range raw -INF..INF
package /AUTOSAR/StdTypes/DataConstrs
  range UInt64_Constr: raw 0..18446744073709551615
  range Boolean_Constr: phys 0..1
package /AUTOSAR/DataTypes
  13 x impl type, all with category=VALUE:
    Std_VersionInfoType
    Std_Std_TransformerError
    PduIdType
    PduInfoType
    PduLengthType
    PNCHandleType
    TPParameterType
    BufReq_ReturnType
    TpDataStateType
    RetryInfoType
    NetworkHandleType
    lcomConfigldType
    lcomSwitch_ErrorType
