AUTOSAR XML (schema 00048)
package /AUTOSAR/AuxillaryObjects
  17 x sw addr method:
    VAR_CLEARED: section-initialization-policy=CLEARED, section-type=VAR
    VAR_INIT: section-initialization-policy=INIT, section-type=VAR
    VAR_POWER_ON_CLEARED: section-initialization-policy=POWER-ON-CLEARED, section-type=VAR
    VAR_FAST_CLEARED: section-initialization-policy=CLEARED, section-type=VAR
    VAR_FAST_INIT: section-initialization-policy=INIT, section-type=VAR
    VAR_FAST_POWER_ON_CLEARED: section-initialization-policy=POWER-ON-CLEARED, section-type=VAR
    VAR_CLONE: section-initialization-policy=CLEARED, section-type=VAR
    INTERNAL_VAR_CLEARED: section-initialization-policy=CLEARED, section-type=VAR
    INTERNAL_VAR_INIT: section-initialization-policy=INIT, section-type=VAR
    INTERNAL_VAR_POWER_ON_CLEARED: section-initialization-policy=POWER-ON-CLEARED, section-type=VAR
    VAR_SAVED_ZONE: section-initialization-policy=POWER-ON-CLEARED, section-type=VAR
    CONST: section-type=CONST
    CONFIG_DATA: section-type=CONFIG-DATA
    CALIB: section-type=CALPRM
    CODE: section-type=CODE
    CODE_FAST: section-type=CODE
    CALLOUT_CODE: section-type=CODE
