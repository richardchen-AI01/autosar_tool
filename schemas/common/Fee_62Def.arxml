AUTOSAR XML (schema 00052)
package /AUTOSAR
  module definition Fee_62 [0..1]: variants pre-compile  # Configuration of the Fee_62 (Flash EEPROM Emulation) module.
    container FeeGeneral  # Container for general parameters. These parameters are not specific to a block.
      boolean FeeDevErrorDetect: set at pre-compile, default-value=true  # Switches the development error detection and notification on or off. | * true: detection and notification is enabled. * false: detection and notification is disabled.
      float FeeMainFunctionPeriod: 0..INF, scope=ECU, set at pre-compile, default-value=0.01  # The period between successive calls to the main function in seconds.
      integer FeeMinimumReadPageSize: 0..65535, set at pre-compile, default-value=0  # Minimum Page size will be a multiple of the minimum page size. Fee shall align read requests to this size.
      function name FeeNvmJobEndNotification [0..1]: multiplicity set at pre-compile, set at pre-compile, default-value=NvM_JobEndNotification  # Mapped to the job end notification routine provided by the upper layer module (NvM_JobEndNotification).
      function name FeeNvmJobErrorNotification [0..1]: multiplicity set at pre-compile, set at pre-compile, default-value=NvM_JobErrorNotification  # Mapped to the job error notification routine provided by the upper layer module (NvM_JobErrorNotification).
      boolean FeePollingMode: set at pre-compile  # Pre-processor switch to enable and disable the polling mode for this module. | true: Polling mode enabled, callback functions (provided to FLS module) disabled. false: Polling mode disabled, callback functions (provided to FLS module) enabled.
      boolean FeeSetModeSupported: set at pre-compile  # Compiler switch to enable/disable the 'SetMode' functionality of the FEE module. | TRUE: SetMode functionality supported / code present, FALSE: SetMode functionality not supported / code not present. Note: This configuration setting has to be consistent with that of all underlying flash device drivers (configuration parameter FlsSetModeApi).
      boolean FeeVersionInfoApi: set at pre-compile, default-value=false  # Pre-processor switch to enable / disable the API to read out the modules version information. | true: Version info API enabled. false: Version info API disabled.
      integer FeeVirtualPageSize: 1..65535, set at pre-compile, default-value=8  # The size in bytes to which logical blocks shall be aligned.
      integer FeeFlsErasedValue: 0..4294967295, set at pre-compile, default-value=255  # The value of the block erased by the underlying Fls module.
      string FeeUserCbkHeaderFile [0..*]: multiplicity set at pre-compile, set at pre-compile, default-value=#include "NvM_MemIf.h", max-length=32, min-length=1  # The header file of the callback function declares.
      boolean FeeCancelApi: set at pre-compile  # Whether to enable the job cancellation mechanism.
      string FeeInitErrorNotification [0..1]: scope=ECU, set at pre-compile, symbolic-name-value=true  # Fee_62 module initialization failed callback function.
      boolean FeePageDirectWriteSupport: set at pre-compile  # Whether to support direct write without erasing.
      container FeeClusterGrp [1..*]  # Group of FeeCluster.
        container FeeCluster [2..*]
          integer FeeClusterIndex: 0..65535, scope=ECU, set at pre-compile, symbolic-name-value=true  # The Cluster identifier in the Fee_62 module
          integer FeeClusterStartaddress: 0..4294967295, scope=ECU, set at pre-compile, symbolic-name-value=true, default-value=0  # The Cluster start address
          integer FeeClusterSize: 0..4294967295, scope=ECU, set at pre-compile, symbolic-name-value=true, default-value=0  # The Cluster size
          reference FeeClusterRef [0..1]: set at link in variant link-time+post-build / pre-compile in variant pre-compile, destination=FlsSector  # The FlsSector in the flash driver associated with Fee_62 Cluster
    container FeeBlockConfiguration [1..*]  # Configuration of block specific parameters for the Flash EEPROM Emulation module.
      integer FeeBlockNumber: 1..65534, scope=ECU, set at pre-compile, default-value=0  # Block identifier (handle). | 0x0000 and 0xFFFF shall not be used for block numbers (see FEE006). Range: min = 2^NVM_DATASET_SELECTION_BITS max = 0xFFFF -2^NVM_DATASET_SELECTION_BITS Note: Depending on the number of bits set aside for dataset selection several other block numbers shall also be left out to ease implementation.
      integer FeeBlockSize: 1..65535, scope=ECU, set at pre-compile  # Size of a logical block in bytes.
      boolean FeeImmediateData: scope=ECU, set at pre-compile  # Marker for high priority data. | true: Block contains immediate data. false: Block does not contain immediate data.
      integer FeeNumberOfWriteCycles: 0..4294967295, set at pre-compile, default-value=0  # Number of write cycles required for this block.
      string FeeDeviceIndex: scope=ECU, set at pre-compile, symbolic-name-value=true, default-value=NULL  # Reference to the device this block is stored in.
      reference FeeMemAccAddressArea [0..1]: multiplicity set at pre-compile, destination=MemAccAddressAreaConfiguration  # Reference to the MemAccAddressAreaConfiguration. Tags: atp.Status=draft
      reference FeeClusterGroupRef: set at pre-compile, destination=FeeClusterGrp  # Reference to the FeeClusterGrp.
    container FeePublishedInformation  # Additional published parameters not covered by CommonPublishedInformation container. | Note that these parameters do not have any configuration class setting, since they are published information.
      integer FeeBlockOverhead: 0..65535, set at published-information  # Management overhead per logical block in bytes. | Note: If the management overhead depends on the block size or block location a formula has to be provided that allows the configurator to calculate the management overhead correctly.
      integer FeeClusterOverhead: 0..65535, set at published-information  # Management overhead per Cluster in bytes. | Note: If the management overhead depends on the block size or block location a formula has to be provided that allows the configurator to calculate the management overhead correctly.
