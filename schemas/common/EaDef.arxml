AUTOSAR XML (schema 00052)
package /AUTOSAR
  module definition Ea [0..1]: variants pre-compile  # Configuration of the Ea (EEPROM Abstraction) module. | The module shall abstract from the device specific addressing scheme and segmentation and provide the upper layers with a virtual addressing scheme and segmentation as well as a 'virtually' unlimited number of erase cycles.
    container EaGeneral  # General configuration of the EEPROM abstraction module. This container lists block independent configuration parameters.
      boolean EaDevErrorDetect: set at pre-compile, default-value=true  # Switches the development error detection and notification on or off. | * true: detection and notification is enabled. * false: detection and notification is disabled.
      float EaMainFunctionPeriod: 0..INF, scope=ECU, set at pre-compile, default-value=0  # The period between successive calls to the main function in seconds.
      integer EaMinimumReadPageSize: 0..65535, set at pre-compile, default-value=0  # Minimum Page size will be a multiple of the minimum page size. Ea shall align read requests to this size. Tags: atp.Status=draft
      function name EaNvmJobEndNotification [0..1]: multiplicity set at pre-compile, set at pre-compile, default-value=NvM_JobEndNotification  # Mapped to the job end notification routine provided by the upper layer module (NvM_JobEndNotification).
      function name EaNvmJobErrorNotification [0..1]: multiplicity set at pre-compile, set at pre-compile, default-value=NvM_JobErrorNotification  # Mapped to the job error notification routine provided by the upper layer module (NvM_JobErrorNotification).
      boolean EaPollingMode: set at pre-compile  # Pre-processor switch to enable and disable the polling mode for this module. | true: Polling mode enabled, callback functions (provided to EEP module) disabled. false: Polling mode disabled, callback functions (provided to EEP module) enabled.
      boolean EaVersionInfoApi: set at pre-compile, default-value=false  # Pre-processor switch to enable / disable the API to read out the modules version information. | true: Version info API enabled. false: Version info API disabled.
      integer EaVirtualPageSize: 0..65535, set at pre-compile, default-value=0  # The size in bytes to which logical blocks shall be aligned.
      string EaHeaderFile [0..*]: multiplicity set at pre-compile, set at pre-compile, max-length=32, min-length=1  # Defines header files for callback functions which shall be included in case of CDDs. Range of characters is 1.. 32.
      reference EaBufferAlignmentValue [0..1]: set at pre-compile, requires-symbolic-name-value=true, destination=MemAccAddressAreaConfiguration  # Parameter determines the alignment of the start address that Ea buffers need to have.Value shall be inherited from MemAccBufferAlignmentValue. Tags: atp.Status=draft | Value shall be inherited from MemAccBufferAlignmentValue.
    container EaBlockConfiguration [1..*]  # Configuration of block specific parameters for the EEPROM abstraction module.
      integer EaBlockNumber: 1..65534, scope=ECU, set at pre-compile, symbolic-name-value=true, default-value=1  # Block identifier (handle). | 0x0000 and 0xFFFF shall not be used for block numbers (see SWS_Ea_00006). Range: min = 2^NVM_DATASET_SELECTION_BITS max = 0xFFFF -2^NVM_DATASET_SELECTION_BITS Note: Depending on the number of bits set aside for dataset selection several other block numbers shall also be left out to ease implementation.
      integer EaBlockSize: 1..65535, scope=ECU, set at pre-compile, default-value=1  # Size of a logical block in bytes.
      boolean EaImmediateData: scope=ECU, set at pre-compile  # Marker for high priority data. | true: Block contains immediate data. false: Block does not contain immediate data.
      integer EaNumberOfWriteCycles: 0..4294967295, set at pre-compile, default-value=0  # Number of write cycles required for this block.
      foreign reference EaDeviceIndex: set at pre-compile, requires-symbolic-name-value=true  # Reference to the device this block is stored in.
      reference EaMemAccAddressArea [0..1]: multiplicity set at pre-compile, set at pre-compile, requires-symbolic-name-value=true, destination=MemAccAddressAreaConfiguration  # Reference to the MemAccAddressAreaConfiguration. Tags: atp.Status=draft
    container EaPublishedInformation  # Additional published parameters not covered by CommonPublishedInformation container. | Note that these parameters do not have any configuration class setting, since they are published information.
      integer EaBlockOverhead: 0..65535, set at published-information, default-value=14  # Management overhead per logical block in bytes. | Note: If the management overhead depends on the block size or block location a formula has to be provided that allows the configurator to calculate the management overhead correctly.
      integer EaPageOverhead: 0..65535, set at published-information, default-value=0  # Management overhead per page in bytes. | Note: If the management overhead depends on the block size or block location a formula has to be provided that allows the configurator to calculate the management overhead correctly.
    container Ea_EepApiCfg  # Ea_EepApiCfg.
      container Ea_EepApi [1..*]  # Describes the EEP driver interface used.
        string EepReadApi: scope=ECU, set at pre-compile, symbolic-name-value=true, default-value=Eep_Read  # Reads from EEPROM.
        string EepWriteApi: scope=ECU, set at pre-compile, symbolic-name-value=true, default-value=Eep_Write  # Writes to EEPROM.
        string EepEraseApi: scope=ECU, set at pre-compile, symbolic-name-value=true, default-value=Eep_Erase  # Service for erasing EEPROM sections.
        string EepCancelApi: scope=ECU, set at pre-compile, symbolic-name-value=true, default-value=Eep_Cancel  # Cancels a running job.
        string EepGetStatusApi: scope=ECU, set at pre-compile, symbolic-name-value=true, default-value=Eep_GetStatus  # Returns the EEPROM status.
        string EepGetJobResultApi: scope=ECU, set at pre-compile, symbolic-name-value=true, default-value=Eep_GetJobResult  # This service returns the result of the last job.
        string EepSetModeApi: scope=ECU, set at pre-compile, symbolic-name-value=true, default-value=Eep_SetMode  # Sets the mode.
        foreign reference EaEepDeviceRef: set at pre-compile, requires-symbolic-name-value=true  # Reference to the device this block is stored in.
