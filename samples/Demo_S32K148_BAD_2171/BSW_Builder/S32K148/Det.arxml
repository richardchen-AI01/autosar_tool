AUTOSAR XML (schema 00048)
package /S32K148
  module config Det
    DetGeneral: DetVersionInfoApi=false
