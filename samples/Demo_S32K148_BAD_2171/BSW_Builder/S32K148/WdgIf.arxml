AUTOSAR XML (schema 00048)
package /S32K148
  module config WdgIf
    WdgIfGeneral: WdgIfDevErrorDetect=true, WdgIfVersionInfoApi=false, WdgIfNumberOfDevices=1, WdgIfIncludeHeader=Wdg_43_Instance0.h
    WdgIfInternalDevice_0 (WdgIfInternalDevice):
      WdgIfDeviceIndex = 0
      TriggerConditionFunction = Wdg_43_Instance0_SetTriggerCondition
      SetModeFunction = Wdg_43_Instance0_SetMode
      WdgIfDriverRef = WdgGeneral
