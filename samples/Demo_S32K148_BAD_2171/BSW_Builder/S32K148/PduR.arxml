AUTOSAR XML (schema 00048)
package /S32K148
  module config PduR
    PduRGeneral: PduRConfigType=PC_CONFIG, PduRDevErrorDetect=false, PduRMetaDataSupport=false, PduRVersionInfoApi=false, PduRZeroCostOperation=false
    PduRRoutingPaths: PduRConfigurationId=0, PduRMaxRoutingPathCnt=20, PduRMaxRoutingPathGroupCnt=0, PduRMaxRoutingTableCnt=1
      PDUR_ROUTING_CAN0_Rx_0x260_E2E_P01 (PduRRoutingPath): PduRRouteType=IF, PduRDestPduRRef=PduRDestPdu_CAN0_Rx_0x260_E2E_P01, PduRSrcPduRRef=PduRSrcPdu_CAN0_Rx_0x260_E2E_P01
      PduRSrcPdu_CAN0_Rx_0x260_E2E_P01 (PduRSrcPdu): PduRSourcePduHandleId=0, PduRSrcPduUpTxConf=true, PduRSrcPduRef=CANIF_CAN0_Rx_0x260_E2E_P01
      PduRDestPdu_CAN0_Rx_0x260_E2E_P01 (PduRDestPdu): PduRDestPduDataProvision=PDUR_DIRECT, PduRDestPduHandleId=0, PduRTransmissionConfirmation=true, PduRDestPduRef=COM_CAN0_Rx_0x260_E2E_P01
      PDUR_ROUTING_CAN0_Rx_0x251_Cyclic_PN29 (PduRRoutingPath): PduRRouteType=IF, PduRDestPduRRef=PduRDestPdu_CAN0_Rx_0x251_Cyclic_PN29, PduRSrcPduRRef=PduRSrcPdu_CAN0_Rx_0x251_Cyclic_PN29
      PduRSrcPdu_CAN0_Rx_0x251_Cyclic_PN29 (PduRSrcPdu): PduRSourcePduHandleId=1, PduRSrcPduUpTxConf=true, PduRSrcPduRef=CANIF_CAN0_Rx_0x251_Cyclic_PN29
      PduRDestPdu_CAN0_Rx_0x251_Cyclic_PN29 (PduRDestPdu): PduRDestPduDataProvision=PDUR_DIRECT, PduRDestPduHandleId=1, PduRTransmissionConfirmation=true, PduRDestPduRef=COM_CAN0_Rx_0x251_Cyclic_PN29
      PDUR_ROUTING_CAN0_Rx_0x250_Cyclic_PN17 (PduRRoutingPath): PduRRouteType=IF, PduRDestPduRRef=PduRDestPdu_CAN0_Rx_0x250_Cyclic_PN17, PduRSrcPduRRef=PduRSrcPdu_CAN0_Rx_0x250_Cyclic_PN17
      PduRSrcPdu_CAN0_Rx_0x250_Cyclic_PN17 (PduRSrcPdu): PduRSourcePduHandleId=2, PduRSrcPduUpTxConf=true, PduRSrcPduRef=CANIF_CAN0_Rx_0x250_Cyclic_PN17
      PduRDestPdu_CAN0_Rx_0x250_Cyclic_PN17 (PduRDestPdu): PduRDestPduDataProvision=PDUR_DIRECT, PduRDestPduHandleId=2, PduRTransmissionConfirmation=true, PduRDestPduRef=COM_CAN0_Rx_0x250_Cyclic_PN17
      PDUR_ROUTING_CAN0_Rx_0x200_Cyclic (PduRRoutingPath): PduRRouteType=IF, PduRDestPduRRef=PduRDestPdu_CAN0_Rx_0x200_Cyclic, PduRSrcPduRRef=PduRSrcPdu_CAN0_Rx_0x200_Cyclic
      PduRSrcPdu_CAN0_Rx_0x200_Cyclic (PduRSrcPdu): PduRSourcePduHandleId=3, PduRSrcPduUpTxConf=true, PduRSrcPduRef=CANIF_CAN0_Rx_0x200_Cyclic
      PduRDestPdu_CAN0_Rx_0x200_Cyclic (PduRDestPdu): PduRDestPduDataProvision=PDUR_DIRECT, PduRDestPduHandleId=3, PduRTransmissionConfirmation=true, PduRDestPduRef=COM_CAN0_Rx_0x200_Cyclic
      PDUR_ROUTING_CAN0_Rx_0x201_Event (PduRRoutingPath): PduRRouteType=IF, PduRDestPduRRef=PduRDestPdu_CAN0_Rx_0x201_Event, PduRSrcPduRRef=PduRSrcPdu_CAN0_Rx_0x201_Event
      PduRSrcPdu_CAN0_Rx_0x201_Event (PduRSrcPdu): PduRSourcePduHandleId=4, PduRSrcPduUpTxConf=true, PduRSrcPduRef=CANIF_CAN0_Rx_0x201_Event
      PduRDestPdu_CAN0_Rx_0x201_Event (PduRDestPdu): PduRDestPduDataProvision=PDUR_DIRECT, PduRDestPduHandleId=4, PduRTransmissionConfirmation=true, PduRDestPduRef=COM_CAN0_Rx_0x201_Event
      PDUR_ROUTING_CAN0_Rx_0x202_Mixed (PduRRoutingPath): PduRRouteType=IF, PduRDestPduRRef=PduRDestPdu_CAN0_Rx_0x202_Mixed, PduRSrcPduRRef=PduRSrcPdu_CAN0_Rx_0x202_Mixed
      PduRSrcPdu_CAN0_Rx_0x202_Mixed (PduRSrcPdu): PduRSourcePduHandleId=5, PduRSrcPduUpTxConf=true, PduRSrcPduRef=CANIF_CAN0_Rx_0x202_Mixed
      PduRDestPdu_CAN0_Rx_0x202_Mixed (PduRDestPdu): PduRDestPduDataProvision=PDUR_DIRECT, PduRDestPduHandleId=5, PduRTransmissionConfirmation=true, PduRDestPduRef=COM_CAN0_Rx_0x202_Mixed
      PDUR_ROUTING_CAN0_Rx_0x203_Cyclic_Counter (PduRRoutingPath): PduRRouteType=IF, PduRDestPduRRef=PduRDestPdu_CAN0_Rx_0x203_Cyclic_Counter, PduRSrcPduRRef=PduRSrcPdu_CAN0_Rx_0x203_Cyclic_Counter
      PduRSrcPdu_CAN0_Rx_0x203_Cyclic_Counter (PduRSrcPdu): PduRSourcePduHandleId=6, PduRSrcPduUpTxConf=true, PduRSrcPduRef=CANIF_CAN0_Rx_0x203_Cyclic_Counter
      PduRDestPdu_CAN0_Rx_0x203_Cyclic_Counter (PduRDestPdu): PduRDestPduDataProvision=PDUR_DIRECT, PduRDestPduHandleId=6, PduRTransmissionConfirmation=true, PduRDestPduRef=COM_CAN0_Rx_0x203_Cyclic_Counter
      PDUR_ROUTING_CAN0_Tx_0x360_E2E_P01 (PduRRoutingPath): PduRRouteType=IF, PduRDestPduRRef=PduRDestPdu_CAN0_Tx_0x360_E2E_P01, PduRSrcPduRRef=PduRSrcPdu_CAN0_Tx_0x360_E2E_P01
      PduRSrcPdu_CAN0_Tx_0x360_E2E_P01 (PduRSrcPdu): PduRSourcePduHandleId=7, PduRSrcPduUpTxConf=true, PduRSrcPduRef=COM_CAN0_Tx_0x360_E2E_P01
      PduRDestPdu_CAN0_Tx_0x360_E2E_P01 (PduRDestPdu): PduRDestPduDataProvision=PDUR_DIRECT, PduRDestPduHandleId=7, PduRTransmissionConfirmation=true, PduRDestPduRef=CANIF_CAN0_Tx_0x360_E2E_P01
      PDUR_ROUTING_CAN0_Tx_0x351_Cyclic_PN29 (PduRRoutingPath): PduRRouteType=IF, PduRDestPduRRef=PduRDestPdu_CAN0_Tx_0x351_Cyclic_PN29, PduRSrcPduRRef=PduRSrcPdu_CAN0_Tx_0x351_Cyclic_PN29
      PduRSrcPdu_CAN0_Tx_0x351_Cyclic_PN29 (PduRSrcPdu): PduRSourcePduHandleId=8, PduRSrcPduUpTxConf=true, PduRSrcPduRef=COM_CAN0_Tx_0x351_Cyclic_PN29
      PduRDestPdu_CAN0_Tx_0x351_Cyclic_PN29 (PduRDestPdu): PduRDestPduDataProvision=PDUR_DIRECT, PduRDestPduHandleId=8, PduRTransmissionConfirmation=true, PduRDestPduRef=CANIF_CAN0_Tx_0x351_Cyclic_PN29
      PDUR_ROUTING_CAN0_Tx_0x350_Cyclic_PN17 (PduRRoutingPath): PduRRouteType=IF, PduRDestPduRRef=PduRDestPdu_CAN0_Tx_0x350_Cyclic_PN17, PduRSrcPduRRef=PduRSrcPdu_CAN0_Tx_0x350_Cyclic_PN17
      PduRSrcPdu_CAN0_Tx_0x350_Cyclic_PN17 (PduRSrcPdu): PduRSourcePduHandleId=9, PduRSrcPduUpTxConf=true, PduRSrcPduRef=COM_CAN0_Tx_0x350_Cyclic_PN17
      PduRDestPdu_CAN0_Tx_0x350_Cyclic_PN17 (PduRDestPdu): PduRDestPduDataProvision=PDUR_DIRECT, PduRDestPduHandleId=9, PduRTransmissionConfirmation=true, PduRDestPduRef=CANIF_CAN0_Tx_0x350_Cyclic_PN17
      PDUR_ROUTING_CAN0_Tx_0x300_Cyclic (PduRRoutingPath): PduRRouteType=IF, PduRDestPduRRef=PduRDestPdu_CAN0_Tx_0x300_Cyclic, PduRSrcPduRRef=PduRSrcPdu_CAN0_Tx_0x300_Cyclic
      PduRSrcPdu_CAN0_Tx_0x300_Cyclic (PduRSrcPdu): PduRSourcePduHandleId=10, PduRSrcPduUpTxConf=true, PduRSrcPduRef=COM_CAN0_Tx_0x300_Cyclic
      PduRDestPdu_CAN0_Tx_0x300_Cyclic (PduRDestPdu): PduRDestPduDataProvision=PDUR_DIRECT, PduRDestPduHandleId=10, PduRTransmissionConfirmation=true, PduRDestPduRef=CANIF_CAN0_Tx_0x300_Cyclic
      PDUR_ROUTING_CAN0_Tx_0x301_Event (PduRRoutingPath): PduRRouteType=IF, PduRDestPduRRef=PduRDestPdu_CAN0_Tx_0x301_Event, PduRSrcPduRRef=PduRSrcPdu_CAN0_Tx_0x301_Event
      PduRSrcPdu_CAN0_Tx_0x301_Event (PduRSrcPdu): PduRSourcePduHandleId=11, PduRSrcPduUpTxConf=true, PduRSrcPduRef=COM_CAN0_Tx_0x301_Event
      PduRDestPdu_CAN0_Tx_0x301_Event (PduRDestPdu): PduRDestPduDataProvision=PDUR_DIRECT, PduRDestPduHandleId=11, PduRTransmissionConfirmation=true, PduRDestPduRef=CANIF_CAN0_Tx_0x301_Event
      PDUR_ROUTING_CAN0_Tx_0x302_Mixed (PduRRoutingPath): PduRRouteType=IF, PduRDestPduRRef=PduRDestPdu_CAN0_Tx_0x302_Mixed, PduRSrcPduRRef=PduRSrcPdu_CAN0_Tx_0x302_Mixed
      PduRSrcPdu_CAN0_Tx_0x302_Mixed (PduRSrcPdu): PduRSourcePduHandleId=12, PduRSrcPduUpTxConf=true, PduRSrcPduRef=COM_CAN0_Tx_0x302_Mixed
      PduRDestPdu_CAN0_Tx_0x302_Mixed (PduRDestPdu): PduRDestPduDataProvision=PDUR_DIRECT, PduRDestPduHandleId=12, PduRTransmissionConfirmation=true, PduRDestPduRef=CANIF_CAN0_Tx_0x302_Mixed
      PDUR_ROUTING_CAN0_Tx_0x303_Cyclic_Counter (PduRRoutingPath): PduRRouteType=IF, PduRDestPduRRef=PduRDestPdu_CAN0_Tx_0x303_Cyclic_Counter, PduRSrcPduRRef=PduRSrcPdu_CAN0_Tx_0x303_Cyclic_Counter
      PduRSrcPdu_CAN0_Tx_0x303_Cyclic_Counter (PduRSrcPdu): PduRSourcePduHandleId=13, PduRSrcPduUpTxConf=true, PduRSrcPduRef=COM_CAN0_Tx_0x303_Cyclic_Counter
      PduRDestPdu_CAN0_Tx_0x303_Cyclic_Counter (PduRDestPdu): PduRDestPduDataProvision=PDUR_DIRECT, PduRDestPduHandleId=13, PduRTransmissionConfirmation=true, PduRDestPduRef=CANIF_CAN0_Tx_0x303_Cyclic_Counter
      PduRRoutingPath_CAN_Func_Rx (PduRRoutingPath): PduRRouteType=TP, PduRDestPduRRef=PduRDestPdu_CAN_Func_Rx, PduRSrcPduRRef=PduRSrcPdu_CAN_Func_Rx
      PduRDestPdu_CAN_Func_Rx (PduRDestPdu): PduRDestPduDataProvision=PDUR_DIRECT, PduRDestPduHandleId=14, PduRTransmissionConfirmation=true, PduRDestPduRef=CAN_Dcm_Func_Rx
      PduRSrcPdu_CAN_Func_Rx (PduRSrcPdu): PduRSourcePduHandleId=14, PduRSrcPduUpTxConf=true, PduRSrcPduRef=CAN_CanTp_Func_Rx
      PduRRoutingPath_CAN_Phys_Rx (PduRRoutingPath): PduRRouteType=TP, PduRDestPduRRef=PduRDestPdu_CAN_Phys_Rx, PduRSrcPduRRef=PduRSrcPdu_CAN_Phys_Rx
      PduRDestPdu_CAN_Phys_Rx (PduRDestPdu): PduRDestPduDataProvision=PDUR_DIRECT, PduRDestPduHandleId=15, PduRTransmissionConfirmation=true, PduRDestPduRef=CAN_Dcm_Phys_Rx
      PduRSrcPdu_CAN_Phys_Rx (PduRSrcPdu): PduRSourcePduHandleId=15, PduRSrcPduUpTxConf=true, PduRSrcPduRef=CAN_CanTp_Phys_Rx
      PduRRoutingPath_CAN_USDT_Tx (PduRRoutingPath): PduRRouteType=TP, PduRDestPduRRef=PduRDestPdu_CAN_USDT_Tx, PduRSrcPduRRef=PduRSrcPdu_CAN_USDT_Tx
      PduRDestPdu_CAN_USDT_Tx (PduRDestPdu): PduRDestPduDataProvision=PDUR_DIRECT, PduRDestPduHandleId=16, PduRTransmissionConfirmation=true, PduRDestPduRef=CAN_CanTp_USDT_Tx
      PduRSrcPdu_CAN_USDT_Tx (PduRSrcPdu): PduRSourcePduHandleId=16, PduRSrcPduUpTxConf=true, PduRSrcPduRef=CAN_Dcm_USDT_Tx
    4 x PduRBswModules, all with PduRRetransmission=false:
      PduRBswModules_COM: PduRCancelReceive=true, PduRCancelTransmit=true, PduRCommunicationInterface=true, PduRCopyRxData=true, PduRCopyTxData=true, PduRLowerModule=false, PduRRxIndication=true, PduRStartOfReception=true, PduRTpRxIndication=true, PduRTpTransmit=false, PduRTpTxConfirmation=true, PduRTransmit=true, PduRTransportProtocol=true, PduRTriggertransmit=true, PduRTxConfirmation=true, PduRUpperModule=true, PduRBswModuleRef=Com
      PduRBswModules_CANIF: PduRCommunicationInterface=true, PduRCopyRxData=false, PduRCopyTxData=false, PduRLowerModule=true, PduRRxIndication=true, PduRStartOfReception=false, PduRTpRxIndication=false, PduRTpTransmit=false, PduRTpTxConfirmation=false, PduRTransmit=true, PduRTransportProtocol=false, PduRTriggertransmit=true, PduRTxConfirmation=true, PduRUpperModule=false, PduRCancelReceive=false, PduRCancelTransmit=false, PduRBswModuleRef=CanIf
      PduRBswModules_CANTP: PduRCommunicationInterface=false, PduRCopyRxData=true, PduRCopyTxData=true, PduRLowerModule=true, PduRRxIndication=false, PduRStartOfReception=true, PduRTpRxIndication=true, PduRTpTransmit=true, PduRTpTxConfirmation=true, PduRTransmit=false, PduRTransportProtocol=true, PduRTriggertransmit=false, PduRTxConfirmation=false, PduRUpperModule=false, PduRCancelReceive=false, PduRCancelTransmit=false, PduRBswModuleRef=CanTp
      PduRBswModules_DCM: PduRCancelReceive=true, PduRCancelTransmit=true, PduRCommunicationInterface=true, PduRCopyRxData=true, PduRCopyTxData=true, PduRLowerModule=false, PduRRxIndication=false, PduRStartOfReception=true, PduRTpRxIndication=true, PduRTpTransmit=false, PduRTpTxConfirmation=true, PduRTransmit=true, PduRTransportProtocol=true, PduRTriggertransmit=false, PduRTxConfirmation=true, PduRUpperModule=true, PduRBswModuleRef=Dcm
