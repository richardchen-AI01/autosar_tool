AUTOSAR XML (schema 00048)
package /S32K148
  module config NvM
    NvMBlock_ConfigID (NvMBlockDescriptor):
      NvMBlockJobPriority = 1
      NvMBlockManagementType = NVM_BLOCK_REDUNDANT
      NvMBlockUseAutoValidation = false
      NvMBlockUseCompression = false
      NvMBlockUseCrc = true
      NvMBlockUseCRCCompMechanism = false
      NvMBlockUsePort = false
      NvMBlockUseSetRamBlockStatus = false
      NvMBlockUseSyncMechanism = false
      NvMBlockWriteProt = false
      NvMBswMBlockStatusInformation = false
      NvMCalcRamBlockCrc = true
      NvMMaxNumOfReadRetries = 3
      NvMMaxNumOfWriteRetries = 3
      NvMNvBlockBaseNumber = 1
      NvMNvBlockLength = 2
      NvMNvBlockNum = 2
      NvMNvramBlockIdentifier = NvMConf_NvMBlockDescriptor_NvMBlock_ConfigID
      NvMNvramDeviceId = 0
      NvMResistantToChangedSw = true
      NvMRomBlockNum = 0
      NvMSelectBlockForFirstInitAll = false
      NvMSelectBlockForReadAll = true
      NvMSelectBlockForWriteAll = true
      NvMStaticBlockIDCheck = false
      NvMWriteBlockOnce = false
      NvMWriteVerification = false
      NvMWriteVerificationDataSize = 1
      NvMRamBlockDataBufferAutoFill = true
      NvMBlockCrcType = NVM_CRC16
      NvMRamBlockDataAddress = NvMBlockRamBuffer1
      NvMTargetBlockReference
        NvMFeeRef (NvMNullRef): NvMNameOfFeeBlock=FeeBlockConfiguration_0
    NvMCommon:
      NvMApiConfigClass = NVM_API_CONFIG_CLASS_3
      NvMBswMMultiBlockJobStatusInformation = false
      NvMCompiledConfigId = 43707
      NvMCrcNumOfBytes = 128
      NvMDatasetSelectionBits = 8
      NvMDevErrorDetect = true
      NvMDynamicConfiguration = false
      NvMJobPrioritization = false
      NvMMainFunctionPeriod = 0.005
      NvMPollingMode = true
      NvMRepeatMirrorOperations = 5
      NvMSetRamBlockStatusApi = true
      NvMSizeStandardJobQueue = 25
      NvMVersionInfoApi = false
    23 x NvMBlockDescriptor, all with NvMBlockJobPriority=1, NvMBlockManagementType=NVM_BLOCK_NATIVE, NvMBlockUseCompression=false, NvMBlockUseCrc=true, NvMBlockUsePort=false, NvMBlockUseSyncMechanism=false, NvMBlockWriteProt=false, NvMBswMBlockStatusInformation=false, NvMMaxNumOfReadRetries=3, NvMMaxNumOfWriteRetries=3, NvMNvBlockNum=1, NvMNvramDeviceId=0, NvMResistantToChangedSw=true, NvMSelectBlockForFirstInitAll=false, NvMSelectBlockForReadAll=true, NvMStaticBlockIDCheck=false, NvMWriteBlockOnce=false, NvMWriteVerification=false, NvMWriteVerificationDataSize=1, NvMBlockCrcType=NVM_CRC16:
      NvMBlock_SecurityLevel01: NvMBlockUseAutoValidation=false, NvMBlockUseCRCCompMechanism=true, NvMBlockUseSetRamBlockStatus=false, NvMCalcRamBlockCrc=true, NvMNvBlockBaseNumber=5, NvMNvBlockLength=1, NvMNvramBlockIdentifier=NvMConf_NvMBlockDescriptor_NvMBlock_SecurityLevel01, NvMRamBlockDataAddress=NvMBlockRamBuffer2, NvMRomBlockNum=0, NvMSelectBlockForWriteAll=true, NvMRamBlockDataBufferAutoFill=true
        NvMTargetBlockReference
          NvMFeeRef (NvMNullRef): NvMNameOfFeeBlock=FeeBlockConfiguration_SecurityLevel01
      NvMBlock_SecurityLevel02: NvMBlockUseAutoValidation=false, NvMBlockUseCRCCompMechanism=true, NvMBlockUseSetRamBlockStatus=false, NvMCalcRamBlockCrc=true, NvMNvBlockBaseNumber=6, NvMNvBlockLength=1, NvMNvramBlockIdentifier=NvMConf_NvMBlockDescriptor_NvMBlock_SecurityLevel02, NvMRamBlockDataAddress=NvMBlockRamBuffer3, NvMRomBlockNum=0, NvMSelectBlockForWriteAll=true, NvMRamBlockDataBufferAutoFill=true
        NvMTargetBlockReference
          NvMFeeRef (NvMNullRef): NvMNameOfFeeBlock=FeeBlockConfiguration_SecurityLevel02
      NvMBlock_DIDF190: NvMBlockUseAutoValidation=false, NvMBlockUseCRCCompMechanism=true, NvMBlockUseSetRamBlockStatus=false, NvMCalcRamBlockCrc=true, NvMNvBlockBaseNumber=7, NvMNvBlockLength=17, NvMNvramBlockIdentifier=NvMConf_NvMBlockDescriptor_NvMBlock_DIDF190, NvMRamBlockDataAddress=NvMBlockRamBuffer4, NvMRomBlockNum=1, NvMSelectBlockForWriteAll=false, NvMRamBlockDataBufferAutoFill=true, NvMRomBlockDataAddress=NvMBlock_DIDF190_RomAddress, NvMBlockHeaderInclude=Rte_NvMApp.h
        NvMTargetBlockReference
          NvMFeeRef (NvMNullRef): NvMNameOfFeeBlock=FeeBlockConfiguration_DIDF190
      NvMBlock_DIDF183: NvMBlockUseAutoValidation=false, NvMBlockUseCRCCompMechanism=true, NvMBlockUseSetRamBlockStatus=false, NvMCalcRamBlockCrc=true, NvMNvBlockBaseNumber=8, NvMNvBlockLength=4, NvMNvramBlockIdentifier=NvMConf_NvMBlockDescriptor_NvMBlock_DIDF183, NvMRamBlockDataAddress=NvMBlockRamBuffer5, NvMRomBlockNum=1, NvMSelectBlockForWriteAll=false, NvMRamBlockDataBufferAutoFill=true, NvMRomBlockDataAddress=NvMBlock_DIDF183_RomAddress
        NvMTargetBlockReference
          NvMFeeRef (NvMNullRef): NvMNameOfFeeBlock=FeeBlockConfiguration_DIDF183
      NvMBlock_Primary_0: NvMBlockUseAutoValidation=true, NvMBlockUseCRCCompMechanism=false, NvMBlockUseSetRamBlockStatus=true, NvMCalcRamBlockCrc=false, NvMNvBlockBaseNumber=9, NvMNvBlockLength=28, NvMNvramBlockIdentifier=NvMConf_NvMBlockDescriptor_NvMBlock_Primary_0, NvMRomBlockNum=0, NvMSelectBlockForWriteAll=true, NvMRamBlockDataBufferAutoFill=false, NvMBlockHeaderInclude=Dem_Cbk.h, NvMRamBlockDataAddress=&Dem_GetMemoryEntry()[0]
        NvMTargetBlockReference
          NvMFeeRef (NvMNullRef): NvMNameOfFeeBlock=Fee_EventEntryPrimary_0
        NvMSingleBlockCallback: NvMSingleBlockCallbackFnc=Dem_NvMJobFinished
      NvMBlock_Primary_1: NvMBlockUseAutoValidation=true, NvMBlockUseCRCCompMechanism=false, NvMBlockUseSetRamBlockStatus=true, NvMCalcRamBlockCrc=false, NvMNvBlockBaseNumber=10, NvMNvBlockLength=28, NvMNvramBlockIdentifier=NvMConf_NvMBlockDescriptor_NvMBlock_Primary_1, NvMRomBlockNum=0, NvMSelectBlockForWriteAll=true, NvMRamBlockDataBufferAutoFill=false, NvMBlockHeaderInclude=Dem_Cbk.h, NvMRamBlockDataAddress=&Dem_GetMemoryEntry()[1]
        NvMTargetBlockReference
          NvMFeeRef (NvMNullRef): NvMNameOfFeeBlock=Fee_EventEntryPrimary_1
        NvMSingleBlockCallback: NvMSingleBlockCallbackFnc=Dem_NvMJobFinished
      NvMBlock_Primary_2: NvMBlockUseAutoValidation=true, NvMBlockUseCRCCompMechanism=false, NvMBlockUseSetRamBlockStatus=true, NvMCalcRamBlockCrc=false, NvMNvBlockBaseNumber=11, NvMNvBlockLength=28, NvMNvramBlockIdentifier=NvMConf_NvMBlockDescriptor_NvMBlock_Primary_2, NvMRomBlockNum=0, NvMSelectBlockForWriteAll=true, NvMRamBlockDataBufferAutoFill=false, NvMBlockHeaderInclude=Dem_Cbk.h, NvMRamBlockDataAddress=&Dem_GetMemoryEntry()[2]
        NvMTargetBlockReference
          NvMFeeRef (NvMNullRef): NvMNameOfFeeBlock=Fee_EventEntryPrimary_2
        NvMSingleBlockCallback: NvMSingleBlockCallbackFnc=Dem_NvMJobFinished
      NvMBlock_Primary_3: NvMBlockUseAutoValidation=true, NvMBlockUseCRCCompMechanism=false, NvMBlockUseSetRamBlockStatus=true, NvMCalcRamBlockCrc=false, NvMNvBlockBaseNumber=12, NvMNvBlockLength=28, NvMNvramBlockIdentifier=NvMConf_NvMBlockDescriptor_NvMBlock_Primary_3, NvMRomBlockNum=0, NvMSelectBlockForWriteAll=true, NvMRamBlockDataBufferAutoFill=false, NvMBlockHeaderInclude=Dem_Cbk.h, NvMRamBlockDataAddress=&Dem_GetMemoryEntry()[3]
        NvMTargetBlockReference
          NvMFeeRef (NvMNullRef): NvMNameOfFeeBlock=Fee_EventEntryPrimary_3
        NvMSingleBlockCallback: NvMSingleBlockCallbackFnc=Dem_NvMJobFinished
      NvMBlock_Primary_4: NvMBlockUseAutoValidation=true, NvMBlockUseCRCCompMechanism=false, NvMBlockUseSetRamBlockStatus=true, NvMCalcRamBlockCrc=false, NvMNvBlockBaseNumber=13, NvMNvBlockLength=28, NvMNvramBlockIdentifier=NvMConf_NvMBlockDescriptor_NvMBlock_Primary_4, NvMRomBlockNum=0, NvMSelectBlockForWriteAll=true, NvMRamBlockDataBufferAutoFill=false, NvMBlockHeaderInclude=Dem_Cbk.h, NvMRamBlockDataAddress=&Dem_GetMemoryEntry()[4], NvMWriteRamBlockToNvCallback=false
        NvMTargetBlockReference
          NvMFeeRef (NvMNullRef): NvMNameOfFeeBlock=Fee_EventEntryPrimary_4
        NvMSingleBlockCallback: NvMSingleBlockCallbackFnc=Dem_NvMJobFinished
      NvMBlock_Primary_5: NvMBlockUseAutoValidation=true, NvMBlockUseCRCCompMechanism=false, NvMBlockUseSetRamBlockStatus=true, NvMCalcRamBlockCrc=false, NvMNvBlockBaseNumber=14, NvMNvBlockLength=28, NvMNvramBlockIdentifier=NvMConf_NvMBlockDescriptor_NvMBlock_Primary_5, NvMRomBlockNum=0, NvMSelectBlockForWriteAll=true, NvMRamBlockDataBufferAutoFill=false, NvMBlockHeaderInclude=Dem_Cbk.h, NvMRamBlockDataAddress=&Dem_GetMemoryEntry()[5], NvMWriteRamBlockToNvCallback=false
        NvMTargetBlockReference
          NvMFeeRef (NvMNullRef): NvMNameOfFeeBlock=Fee_EventEntryPrimary_5
        NvMSingleBlockCallback: NvMSingleBlockCallbackFnc=Dem_NvMJobFinished
      NvMBlock_Primary_6: NvMBlockUseAutoValidation=true, NvMBlockUseCRCCompMechanism=false, NvMBlockUseSetRamBlockStatus=true, NvMCalcRamBlockCrc=false, NvMNvBlockBaseNumber=15, NvMNvBlockLength=28, NvMNvramBlockIdentifier=NvMConf_NvMBlockDescriptor_NvMBlock_Primary_6, NvMRomBlockNum=0, NvMSelectBlockForWriteAll=true, NvMRamBlockDataBufferAutoFill=false, NvMBlockHeaderInclude=Dem_Cbk.h, NvMRamBlockDataAddress=&Dem_GetMemoryEntry()[6], NvMWriteRamBlockToNvCallback=false
        NvMTargetBlockReference
          NvMFeeRef (NvMNullRef): NvMNameOfFeeBlock=Fee_EventEntryPrimary_6
        NvMSingleBlockCallback: NvMSingleBlockCallbackFnc=Dem_NvMJobFinished
      NvMBlock_Primary_7: NvMBlockUseAutoValidation=true, NvMBlockUseCRCCompMechanism=false, NvMBlockUseSetRamBlockStatus=true, NvMCalcRamBlockCrc=false, NvMNvBlockBaseNumber=16, NvMNvBlockLength=28, NvMNvramBlockIdentifier=NvMConf_NvMBlockDescriptor_NvMBlock_Primary_7, NvMRomBlockNum=0, NvMSelectBlockForWriteAll=true, NvMRamBlockDataBufferAutoFill=false, NvMBlockHeaderInclude=Dem_Cbk.h, NvMRamBlockDataAddress=&Dem_GetMemoryEntry()[7], NvMWriteRamBlockToNvCallback=false
        NvMTargetBlockReference
          NvMFeeRef (NvMNullRef): NvMNameOfFeeBlock=Fee_EventEntryPrimary_7
        NvMSingleBlockCallback: NvMSingleBlockCallbackFnc=Dem_NvMJobFinished
      NvMBlock_Primary_8: NvMBlockUseAutoValidation=true, NvMBlockUseCRCCompMechanism=false, NvMBlockUseSetRamBlockStatus=true, NvMCalcRamBlockCrc=false, NvMNvBlockBaseNumber=17, NvMNvBlockLength=28, NvMNvramBlockIdentifier=NvMConf_NvMBlockDescriptor_NvMBlock_Primary_8, NvMRomBlockNum=0, NvMSelectBlockForWriteAll=true, NvMRamBlockDataBufferAutoFill=false, NvMBlockHeaderInclude=Dem_Cbk.h, NvMRamBlockDataAddress=&Dem_GetMemoryEntry()[8], NvMWriteRamBlockToNvCallback=false
        NvMTargetBlockReference
          NvMFeeRef (NvMNullRef): NvMNameOfFeeBlock=Fee_EventEntryPrimary_8
        NvMSingleBlockCallback: NvMSingleBlockCallbackFnc=Dem_NvMJobFinished
      NvMBlock_Primary_9: NvMBlockUseAutoValidation=true, NvMBlockUseCRCCompMechanism=false, NvMBlockUseSetRamBlockStatus=true, NvMCalcRamBlockCrc=false, NvMNvBlockBaseNumber=18, NvMNvBlockLength=28, NvMNvramBlockIdentifier=NvMConf_NvMBlockDescriptor_NvMBlock_Primary_9, NvMRomBlockNum=0, NvMSelectBlockForWriteAll=true, NvMRamBlockDataBufferAutoFill=false, NvMBlockHeaderInclude=Dem_Cbk.h, NvMRamBlockDataAddress=&Dem_GetMemoryEntry()[9], NvMWriteRamBlockToNvCallback=false
        NvMTargetBlockReference
          NvMFeeRef (NvMNullRef): NvMNameOfFeeBlock=Fee_EventEntryPrimary_9
        NvMSingleBlockCallback: NvMSingleBlockCallbackFnc=Dem_NvMJobFinished
      NvMBlock_Primary_10: NvMBlockUseAutoValidation=true, NvMBlockUseCRCCompMechanism=false, NvMBlockUseSetRamBlockStatus=true, NvMCalcRamBlockCrc=false, NvMNvBlockBaseNumber=19, NvMNvBlockLength=28, NvMNvramBlockIdentifier=NvMConf_NvMBlockDescriptor_NvMBlock_Primary_10, NvMRomBlockNum=0, NvMSelectBlockForWriteAll=true, NvMRamBlockDataBufferAutoFill=false, NvMBlockHeaderInclude=Dem_Cbk.h, NvMRamBlockDataAddress=&Dem_GetMemoryEntry()[10], NvMWriteRamBlockToNvCallback=false
        NvMTargetBlockReference
          NvMFeeRef (NvMNullRef): NvMNameOfFeeBlock=Fee_EventEntryPrimary_10
        NvMSingleBlockCallback: NvMSingleBlockCallbackFnc=Dem_NvMJobFinished
      NvMBlock_Primary_11: NvMBlockUseAutoValidation=true, NvMBlockUseCRCCompMechanism=false, NvMBlockUseSetRamBlockStatus=true, NvMCalcRamBlockCrc=false, NvMNvBlockBaseNumber=20, NvMNvBlockLength=28, NvMNvramBlockIdentifier=NvMConf_NvMBlockDescriptor_NvMBlock_Primary_11, NvMRomBlockNum=0, NvMSelectBlockForWriteAll=true, NvMRamBlockDataBufferAutoFill=false, NvMBlockHeaderInclude=Dem_Cbk.h, NvMRamBlockDataAddress=&Dem_GetMemoryEntry()[11]
        NvMTargetBlockReference
          NvMFeeRef (NvMNullRef): NvMNameOfFeeBlock=Fee_EventEntryPrimary_11
        NvMSingleBlockCallback: NvMSingleBlockCallbackFnc=Dem_NvMJobFinished
      NvMBlock_Primary_12: NvMBlockUseAutoValidation=true, NvMBlockUseCRCCompMechanism=false, NvMBlockUseSetRamBlockStatus=true, NvMCalcRamBlockCrc=false, NvMNvBlockBaseNumber=21, NvMNvBlockLength=28, NvMNvramBlockIdentifier=NvMConf_NvMBlockDescriptor_NvMBlock_Primary_12, NvMRomBlockNum=0, NvMSelectBlockForWriteAll=true, NvMRamBlockDataBufferAutoFill=false, NvMBlockHeaderInclude=Dem_Cbk.h, NvMRamBlockDataAddress=&Dem_GetMemoryEntry()[12], NvMWriteRamBlockToNvCallback=false
        NvMTargetBlockReference
          NvMFeeRef (NvMNullRef): NvMNameOfFeeBlock=Fee_EventEntryPrimary_12
        NvMSingleBlockCallback: NvMSingleBlockCallbackFnc=Dem_NvMJobFinished
      NvMBlock_Primary_13: NvMBlockUseAutoValidation=true, NvMBlockUseCRCCompMechanism=false, NvMBlockUseSetRamBlockStatus=true, NvMCalcRamBlockCrc=false, NvMNvBlockBaseNumber=22, NvMNvBlockLength=28, NvMNvramBlockIdentifier=NvMConf_NvMBlockDescriptor_NvMBlock_Primary_13, NvMRomBlockNum=0, NvMSelectBlockForWriteAll=true, NvMRamBlockDataBufferAutoFill=false, NvMBlockHeaderInclude=Dem_Cbk.h, NvMRamBlockDataAddress=&Dem_GetMemoryEntry()[13], NvMWriteRamBlockToNvCallback=false
        NvMTargetBlockReference
          NvMFeeRef (NvMNullRef): NvMNameOfFeeBlock=Fee_EventEntryPrimary_13
        NvMSingleBlockCallback: NvMSingleBlockCallbackFnc=Dem_NvMJobFinished
      NvMBlock_Primary_14: NvMBlockUseAutoValidation=true, NvMBlockUseCRCCompMechanism=false, NvMBlockUseSetRamBlockStatus=true, NvMCalcRamBlockCrc=false, NvMNvBlockBaseNumber=23, NvMNvBlockLength=28, NvMNvramBlockIdentifier=NvMConf_NvMBlockDescriptor_NvMBlock_Primary_14, NvMRomBlockNum=0, NvMSelectBlockForWriteAll=true, NvMRamBlockDataBufferAutoFill=false, NvMBlockHeaderInclude=Dem_Cbk.h, NvMRamBlockDataAddress=&Dem_GetMemoryEntry()[14], NvMWriteRamBlockToNvCallback=false
        NvMTargetBlockReference
          NvMFeeRef (NvMNullRef): NvMNameOfFeeBlock=Fee_EventEntryPrimary_14
        NvMSingleBlockCallback: NvMSingleBlockCallbackFnc=Dem_NvMJobFinished
      NvMBlock_Primary_15: NvMBlockUseAutoValidation=true, NvMBlockUseCRCCompMechanism=false, NvMBlockUseSetRamBlockStatus=true, NvMCalcRamBlockCrc=false, NvMNvBlockBaseNumber=24, NvMNvBlockLength=28, NvMNvramBlockIdentifier=NvMConf_NvMBlockDescriptor_NvMBlock_Primary_15, NvMRomBlockNum=0, NvMSelectBlockForWriteAll=true, NvMRamBlockDataBufferAutoFill=false, NvMBlockHeaderInclude=Dem_Cbk.h, NvMRamBlockDataAddress=&Dem_GetMemoryEntry()[15], NvMWriteRamBlockToNvCallback=false
        NvMTargetBlockReference
          NvMFeeRef (NvMNullRef): NvMNameOfFeeBlock=Fee_EventEntryPrimary_15
        NvMSingleBlockCallback: NvMSingleBlockCallbackFnc=Dem_NvMJobFinished
      NvMBlock_Primary_16: NvMBlockUseAutoValidation=true, NvMBlockUseCRCCompMechanism=false, NvMBlockUseSetRamBlockStatus=true, NvMCalcRamBlockCrc=false, NvMNvBlockBaseNumber=25, NvMNvBlockLength=28, NvMNvramBlockIdentifier=NvMConf_NvMBlockDescriptor_NvMBlock_Primary_16, NvMRomBlockNum=0, NvMSelectBlockForWriteAll=true, NvMRamBlockDataBufferAutoFill=false, NvMBlockHeaderInclude=Dem_Cbk.h, NvMRamBlockDataAddress=&Dem_GetMemoryEntry()[16], NvMWriteRamBlockToNvCallback=false
        NvMTargetBlockReference
          NvMFeeRef (NvMNullRef): NvMNameOfFeeBlock=Fee_EventEntryPrimary_16
        NvMSingleBlockCallback: NvMSingleBlockCallbackFnc=Dem_NvMJobFinished
      NvMBlock_AdminData: NvMBlockUseAutoValidation=true, NvMBlockUseCRCCompMechanism=false, NvMBlockUseSetRamBlockStatus=true, NvMCalcRamBlockCrc=false, NvMNvBlockBaseNumber=26, NvMNvBlockLength=6, NvMNvramBlockIdentifier=NvMConf_NvMBlockDescriptor_NvMBlock_AdminData, NvMRomBlockNum=0, NvMSelectBlockForWriteAll=true, NvMRamBlockDataBufferAutoFill=false, NvMBlockHeaderInclude=Dem_Cbk.h, NvMRamBlockDataAddress=&Dem_GetAdminData()
        NvMTargetBlockReference
          NvMFeeRef (NvMNullRef): NvMNameOfFeeBlock=Fee_DemAdminData
        NvMSingleBlockCallback: NvMSingleBlockCallbackFnc=Dem_NvMJobFinished
        NvMInitBlockCallback: NvMInitBlockCallbackFnc=Dem_NvMInitAdminData
      NvMBlock_EventStatusData: NvMBlockUseAutoValidation=true, NvMBlockUseCRCCompMechanism=false, NvMBlockUseSetRamBlockStatus=true, NvMCalcRamBlockCrc=false, NvMNvBlockBaseNumber=27, NvMNvBlockLength=26, NvMNvramBlockIdentifier=NvMConf_NvMBlockDescriptor_NvMBlock_EventStatusData, NvMRomBlockNum=0, NvMSelectBlockForWriteAll=true, NvMRamBlockDataBufferAutoFill=false, NvMBlockHeaderInclude=Dem_Cbk.h, NvMRamBlockDataAddress=&Dem_GetEventStatusData()
        NvMTargetBlockReference
          NvMFeeRef (NvMNullRef): NvMNameOfFeeBlock=Fee_EventStatusData
        NvMSingleBlockCallback: NvMSingleBlockCallbackFnc=Dem_NvMJobFinished
        NvMInitBlockCallback: NvMInitBlockCallbackFnc=Dem_NvMInitStatusData
