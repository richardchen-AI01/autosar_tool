AUTOSAR XML (schema 00048)
package /S32K148
  module config Port: implementation-config-variant=VARIANT-POST-BUILD, post-build-variant-used=false
    CommonPublishedInformation:
      ArReleaseMajorVersion = 4
      ArReleaseMinorVersion = 7
      ArReleaseRevisionVersion = 0
      ModuleId = 124
      SwMajorVersion = 2
      SwMinorVersion = 0
      SwPatchVersion = 0
      VendorId = 43
    PortConfigSet_0 (PortConfigSet)
      NotUsedPortPin:
        PortPinDSE = Low_Drive_Strength
        PortPinDirection = PORT_PIN_IN
        PortPinLevelValue = PORT_PIN_LEVEL_LOW
        PortPinMode = GPIO
        PortPinPE = PullDisabled
        PortPinPS = PullDown
      PortContainer_CAN (PortContainer): PortNumberOfPortPins=2
        PortPin_PTE4_CAN0_RX (PortPin):
          index = 0
          PortPinDSE = Low_Drive_Strength
          PortPinDirection = PORT_PIN_IN
          PortPinDirectionChangeable = 1
          PortPinId = 1
          PortPinInitialMode = PORT_GPIO_MODE
          PortPinLK = 0
          PortPinLevelValue = PORT_PIN_LEVEL_LOW
          PortPinMode = CAN0_RX
          PortPinModeChangeable = 1
          PortPinODE = 0
          PortPinPE = PullDisabled
          PortPinPFE = 0
          PortPinPS = PullDown
          PortPinPcr = 132
          PortPinSlewRate = FAST_SLEW_RATE
        PortPin_PTE5_CAN0_TX (PortPin):
          index = 1
          PortPinDSE = Low_Drive_Strength
          PortPinDirection = PORT_PIN_OUT
          PortPinDirectionChangeable = 1
          PortPinId = 2
          PortPinInitialMode = PORT_GPIO_MODE
          PortPinLK = 0
          PortPinLevelValue = PORT_PIN_LEVEL_LOW
          PortPinMode = CAN0_TX
          PortPinModeChangeable = 1
          PortPinODE = 0
          PortPinPE = PullDisabled
          PortPinPFE = 0
          PortPinPS = PullDown
          PortPinPcr = 133
          PortPinSlewRate = FAST_SLEW_RATE
      PortContainer_RGBLED (PortContainer): PortNumberOfPortPins=3
        3 x PortPin, all with PortPinDSE=Low_Drive_Strength, PortPinDirection=PORT_PIN_OUT, PortPinDirectionChangeable=1, PortPinInitialMode=PORT_GPIO_MODE, PortPinLK=0, PortPinLevelValue=PORT_PIN_LEVEL_LOW, PortPinModeChangeable=1, PortPinODE=0, PortPinPE=PullDisabled, PortPinPFE=0, PortPinPS=PullDown, PortPinSlewRate=FAST_SLEW_RATE:
          PortPin_PTE21_LED_RED: index=0, PortPinId=3, PortPinMode=FTM4_CH1, PortPinPcr=149
          PortPin_PTE22_LED_GREEN: index=1, PortPinId=4, PortPinMode=FTM4_CH2, PortPinPcr=150
          PortPin_PTE23_LED_BLUE: index=2, PortPinId=5, PortPinMode=FTM4_CH3, PortPinPcr=151
      5 x UnTouchedPortPin:
        PortPin_JTAG_TCK: PortPinPcr=68
        PortPin_JTAG_TDI: PortPinPcr=69
        PortPin_JTAG_TDO: PortPinPcr=10
        PortPin_JTAG_TMS: PortPinPcr=4
        PortPin_Reset_b: PortPinPcr=5
    PortGeneral:
      PortCiPortIPDevErrorDetect = 0
      PortDevErrorDetect = 1
      PortEnableUserModeSupport = 0
      PortMulticoreSupport = 0
      PortResetPinModeApi = 0
      PortSet2PinsDirectionApi = 0
      PortSetAsUnusedPinApi = 0
      PortSetPinDirectionApi = 1
      PortSetPinModeApi = 1
      PortSetPinModeDoesNotTouchGpioLevel = 0
      PortVersionInfoApi = 1
