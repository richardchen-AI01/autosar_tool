AUTOSAR XML (schema 00048)
package /S32K148
  module config MemMap
    MemMapGeneration: AutoMappingByShortName=true, EnableManual=true
    19 x MemMapAddressingModeSet:
      DEFAULT_VAR_CLEARED: MemMapAddressingModeSetType=DEFAULT, MemMapSupportedSectionType=MEMMAP_SECTION_TYPE_VAR, MemMapSupportedSectionInitializationPolicy=CLEARED
        7 x MemMapAddressingMode:
          VAR_CLEARED_64: MemMapAlignmentSelector=64, MemLayoutRegionRef=VAR_CLEARED_64
          VAR_CLEARED_UNSPECIFIED: MemMapAlignmentSelector=UNSPECIFIED, MemLayoutRegionRef=VAR_CLEARED_UNSPECIFIED
          VAR_CLEARED_PTR: MemMapAlignmentSelector=PTR, MemLayoutRegionRef=VAR_CLEARED_PTR
          VAR_CLEARED_32: MemMapAlignmentSelector=32, MemLayoutRegionRef=VAR_CLEARED_32
          VAR_CLEARED_16: MemMapAlignmentSelector=16, MemLayoutRegionRef=VAR_CLEARED_16
          VAR_CLEARED_8: MemMapAlignmentSelector=8, MemLayoutRegionRef=VAR_CLEARED_8
          VAR_CLEARED_BOOLEAN: MemMapAlignmentSelector=BOOLEAN, MemLayoutRegionRef=VAR_CLEARED_BOOLEAN
      DEFAULT_VAR_INIT: MemMapAddressingModeSetType=DEFAULT, MemMapSupportedSectionType=MEMMAP_SECTION_TYPE_VAR, MemMapSupportedSectionInitializationPolicy=INIT
        7 x MemMapAddressingMode:
          VAR_INIT_64: MemMapAlignmentSelector=64, MemLayoutRegionRef=VAR_INIT_64
          VAR_INIT_UNSPECIFIED: MemMapAlignmentSelector=UNSPECIFIED, MemLayoutRegionRef=VAR_INIT_UNSPECIFIED
          VAR_INIT_PTR: MemMapAlignmentSelector=PTR, MemLayoutRegionRef=VAR_INIT_PTR
          VAR_INIT_32: MemMapAlignmentSelector=32, MemLayoutRegionRef=VAR_INIT_32
          VAR_INIT_16: MemMapAlignmentSelector=16, MemLayoutRegionRef=VAR_INIT_16
          VAR_INIT_8: MemMapAlignmentSelector=8, MemLayoutRegionRef=VAR_INIT_8
          VAR_INIT_BOOLEAN: MemMapAlignmentSelector=BOOLEAN, MemLayoutRegionRef=VAR_INIT_BOOLEAN
      DEFAULT_VAR_POWER_ON_CLEARED: MemMapAddressingModeSetType=DEFAULT, MemMapSupportedSectionType=MEMMAP_SECTION_TYPE_VAR, MemMapSupportedSectionInitializationPolicy=POWER-ON-CLEARED
        7 x MemMapAddressingMode:
          VAR_POWER_ON_CLEARED_64: MemMapAlignmentSelector=64, MemLayoutRegionRef=VAR_POWER_ON_CLEARED_64
          VAR_POWER_ON_CLEARED_UNSPECIFIED: MemMapAlignmentSelector=UNSPECIFIED, MemLayoutRegionRef=VAR_POWER_ON_CLEARED_UNSPECIFIED
          VAR_POWER_ON_CLEARED_PTR: MemMapAlignmentSelector=PTR, MemLayoutRegionRef=VAR_POWER_ON_CLEARED_PTR
          VAR_POWER_ON_CLEARED_32: MemMapAlignmentSelector=32, MemLayoutRegionRef=VAR_POWER_ON_CLEARED_32
          VAR_POWER_ON_CLEARED_16: MemMapAlignmentSelector=16, MemLayoutRegionRef=VAR_POWER_ON_CLEARED_16
          VAR_POWER_ON_CLEARED_8: MemMapAlignmentSelector=8, MemLayoutRegionRef=VAR_POWER_ON_CLEARED_8
          VAR_POWER_ON_CLEARED_BOOLEAN: MemMapAlignmentSelector=BOOLEAN, MemLayoutRegionRef=VAR_POWER_ON_CLEARED_BOOLEAN
      DEFAULT_VAR_FAST_CLEARED: MemMapAddressingModeSetType=DEFAULT, MemMapSupportedSectionType=MEMMAP_SECTION_TYPE_VAR, MemMapSupportedSectionInitializationPolicy=CLEARED
        7 x MemMapAddressingMode:
          VAR_FAST_CLEARED_64: MemMapAlignmentSelector=64, MemLayoutRegionRef=VAR_FAST_CLEARED_64
          VAR_FAST_CLEARED_UNSPECIFIED: MemMapAlignmentSelector=UNSPECIFIED, MemLayoutRegionRef=VAR_FAST_CLEARED_UNSPECIFIED
          VAR_FAST_CLEARED_PTR: MemMapAlignmentSelector=PTR, MemLayoutRegionRef=VAR_FAST_CLEARED_PTR
          VAR_FAST_CLEARED_32: MemMapAlignmentSelector=32, MemLayoutRegionRef=VAR_FAST_CLEARED_32
          VAR_FAST_CLEARED_16: MemMapAlignmentSelector=16, MemLayoutRegionRef=VAR_FAST_CLEARED_16
          VAR_FAST_CLEARED_8: MemMapAlignmentSelector=8, MemLayoutRegionRef=VAR_FAST_CLEARED_8
          VAR_FAST_CLEARED_BOOLEAN: MemMapAlignmentSelector=BOOLEAN, MemLayoutRegionRef=VAR_FAST_CLEARED_BOOLEAN
      DEFAULT_VAR_FAST_INIT: MemMapAddressingModeSetType=DEFAULT, MemMapSupportedSectionType=MEMMAP_SECTION_TYPE_VAR, MemMapSupportedSectionInitializationPolicy=INIT
        7 x MemMapAddressingMode:
          VAR_FAST_INIT_64: MemMapAlignmentSelector=64, MemLayoutRegionRef=VAR_FAST_INIT_64
          VAR_FAST_INIT_UNSPECIFIED: MemMapAlignmentSelector=UNSPECIFIED, MemLayoutRegionRef=VAR_FAST_INIT_UNSPECIFIED
          VAR_FAST_INIT_PTR: MemMapAlignmentSelector=PTR, MemLayoutRegionRef=VAR_FAST_INIT_PTR
          VAR_FAST_INIT_32: MemMapAlignmentSelector=32, MemLayoutRegionRef=VAR_FAST_INIT_32
          VAR_FAST_INIT_16: MemMapAlignmentSelector=16, MemLayoutRegionRef=VAR_FAST_INIT_16
          VAR_FAST_INIT_8: MemMapAlignmentSelector=8, MemLayoutRegionRef=VAR_FAST_INIT_8
          VAR_FAST_INIT_BOOLEAN: MemMapAlignmentSelector=BOOLEAN, MemLayoutRegionRef=VAR_FAST_INIT_BOOLEAN
      DEFAULT_VAR_FAST_POWER_ON_CLEARED: MemMapAddressingModeSetType=DEFAULT, MemMapSupportedSectionType=MEMMAP_SECTION_TYPE_VAR, MemMapSupportedSectionInitializationPolicy=POWER-ON-CLEARED
        7 x MemMapAddressingMode:
          VAR_FAST_POWER_ON_CLEARED_64: MemMapAlignmentSelector=64, MemLayoutRegionRef=VAR_FAST_POWER_ON_CLEARED_64
          VAR_FAST_POWER_ON_CLEARED_UNSPECIFIED: MemMapAlignmentSelector=UNSPECIFIED, MemLayoutRegionRef=VAR_FAST_POWER_ON_CLEARED_UNSPECIFIED
          VAR_FAST_POWER_ON_CLEARED_PTR: MemMapAlignmentSelector=PTR, MemLayoutRegionRef=VAR_FAST_POWER_ON_CLEARED_PTR
          VAR_FAST_POWER_ON_CLEARED_32: MemMapAlignmentSelector=32, MemLayoutRegionRef=VAR_FAST_POWER_ON_CLEARED_32
          VAR_FAST_POWER_ON_CLEARED_16: MemMapAlignmentSelector=16, MemLayoutRegionRef=VAR_FAST_POWER_ON_CLEARED_16
          VAR_FAST_POWER_ON_CLEARED_8: MemMapAlignmentSelector=8, MemLayoutRegionRef=VAR_FAST_POWER_ON_CLEARED_8
          VAR_FAST_POWER_ON_CLEARED_BOOLEAN: MemMapAlignmentSelector=BOOLEAN, MemLayoutRegionRef=VAR_FAST_POWER_ON_CLEARED_BOOLEAN
      DEFAULT_VAR_CLONE: MemMapAddressingModeSetType=DEFAULT, MemMapSupportedSectionType=MEMMAP_SECTION_TYPE_VAR, MemMapSupportedSectionInitializationPolicy=CLEARED
        7 x MemMapAddressingMode:
          VAR_CLONE_64: MemMapAlignmentSelector=64, MemLayoutRegionRef=VAR_CLONE_64
          VAR_CLONE_UNSPECIFIED: MemMapAlignmentSelector=UNSPECIFIED, MemLayoutRegionRef=VAR_CLONE_UNSPECIFIED
          VAR_CLONE_PTR: MemMapAlignmentSelector=PTR, MemLayoutRegionRef=VAR_CLONE_PTR
          VAR_CLONE_32: MemMapAlignmentSelector=32, MemLayoutRegionRef=VAR_CLONE_32
          VAR_CLONE_16: MemMapAlignmentSelector=16, MemLayoutRegionRef=VAR_CLONE_16
          VAR_CLONE_8: MemMapAlignmentSelector=8, MemLayoutRegionRef=VAR_CLONE_8
          VAR_CLONE_BOOLEAN: MemMapAlignmentSelector=BOOLEAN, MemLayoutRegionRef=VAR_CLONE_BOOLEAN
      DEFAULT_INTERNAL_VAR_CLEARED: MemMapAddressingModeSetType=DEFAULT, MemMapSupportedSectionType=MEMMAP_SECTION_TYPE_VAR, MemMapSupportedSectionInitializationPolicy=CLEARED
        7 x MemMapAddressingMode:
          INTERNAL_VAR_CLEARED_64: MemMapAlignmentSelector=64, MemLayoutRegionRef=INTERNAL_VAR_CLEARED_64
          INTERNAL_VAR_CLEARED_UNSPECIFIED: MemMapAlignmentSelector=UNSPECIFIED, MemLayoutRegionRef=INTERNAL_VAR_CLEARED_UNSPECIFIED
          INTERNAL_VAR_CLEARED_PTR: MemMapAlignmentSelector=PTR, MemLayoutRegionRef=INTERNAL_VAR_CLEARED_PTR
          INTERNAL_VAR_CLEARED_32: MemMapAlignmentSelector=32, MemLayoutRegionRef=INTERNAL_VAR_CLEARED_32
          INTERNAL_VAR_CLEARED_16: MemMapAlignmentSelector=16, MemLayoutRegionRef=INTERNAL_VAR_CLEARED_16
          INTERNAL_VAR_CLEARED_8: MemMapAlignmentSelector=8, MemLayoutRegionRef=INTERNAL_VAR_CLEARED_8
          INTERNAL_VAR_CLEARED_BOOLEAN: MemMapAlignmentSelector=BOOLEAN, MemLayoutRegionRef=INTERNAL_VAR_CLEARED_BOOLEAN
      DEFAULT_INTERNAL_VAR_INIT: MemMapAddressingModeSetType=DEFAULT, MemMapSupportedSectionType=MEMMAP_SECTION_TYPE_VAR, MemMapSupportedSectionInitializationPolicy=INIT
        7 x MemMapAddressingMode:
          INTERNAL_VAR_INIT_64: MemMapAlignmentSelector=64, MemLayoutRegionRef=INTERNAL_VAR_INIT_64
          INTERNAL_VAR_INIT_UNSPECIFIED: MemMapAlignmentSelector=UNSPECIFIED, MemLayoutRegionRef=INTERNAL_VAR_INIT_UNSPECIFIED
          INTERNAL_VAR_INIT_PTR: MemMapAlignmentSelector=PTR, MemLayoutRegionRef=INTERNAL_VAR_INIT_PTR
          INTERNAL_VAR_INIT_32: MemMapAlignmentSelector=32, MemLayoutRegionRef=INTERNAL_VAR_INIT_32
          INTERNAL_VAR_INIT_16: MemMapAlignmentSelector=16, MemLayoutRegionRef=INTERNAL_VAR_INIT_16
          INTERNAL_VAR_INIT_8: MemMapAlignmentSelector=8, MemLayoutRegionRef=INTERNAL_VAR_INIT_8
          INTERNAL_VAR_INIT_BOOLEAN: MemMapAlignmentSelector=BOOLEAN, MemLayoutRegionRef=INTERNAL_VAR_INIT_BOOLEAN
      DEFAULT_INTERNAL_VAR_POWER_ON_CLEARED: MemMapAddressingModeSetType=DEFAULT, MemMapSupportedSectionType=MEMMAP_SECTION_TYPE_VAR, MemMapSupportedSectionInitializationPolicy=POWER-ON-CLEARED
        7 x MemMapAddressingMode:
          INTERNAL_VAR_POWER_ON_CLEARED_64: MemMapAlignmentSelector=64, MemLayoutRegionRef=INTERNAL_VAR_POWER_ON_CLEARED_64
          INTERNAL_VAR_POWER_ON_CLEARED_UNSPECIFIED: MemMapAlignmentSelector=UNSPECIFIED, MemLayoutRegionRef=INTERNAL_VAR_POWER_ON_CLEARED_UNSPECIFIED
          INTERNAL_VAR_POWER_ON_CLEARED_PTR: MemMapAlignmentSelector=PTR, MemLayoutRegionRef=INTERNAL_VAR_POWER_ON_CLEARED_PTR
          INTERNAL_VAR_POWER_ON_CLEARED_32: MemMapAlignmentSelector=32, MemLayoutRegionRef=INTERNAL_VAR_POWER_ON_CLEARED_32
          INTERNAL_VAR_POWER_ON_CLEARED_16: MemMapAlignmentSelector=16, MemLayoutRegionRef=INTERNAL_VAR_POWER_ON_CLEARED_16
          INTERNAL_VAR_POWER_ON_CLEARED_8: MemMapAlignmentSelector=8, MemLayoutRegionRef=INTERNAL_VAR_POWER_ON_CLEARED_8
          INTERNAL_VAR_POWER_ON_CLEARED_BOOLEAN: MemMapAlignmentSelector=BOOLEAN, MemLayoutRegionRef=INTERNAL_VAR_POWER_ON_CLEARED_BOOLEAN
      DEFAULT_VAR_SAVED_ZONE: MemMapAddressingModeSetType=DEFAULT, MemMapSupportedSectionType=MEMMAP_SECTION_TYPE_VAR, MemMapSupportedSectionInitializationPolicy=POWER-ON-CLEARED
        7 x MemMapAddressingMode:
          VAR_SAVED_ZONE_64: MemMapAlignmentSelector=64, MemLayoutRegionRef=VAR_SAVED_ZONE_64
          VAR_SAVED_ZONE_UNSPECIFIED: MemMapAlignmentSelector=UNSPECIFIED, MemLayoutRegionRef=VAR_SAVED_ZONE_UNSPECIFIED
          VAR_SAVED_ZONE_PTR: MemMapAlignmentSelector=PTR, MemLayoutRegionRef=VAR_SAVED_ZONE_PTR
          VAR_SAVED_ZONE_32: MemMapAlignmentSelector=32, MemLayoutRegionRef=VAR_SAVED_ZONE_32
          VAR_SAVED_ZONE_16: MemMapAlignmentSelector=16, MemLayoutRegionRef=VAR_SAVED_ZONE_16
          VAR_SAVED_ZONE_8: MemMapAlignmentSelector=8, MemLayoutRegionRef=VAR_SAVED_ZONE_8
          VAR_SAVED_ZONE_BOOLEAN: MemMapAlignmentSelector=BOOLEAN, MemLayoutRegionRef=VAR_SAVED_ZONE_BOOLEAN
      DEFAULT_CONST: MemMapAddressingModeSetType=DEFAULT, MemMapSupportedSectionType=MEMMAP_SECTION_TYPE_CONST
        7 x MemMapAddressingMode:
          CONST_64: MemMapAlignmentSelector=64, MemLayoutRegionRef=CONST_64
          CONST_UNSPECIFIED: MemMapAlignmentSelector=UNSPECIFIED, MemLayoutRegionRef=CONST_UNSPECIFIED
          CONST_PTR: MemMapAlignmentSelector=PTR, MemLayoutRegionRef=CONST_PTR
          CONST_32: MemMapAlignmentSelector=32, MemLayoutRegionRef=CONST_32
          CONST_16: MemMapAlignmentSelector=16, MemLayoutRegionRef=CONST_16
          CONST_8: MemMapAlignmentSelector=8, MemLayoutRegionRef=CONST_8
          CONST_BOOLEAN: MemMapAlignmentSelector=BOOLEAN, MemLayoutRegionRef=CONST_BOOLEAN
      DEFAULT_CONFIG_DATA: MemMapAddressingModeSetType=DEFAULT, MemMapSupportedSectionType=MEMMAP_SECTION_TYPE_CONFIG_DATA
        7 x MemMapAddressingMode:
          CONFIG_DATA_64: MemMapAlignmentSelector=64, MemLayoutRegionRef=CONFIG_DATA_64
          CONFIG_DATA_UNSPECIFIED: MemMapAlignmentSelector=UNSPECIFIED, MemLayoutRegionRef=CONFIG_DATA_UNSPECIFIED
          CONFIG_DATA_PTR: MemMapAlignmentSelector=PTR, MemLayoutRegionRef=CONFIG_DATA_PTR
          CONFIG_DATA_32: MemMapAlignmentSelector=32, MemLayoutRegionRef=CONFIG_DATA_32
          CONFIG_DATA_16: MemMapAlignmentSelector=16, MemLayoutRegionRef=CONFIG_DATA_16
          CONFIG_DATA_8: MemMapAlignmentSelector=8, MemLayoutRegionRef=CONFIG_DATA_8
          CONFIG_DATA_BOOLEAN: MemMapAlignmentSelector=BOOLEAN, MemLayoutRegionRef=CONFIG_DATA_BOOLEAN
      DEFAULT_CALIB: MemMapAddressingModeSetType=DEFAULT, MemMapSupportedSectionType=MEMMAP_SECTION_TYPE_CAL_PRM
        7 x MemMapAddressingMode:
          CALIB_64: MemMapAlignmentSelector=64, MemLayoutRegionRef=CALIB_64
          CALIB_UNSPECIFIED: MemMapAlignmentSelector=UNSPECIFIED, MemLayoutRegionRef=CALIB_UNSPECIFIED
          CALIB_PTR: MemMapAlignmentSelector=PTR, MemLayoutRegionRef=CALIB_PTR
          CALIB_32: MemMapAlignmentSelector=32, MemLayoutRegionRef=CALIB_32
          CALIB_16: MemMapAlignmentSelector=16, MemLayoutRegionRef=CALIB_16
          CALIB_8: MemMapAlignmentSelector=8, MemLayoutRegionRef=CALIB_8
          CALIB_BOOLEAN: MemMapAlignmentSelector=BOOLEAN, MemLayoutRegionRef=CALIB_BOOLEAN
      DEFAULT_CODE: MemMapAddressingModeSetType=DEFAULT, MemMapSupportedSectionType=MEMMAP_SECTION_TYPE_CODE
        7 x MemMapAddressingMode:
          CODE_64: MemMapAlignmentSelector=64, MemLayoutRegionRef=CODE_64
          CODE_UNSPECIFIED: MemMapAlignmentSelector=UNSPECIFIED, MemLayoutRegionRef=CODE_UNSPECIFIED
          CODE_PTR: MemMapAlignmentSelector=PTR, MemLayoutRegionRef=CODE_PTR
          CODE_32: MemMapAlignmentSelector=32, MemLayoutRegionRef=CODE_32
          CODE_16: MemMapAlignmentSelector=16, MemLayoutRegionRef=CODE_16
          CODE_8: MemMapAlignmentSelector=8, MemLayoutRegionRef=CODE_8
          CODE_BOOLEAN: MemMapAlignmentSelector=BOOLEAN, MemLayoutRegionRef=CODE_BOOLEAN
      DEFAULT_CODE_FAST: MemMapAddressingModeSetType=DEFAULT, MemMapSupportedSectionType=MEMMAP_SECTION_TYPE_CODE
        7 x MemMapAddressingMode:
          CODE_FAST_64: MemMapAlignmentSelector=64, MemLayoutRegionRef=CODE_FAST_64
          CODE_FAST_UNSPECIFIED: MemMapAlignmentSelector=UNSPECIFIED, MemLayoutRegionRef=CODE_FAST_UNSPECIFIED
          CODE_FAST_PTR: MemMapAlignmentSelector=PTR, MemLayoutRegionRef=CODE_FAST_PTR
          CODE_FAST_32: MemMapAlignmentSelector=32, MemLayoutRegionRef=CODE_FAST_32
          CODE_FAST_16: MemMapAlignmentSelector=16, MemLayoutRegionRef=CODE_FAST_16
          CODE_FAST_8: MemMapAlignmentSelector=8, MemLayoutRegionRef=CODE_FAST_8
          CODE_FAST_BOOLEAN: MemMapAlignmentSelector=BOOLEAN, MemLayoutRegionRef=CODE_FAST_BOOLEAN
      DEFAULT_CALLOUT_CODE: MemMapAddressingModeSetType=DEFAULT, MemMapSupportedSectionType=MEMMAP_SECTION_TYPE_CODE
        7 x MemMapAddressingMode:
          CALLOUT_CODE_64: MemMapAlignmentSelector=64, MemLayoutRegionRef=CALLOUT_CODE_64
          CALLOUT_CODE_UNSPECIFIED: MemMapAlignmentSelector=UNSPECIFIED, MemLayoutRegionRef=CALLOUT_CODE_UNSPECIFIED
          CALLOUT_CODE_PTR: MemMapAlignmentSelector=PTR, MemLayoutRegionRef=CALLOUT_CODE_PTR
          CALLOUT_CODE_32: MemMapAlignmentSelector=32, MemLayoutRegionRef=CALLOUT_CODE_32
          CALLOUT_CODE_16: MemMapAlignmentSelector=16, MemLayoutRegionRef=CALLOUT_CODE_16
          CALLOUT_CODE_8: MemMapAlignmentSelector=8, MemLayoutRegionRef=CALLOUT_CODE_8
          CALLOUT_CODE_BOOLEAN: MemMapAlignmentSelector=BOOLEAN, MemLayoutRegionRef=CALLOUT_CODE_BOOLEAN
      DEFAULT_VAR_INIT_CORE0: MemMapAddressingModeSetType=CUSTOM, MemMapSupportedSectionType=MEMMAP_SECTION_TYPE_VAR, MemMapSupportedSectionInitializationPolicy=INIT
        7 x MemMapAddressingMode:
          VAR_INIT_CORE_0_64: MemMapAlignmentSelector=64, MemLayoutRegionRef=VAR_INIT_CORE0_64
          VAR_INIT_CORE_0_UNSPECIFIED: MemMapAlignmentSelector=UNSPECIFIED, MemLayoutRegionRef=VAR_INIT_CORE0_UNSPECIFIED
          VAR_INIT_CORE_0_PTR: MemMapAlignmentSelector=PTR, MemLayoutRegionRef=VAR_INIT_CORE0_PTR
          VAR_INIT_CORE_0_32: MemMapAlignmentSelector=32, MemLayoutRegionRef=VAR_INIT_CORE0_32
          VAR_INIT_CORE_0_16: MemMapAlignmentSelector=16, MemLayoutRegionRef=VAR_INIT_CORE0_16
          VAR_INIT_CORE_0_8: MemMapAlignmentSelector=8, MemLayoutRegionRef=VAR_INIT_CORE0_8
          VAR_INIT_CORE_0_BOOLEAN: MemMapAlignmentSelector=BOOLEAN, MemLayoutRegionRef=VAR_INIT_CORE0_BOOLEAN
      DEFAULT_VAR_CLEARED_CORE0: MemMapAddressingModeSetType=CUSTOM, MemMapSupportedSectionType=MEMMAP_SECTION_TYPE_VAR, MemMapSupportedSectionInitializationPolicy=CLEARED
        7 x MemMapAddressingMode:
          VAR_CLEARED_CORE_0_64: MemMapAlignmentSelector=64, MemLayoutRegionRef=VAR_CLEARED_CORE0_64
          VAR_CLEARED_CORE_0_UNSPECIFIED: MemMapAlignmentSelector=UNSPECIFIED, MemLayoutRegionRef=VAR_CLEARED_CORE0_UNSPECIFIED
          VAR_CLEARED_CORE_0_PTR: MemMapAlignmentSelector=PTR, MemLayoutRegionRef=VAR_CLEARED_CORE0_PTR
          VAR_CLEARED_CORE_0_32: MemMapAlignmentSelector=32, MemLayoutRegionRef=VAR_CLEARED_CORE0_32
          VAR_CLEARED_CORE_0_16: MemMapAlignmentSelector=16, MemLayoutRegionRef=VAR_CLEARED_CORE0_16
          VAR_CLEARED_CORE_0_8: MemMapAlignmentSelector=8, MemLayoutRegionRef=VAR_CLEARED_CORE0_8
          VAR_CLEARED_CORE_0_BOOLEAN: MemMapAlignmentSelector=BOOLEAN, MemLayoutRegionRef=VAR_CLEARED_CORE0_BOOLEAN
    DEFAULT (MemMapAllocation): MemMapAllocationType=DEFAULT
      17 x MemMapGenericMapping:
        DEFAULT_CALIB: MemMapAddressingModeSetRef=MemMap/DEFAULT_CALIB, MemMapSwAddressMethodRef=CALIB
        DEFAULT_CALLOUT_CODE: MemMapAddressingModeSetRef=MemMap/DEFAULT_CALLOUT_CODE, MemMapSwAddressMethodRef=CALLOUT_CODE
        DEFAULT_VAR_FAST_POWER_ON_CLEARED: MemMapAddressingModeSetRef=MemMap/DEFAULT_VAR_FAST_POWER_ON_CLEARED, MemMapSwAddressMethodRef=VAR_FAST_POWER_ON_CLEARED
        DEFAULT_CONST: MemMapAddressingModeSetRef=MemMap/DEFAULT_CONST, MemMapSwAddressMethodRef=CONST
        DEFAULT_CODE_FAST: MemMapAddressingModeSetRef=MemMap/DEFAULT_CODE_FAST, MemMapSwAddressMethodRef=CODE_FAST
        DEFAULT_INTERNAL_VAR_CLEARED: MemMapAddressingModeSetRef=MemMap/DEFAULT_INTERNAL_VAR_CLEARED, MemMapSwAddressMethodRef=INTERNAL_VAR_CLEARED
        DEFAULT_VAR_POWER_ON_CLEARED: MemMapAddressingModeSetRef=MemMap/DEFAULT_VAR_POWER_ON_CLEARED, MemMapSwAddressMethodRef=VAR_POWER_ON_CLEARED
        DEFAULT_CONFIG_DATA: MemMapAddressingModeSetRef=MemMap/DEFAULT_CONFIG_DATA, MemMapSwAddressMethodRef=CONFIG_DATA
        DEFAULT_INTERNAL_VAR_INIT: MemMapAddressingModeSetRef=MemMap/DEFAULT_INTERNAL_VAR_INIT, MemMapSwAddressMethodRef=INTERNAL_VAR_INIT
        DEFAULT_INTERNAL_VAR_POWER_ON_CLEARED: MemMapAddressingModeSetRef=MemMap/DEFAULT_INTERNAL_VAR_POWER_ON_CLEARED, MemMapSwAddressMethodRef=INTERNAL_VAR_POWER_ON_CLEARED
        DEFAULT_CODE: MemMapAddressingModeSetRef=MemMap/DEFAULT_CODE, MemMapSwAddressMethodRef=CODE
        DEFAULT_VAR_CLEARED: MemMapAddressingModeSetRef=MemMap/DEFAULT_VAR_CLEARED, MemMapSwAddressMethodRef=VAR_CLEARED
        DEFAULT_VAR_FAST_INIT: MemMapAddressingModeSetRef=MemMap/DEFAULT_VAR_FAST_INIT, MemMapSwAddressMethodRef=VAR_FAST_INIT
        DEFAULT_VAR_FAST_CLEARED: MemMapAddressingModeSetRef=MemMap/DEFAULT_VAR_FAST_CLEARED, MemMapSwAddressMethodRef=VAR_FAST_CLEARED
        DEFAULT_VAR_INIT: MemMapAddressingModeSetRef=MemMap/DEFAULT_VAR_INIT, MemMapSwAddressMethodRef=VAR_INIT
        DEFAULT_VAR_SAVED_ZONE: MemMapAddressingModeSetRef=MemMap/DEFAULT_VAR_SAVED_ZONE, MemMapSwAddressMethodRef=VAR_SAVED_ZONE
        DEFAULT_VAR_CLONE: MemMapAddressingModeSetRef=MemMap/DEFAULT_VAR_CLONE, MemMapSwAddressMethodRef=VAR_CLONE
