AUTOSAR XML (schema 00048)
package /S32K148
  module config CanIf
    CanIfCtrlDrvCfg: CanIfCtrlDrvInitHohConfigRef=CanIfInitHohCfg, CanIfCtrlDrvNameRef=Can_43_FLEXCAN
      CANIF_CAN_CONTROLLER_0_ECU_ECU (CanIfCtrlCfg): CanIfCtrlId=CANIF_CANDRV_0_CANIF_CAN_CONTROLLER_0_ECU_ECU, CanIfCtrlWakeupSupport=false, CanIfCtrlCanCtrlRef=CanController_0
    CanIfDispatchCfg:
      CanIfDispatchUserCheckTrcvWakeFlagIndicationName = User_CheckTransceiverWakeFlagIndication
      CanIfDispatchUserClearTrcvWufFlagIndicationName = User_ClearTrcvWufFlagIndication
      CanIfDispatchUserConfirmPnAvailabilityName = User_ConfirmPnAvailability
      CanIfDispatchUserCtrlBusOffName = CanSM_ControllerBusOff
      CanIfDispatchUserCtrlBusOffUL = CAN_SM
      CanIfDispatchUserCtrlModeIndicationName = CanSM_ControllerModeIndication
      CanIfDispatchUserCtrlModeIndicationUL = CAN_SM
      CanIfDispatchUserTrcvModeIndicationName = User_TrcvModeIndication
      CanIfDispatchUserValidateWakeupEventName = User_ValidateWakeupEvent
    CanIfInitCfg: CanIfInitCfgSet=CanIfInitCfgSet
      CanIfInitHohCfg
        7 x CanIfHrhCfg, all with CanIfHrhSoftwareFilter=false, CanIfHrhCanCtrlIdRef=CANIF_CAN_CONTROLLER_0_ECU_ECU:
          CANIF_CAN_CONTROLLER_0_ECU_CAN0_Rx_0x260_E2E_P01_FULL_HRH: CanIfHrhIdSymRef=CanHardwareObject_CAN0_Rx_0x260_E2E_P01
          CANIF_CAN_CONTROLLER_0_ECU_CAN0_Rx_0x251_Cyclic_PN29_FULL_HRH: CanIfHrhIdSymRef=CanHardwareObject_CAN0_Rx_0x251_Cyclic_PN29
          CANIF_CAN_CONTROLLER_0_ECU_CAN0_Rx_0x250_Cyclic_PN17_FULL_HRH: CanIfHrhIdSymRef=CanHardwareObject_CAN0_Rx_0x250_Cyclic_PN17
          CANIF_CAN_CONTROLLER_0_ECU_CAN0_Rx_0x200_Cyclic_FULL_HRH: CanIfHrhIdSymRef=CanHardwareObject_CAN0_Rx_0x200_Cyclic
          CANIF_CAN_CONTROLLER_0_ECU_CAN0_Rx_0x201_Event_FULL_HRH: CanIfHrhIdSymRef=CanHardwareObject_CAN0_Rx_0x201_Event
          CANIF_CAN_CONTROLLER_0_ECU_CAN0_Rx_0x202_Mixed_FULL_HRH: CanIfHrhIdSymRef=CanHardwareObject_CAN0_Rx_0x202_Mixed
          CANIF_CAN_CONTROLLER_0_ECU_CAN0_Rx_0x203_Cyclic_Counter_FULL_HRH: CanIfHrhIdSymRef=CanHardwareObject_CAN0_Rx_0x203_Cyclic_Counter
        7 x CanIfHthCfg, all with CanIfHthCanCtrlIdRef=CANIF_CAN_CONTROLLER_0_ECU_ECU:
          CANIF_CAN_CONTROLLER_0_ECU_CAN0_Tx_0x360_E2E_P01_FULL_HTH: CanIfHthIdSymRef=CanHardwareObject_CAN0_Tx_0x360_E2E_P01
          CANIF_CAN_CONTROLLER_0_ECU_CAN0_Tx_0x351_Cyclic_PN29_FULL_HTH: CanIfHthIdSymRef=CanHardwareObject_CAN0_Tx_0x351_Cyclic_PN29
          CANIF_CAN_CONTROLLER_0_ECU_CAN0_Tx_0x350_Cyclic_PN17_FULL_HTH: CanIfHthIdSymRef=CanHardwareObject_CAN0_Tx_0x350_Cyclic_PN17
          CANIF_CAN_CONTROLLER_0_ECU_CAN0_Tx_0x300_Cyclic_FULL_HTH: CanIfHthIdSymRef=CanHardwareObject_CAN0_Tx_0x300_Cyclic
          CANIF_CAN_CONTROLLER_0_ECU_CAN0_Tx_0x301_Event_FULL_HTH: CanIfHthIdSymRef=CanHardwareObject_CAN0_Tx_0x301_Event
          CANIF_CAN_CONTROLLER_0_ECU_CAN0_Tx_0x302_Mixed_FULL_HTH: CanIfHthIdSymRef=CanHardwareObject_CAN0_Tx_0x302_Mixed
          CANIF_CAN_CONTROLLER_0_ECU_CAN0_Tx_0x303_Cyclic_Counter_FULL_HTH: CanIfHthIdSymRef=CanHardwareObject_CAN0_Tx_0x303_Cyclic_Counter
        CANIF_CAN_CONTROLLER_0_ECU_CAN0_Rx_0x5xx_NM_ECU_FULL_HRH (CanIfHrhCfg): CanIfHrhSoftwareFilter=false, CanIfHrhCanCtrlIdRef=CANIF_CAN_CONTROLLER_0_ECU_ECU, CanIfHrhIdSymRef=CanHardwareObject_CAN0_Rx_0x5xx_NM_ECU
        CANIF_CAN_CONTROLLER_0_ECU_CAN0_Tx_0x501_NM_ECU_FULL_HTH (CanIfHthCfg): CanIfHthCanCtrlIdRef=CANIF_CAN_CONTROLLER_0_ECU_ECU, CanIfHthIdSymRef=CanHardwareObject_CAN0_Tx_0x501_NM_ECU
        CanIfHrhCfg_CAN_Func (CanIfHrhCfg):
          CanIfHrhSoftwareFilter = false
          CanIfHrhCanCtrlIdRef = CANIF_CAN_CONTROLLER_0_ECU_ECU
          CanIfHrhIdSymRef = CanHardwareObject_CAN0_Rx_0x7df_Diag_Fun_Request
        CanIfHrhCfg_CAN_Phys (CanIfHrhCfg):
          CanIfHrhSoftwareFilter = false
          CanIfHrhCanCtrlIdRef = CANIF_CAN_CONTROLLER_0_ECU_ECU
          CanIfHrhIdSymRef = CanHardwareObject_CAN0_Rx_0x708_Diag_Phy_Request
        CanIfHthCfg_CAN_USDT (CanIfHthCfg): CanIfHthCanCtrlIdRef=CANIF_CAN_CONTROLLER_0_ECU_ECU, CanIfHthIdSymRef=CanHardwareObject_CAN0_Tx_0x709_Diag_Phy_Response
      7 x CanIfRxPduCfg, all with CanIfRxPduCanIdType=STANDARD_NO_FD_CAN, CanIfRxPduDataLength=8, CanIfRxPduDataLengthCheck=true, CanIfRxPduReadData=false, CanIfRxPduReadNotifyStatus=false, CanIfRxPduUserRxIndicationName=PduR_CanIfRxIndication, CanIfRxPduUserRxIndicationUL=PDUR:
        RX_PDU_CAN0_Rx_0x260_E2E_P01: CanIfRxPduCanId=608, CanIfRxPduId=CANIF_RXPDU_CANIF_CAN0_Rx_0x260_E2E_P01, CanIfRxPduHrhIdRef=CANIF_CAN_CONTROLLER_0_ECU_CAN0_Rx_0x260_E2E_P01_FULL_HRH, CanIfRxPduRef=CANIF_CAN0_Rx_0x260_E2E_P01
        RX_PDU_CAN0_Rx_0x251_Cyclic_PN29: CanIfRxPduCanId=593, CanIfRxPduId=CANIF_RXPDU_CANIF_CAN0_Rx_0x251_Cyclic_PN29, CanIfRxPduHrhIdRef=CANIF_CAN_CONTROLLER_0_ECU_CAN0_Rx_0x251_Cyclic_PN29_FULL_HRH, CanIfRxPduRef=CANIF_CAN0_Rx_0x251_Cyclic_PN29
        RX_PDU_CAN0_Rx_0x250_Cyclic_PN17: CanIfRxPduCanId=592, CanIfRxPduId=CANIF_RXPDU_CANIF_CAN0_Rx_0x250_Cyclic_PN17, CanIfRxPduHrhIdRef=CANIF_CAN_CONTROLLER_0_ECU_CAN0_Rx_0x250_Cyclic_PN17_FULL_HRH, CanIfRxPduRef=CANIF_CAN0_Rx_0x250_Cyclic_PN17
        RX_PDU_CAN0_Rx_0x200_Cyclic: CanIfRxPduCanId=512, CanIfRxPduId=CANIF_RXPDU_CANIF_CAN0_Rx_0x200_Cyclic, CanIfRxPduHrhIdRef=CANIF_CAN_CONTROLLER_0_ECU_CAN0_Rx_0x200_Cyclic_FULL_HRH, CanIfRxPduRef=CANIF_CAN0_Rx_0x200_Cyclic
        RX_PDU_CAN0_Rx_0x201_Event: CanIfRxPduCanId=513, CanIfRxPduId=CANIF_RXPDU_CANIF_CAN0_Rx_0x201_Event, CanIfRxPduHrhIdRef=CANIF_CAN_CONTROLLER_0_ECU_CAN0_Rx_0x201_Event_FULL_HRH, CanIfRxPduRef=CANIF_CAN0_Rx_0x201_Event
        RX_PDU_CAN0_Rx_0x202_Mixed: CanIfRxPduCanId=514, CanIfRxPduId=CANIF_RXPDU_CANIF_CAN0_Rx_0x202_Mixed, CanIfRxPduHrhIdRef=CANIF_CAN_CONTROLLER_0_ECU_CAN0_Rx_0x202_Mixed_FULL_HRH, CanIfRxPduRef=CANIF_CAN0_Rx_0x202_Mixed
        RX_PDU_CAN0_Rx_0x203_Cyclic_Counter: CanIfRxPduCanId=515, CanIfRxPduId=CANIF_RXPDU_CANIF_CAN0_Rx_0x203_Cyclic_Counter, CanIfRxPduHrhIdRef=CANIF_CAN_CONTROLLER_0_ECU_CAN0_Rx_0x203_Cyclic_Counter_FULL_HRH, CanIfRxPduRef=CANIF_CAN0_Rx_0x203_Cyclic_Counter
      CANIF_TXBUFFER_CAN_CONTROLLER_0_ECU_CAN0_Tx_0x360_E2E_P01 (CanIfBufferCfg): CanIfBufferSize=0, CanIfBufferHthRef=CANIF_CAN_CONTROLLER_0_ECU_CAN0_Tx_0x360_E2E_P01_FULL_HTH
      TX_PDU_CAN0_Tx_0x360_E2E_P01 (CanIfTxPduCfg):
        CanIfTxPduCanId = 864
        CanIfTxPduCanIdType = STANDARD_CAN
        CanIfTxPduId = CANIF_TXPDU_CANIF_CAN0_Tx_0x360_E2E_P01
        CanIfTxPduPnFilterPdu = false
        CanIfTxPduReadNotifyStatus = false
        CanIfTxPduTriggerTransmit = false
        CanIfTxPduTruncation = true
        CanIfTxPduType = STATIC
        CanIfTxPduUserTriggerTransmitName = PduR_CanIfTriggerTransmit
        CanIfTxPduUserTxConfirmationName = PduR_CanIfTxConfirmation
        CanIfTxPduUserTxConfirmationUL = PDUR
        CanIfTxPduBufferRef = CANIF_TXBUFFER_CAN_CONTROLLER_0_ECU_CAN0_Tx_0x360_E2E_P01
        CanIfTxPduRef = CANIF_CAN0_Tx_0x360_E2E_P01
      CANIF_TXBUFFER_CAN_CONTROLLER_0_ECU_CAN0_Tx_0x351_Cyclic_PN29 (CanIfBufferCfg): CanIfBufferSize=0, CanIfBufferHthRef=CANIF_CAN_CONTROLLER_0_ECU_CAN0_Tx_0x351_Cyclic_PN29_FULL_HTH
      TX_PDU_CAN0_Tx_0x351_Cyclic_PN29 (CanIfTxPduCfg):
        CanIfTxPduCanId = 849
        CanIfTxPduCanIdType = STANDARD_CAN
        CanIfTxPduId = CANIF_TXPDU_CANIF_CAN0_Tx_0x351_Cyclic_PN29
        CanIfTxPduPnFilterPdu = false
        CanIfTxPduReadNotifyStatus = false
        CanIfTxPduTriggerTransmit = false
        CanIfTxPduTruncation = true
        CanIfTxPduType = STATIC
        CanIfTxPduUserTriggerTransmitName = PduR_CanIfTriggerTransmit
        CanIfTxPduUserTxConfirmationName = PduR_CanIfTxConfirmation
        CanIfTxPduUserTxConfirmationUL = PDUR
        CanIfTxPduBufferRef = CANIF_TXBUFFER_CAN_CONTROLLER_0_ECU_CAN0_Tx_0x351_Cyclic_PN29
        CanIfTxPduRef = CANIF_CAN0_Tx_0x351_Cyclic_PN29
      CANIF_TXBUFFER_CAN_CONTROLLER_0_ECU_CAN0_Tx_0x350_Cyclic_PN17 (CanIfBufferCfg): CanIfBufferSize=0, CanIfBufferHthRef=CANIF_CAN_CONTROLLER_0_ECU_CAN0_Tx_0x350_Cyclic_PN17_FULL_HTH
      TX_PDU_CAN0_Tx_0x350_Cyclic_PN17 (CanIfTxPduCfg):
        CanIfTxPduCanId = 848
        CanIfTxPduCanIdType = STANDARD_CAN
        CanIfTxPduId = CANIF_TXPDU_CANIF_CAN0_Tx_0x350_Cyclic_PN17
        CanIfTxPduPnFilterPdu = false
        CanIfTxPduReadNotifyStatus = false
        CanIfTxPduTriggerTransmit = false
        CanIfTxPduTruncation = true
        CanIfTxPduType = STATIC
        CanIfTxPduUserTriggerTransmitName = PduR_CanIfTriggerTransmit
        CanIfTxPduUserTxConfirmationName = PduR_CanIfTxConfirmation
        CanIfTxPduUserTxConfirmationUL = PDUR
        CanIfTxPduBufferRef = CANIF_TXBUFFER_CAN_CONTROLLER_0_ECU_CAN0_Tx_0x350_Cyclic_PN17
        CanIfTxPduRef = CANIF_CAN0_Tx_0x350_Cyclic_PN17
      CANIF_TXBUFFER_CAN_CONTROLLER_0_ECU_CAN0_Tx_0x300_Cyclic (CanIfBufferCfg): CanIfBufferSize=0, CanIfBufferHthRef=CANIF_CAN_CONTROLLER_0_ECU_CAN0_Tx_0x300_Cyclic_FULL_HTH
      TX_PDU_CAN0_Tx_0x300_Cyclic (CanIfTxPduCfg):
        CanIfTxPduCanId = 768
        CanIfTxPduCanIdType = STANDARD_CAN
        CanIfTxPduId = CANIF_TXPDU_CANIF_CAN0_Tx_0x300_Cyclic
        CanIfTxPduPnFilterPdu = false
        CanIfTxPduReadNotifyStatus = false
        CanIfTxPduTriggerTransmit = false
        CanIfTxPduTruncation = true
        CanIfTxPduType = STATIC
        CanIfTxPduUserTriggerTransmitName = PduR_CanIfTriggerTransmit
        CanIfTxPduUserTxConfirmationName = PduR_CanIfTxConfirmation
        CanIfTxPduUserTxConfirmationUL = PDUR
        CanIfTxPduBufferRef = CANIF_TXBUFFER_CAN_CONTROLLER_0_ECU_CAN0_Tx_0x300_Cyclic
        CanIfTxPduRef = CANIF_CAN0_Tx_0x300_Cyclic
      CANIF_TXBUFFER_CAN_CONTROLLER_0_ECU_CAN0_Tx_0x301_Event (CanIfBufferCfg): CanIfBufferSize=0, CanIfBufferHthRef=CANIF_CAN_CONTROLLER_0_ECU_CAN0_Tx_0x301_Event_FULL_HTH
      TX_PDU_CAN0_Tx_0x301_Event (CanIfTxPduCfg):
        CanIfTxPduCanId = 769
        CanIfTxPduCanIdType = STANDARD_CAN
        CanIfTxPduId = CANIF_TXPDU_CANIF_CAN0_Tx_0x301_Event
        CanIfTxPduPnFilterPdu = false
        CanIfTxPduReadNotifyStatus = false
        CanIfTxPduTriggerTransmit = false
        CanIfTxPduTruncation = true
        CanIfTxPduType = STATIC
        CanIfTxPduUserTriggerTransmitName = PduR_CanIfTriggerTransmit
        CanIfTxPduUserTxConfirmationName = PduR_CanIfTxConfirmation
        CanIfTxPduUserTxConfirmationUL = PDUR
        CanIfTxPduBufferRef = CANIF_TXBUFFER_CAN_CONTROLLER_0_ECU_CAN0_Tx_0x301_Event
        CanIfTxPduRef = CANIF_CAN0_Tx_0x301_Event
      CANIF_TXBUFFER_CAN_CONTROLLER_0_ECU_CAN0_Tx_0x302_Mixed (CanIfBufferCfg): CanIfBufferSize=0, CanIfBufferHthRef=CANIF_CAN_CONTROLLER_0_ECU_CAN0_Tx_0x302_Mixed_FULL_HTH
      TX_PDU_CAN0_Tx_0x302_Mixed (CanIfTxPduCfg):
        CanIfTxPduCanId = 770
        CanIfTxPduCanIdType = STANDARD_CAN
        CanIfTxPduId = CANIF_TXPDU_CANIF_CAN0_Tx_0x302_Mixed
        CanIfTxPduPnFilterPdu = false
        CanIfTxPduReadNotifyStatus = false
        CanIfTxPduTriggerTransmit = false
        CanIfTxPduTruncation = true
        CanIfTxPduType = STATIC
        CanIfTxPduUserTriggerTransmitName = PduR_CanIfTriggerTransmit
        CanIfTxPduUserTxConfirmationName = PduR_CanIfTxConfirmation
        CanIfTxPduUserTxConfirmationUL = PDUR
        CanIfTxPduBufferRef = CANIF_TXBUFFER_CAN_CONTROLLER_0_ECU_CAN0_Tx_0x302_Mixed
        CanIfTxPduRef = CANIF_CAN0_Tx_0x302_Mixed
      CANIF_TXBUFFER_CAN_CONTROLLER_0_ECU_CAN0_Tx_0x303_Cyclic_Counter (CanIfBufferCfg): CanIfBufferSize=0, CanIfBufferHthRef=CANIF_CAN_CONTROLLER_0_ECU_CAN0_Tx_0x303_Cyclic_Counter_FULL_HTH
      TX_PDU_CAN0_Tx_0x303_Cyclic_Counter (CanIfTxPduCfg):
        CanIfTxPduCanId = 771
        CanIfTxPduCanIdType = STANDARD_CAN
        CanIfTxPduId = CANIF_TXPDU_CANIF_CAN0_Tx_0x303_Cyclic_Counter
        CanIfTxPduPnFilterPdu = false
        CanIfTxPduReadNotifyStatus = false
        CanIfTxPduTriggerTransmit = false
        CanIfTxPduTruncation = true
        CanIfTxPduType = STATIC
        CanIfTxPduUserTriggerTransmitName = PduR_CanIfTriggerTransmit
        CanIfTxPduUserTxConfirmationName = PduR_CanIfTxConfirmation
        CanIfTxPduUserTxConfirmationUL = PDUR
        CanIfTxPduBufferRef = CANIF_TXBUFFER_CAN_CONTROLLER_0_ECU_CAN0_Tx_0x303_Cyclic_Counter
        CanIfTxPduRef = CANIF_CAN0_Tx_0x303_Cyclic_Counter
      RX_PDU_CAN0_Rx_0x5xx_NM_ECU (CanIfRxPduCfg):
        CanIfRxPduCanId = 1280
        CanIfRxPduCanIdType = STANDARD_NO_FD_CAN
        CanIfRxPduDataLength = 8
        CanIfRxPduDataLengthCheck = true
        CanIfRxPduId = CANIF_RXPDU_CANIF_CAN0_Rx_0x5xx_NM_ECU
        CanIfRxPduReadData = false
        CanIfRxPduReadNotifyStatus = false
        CanIfRxPduUserRxIndicationName = CanNm_RxIndication
        CanIfRxPduUserRxIndicationUL = CAN_NM
        CanIfRxPduCanIdMask = 1792
        CanIfRxPduHrhIdRef = CANIF_CAN_CONTROLLER_0_ECU_CAN0_Rx_0x5xx_NM_ECU_FULL_HRH
        CanIfRxPduRef = CANIF_CAN0_Rx_0x5xx_NM_ECU
        CanIfRxPduCanIdRange: CanIfRxPduCanIdRangeLowerCanId=1280, CanIfRxPduCanIdRangeUpperCanId=1535
      CANIF_TXBUFFER_CAN_CONTROLLER_0_ECU_CAN0_Tx_0x501_NM_ECU (CanIfBufferCfg): CanIfBufferSize=0, CanIfBufferHthRef=CANIF_CAN_CONTROLLER_0_ECU_CAN0_Tx_0x501_NM_ECU_FULL_HTH
      TX_PDU_CAN0_Tx_0x501_NM_ECU (CanIfTxPduCfg):
        CanIfTxPduCanId = 1281
        CanIfTxPduCanIdType = STANDARD_CAN
        CanIfTxPduId = CANIF_TXPDU_CANIF_CAN0_Tx_0x501_NM_ECU
        CanIfTxPduPnFilterPdu = false
        CanIfTxPduReadNotifyStatus = false
        CanIfTxPduTriggerTransmit = false
        CanIfTxPduTruncation = true
        CanIfTxPduType = STATIC
        CanIfTxPduUserTriggerTransmitName = CanNm_TriggerTransmit
        CanIfTxPduUserTxConfirmationName = CanNm_TxConfirmation
        CanIfTxPduUserTxConfirmationUL = CAN_NM
        CanIfTxPduBufferRef = CANIF_TXBUFFER_CAN_CONTROLLER_0_ECU_CAN0_Tx_0x501_NM_ECU
        CanIfTxPduRef = CANIF_CAN0_Tx_0x501_NM_ECU
      CanIfRxPduCfg_CAN_Func_Rx (CanIfRxPduCfg):
        CanIfRxPduCanId = 2015
        CanIfRxPduCanIdType = STANDARD_NO_FD_CAN
        CanIfRxPduDataLength = 8
        CanIfRxPduDataLengthCheck = true
        CanIfRxPduId = CANIF_RXPDU_CAN_CanIf_Func_Rx
        CanIfRxPduReadData = false
        CanIfRxPduReadNotifyStatus = false
        CanIfRxPduUserRxIndicationName = CanTp_RxIndication
        CanIfRxPduUserRxIndicationUL = CAN_TP
        CanIfRxPduHrhIdRef = CanIfHrhCfg_CAN_Func
        CanIfRxPduRef = CAN_CanIf_Func_Rx
      CanIfRxPduCfg_CAN_Phys_Rx (CanIfRxPduCfg):
        CanIfRxPduCanId = 1800
        CanIfRxPduCanIdType = STANDARD_NO_FD_CAN
        CanIfRxPduDataLength = 8
        CanIfRxPduDataLengthCheck = true
        CanIfRxPduId = CANIF_RXPDU_CAN_CanIf_Phys_Rx
        CanIfRxPduReadData = false
        CanIfRxPduReadNotifyStatus = false
        CanIfRxPduUserRxIndicationName = CanTp_RxIndication
        CanIfRxPduUserRxIndicationUL = CAN_TP
        CanIfRxPduHrhIdRef = CanIfHrhCfg_CAN_Phys
        CanIfRxPduRef = CAN_CanIf_Phys_Rx
      CanIfTxPduCfg_CAN_USDT_Tx (CanIfTxPduCfg):
        CanIfTxPduCanId = 1801
        CanIfTxPduCanIdType = STANDARD_CAN
        CanIfTxPduId = CANIF_TXPDU_CAN_CanIf_USDT_Tx
        CanIfTxPduPnFilterPdu = false
        CanIfTxPduReadNotifyStatus = false
        CanIfTxPduTriggerTransmit = false
        CanIfTxPduTruncation = true
        CanIfTxPduType = STATIC
        CanIfTxPduUserTriggerTransmitName = CanTp_TriggerTransmit
        CanIfTxPduUserTxConfirmationName = CanTp_TxConfirmation
        CanIfTxPduUserTxConfirmationUL = CAN_TP
        CanIfTxPduBufferRef = CanIfBufferCfg_CAN_CanIf_USDT_Tx
        CanIfTxPduRef = CAN_CanIf_USDT_Tx
      CanIfBufferCfg_CAN_CanIf_USDT_Tx (CanIfBufferCfg): CanIfBufferSize=2, CanIfBufferHthRef=CanIfHthCfg_CAN_USDT
    CanIfPrivateCfg: CanIfPrivateDataLengthCheck=true, CanIfPrivateSoftwareFilterType=LINEAR, CanIfSupportTTCAN=false
    CanIfPublicCfg:
      CanIfConfigType = PC_CONFIG
      CanIfPublicCtrlDrvVersion = AUTOSAR431
      CanIfPublicTrcvPnEnable = false
      CanIfBusMirroringSupport = false
      CanIfDevErrorDetect = false
      CanIfMetaDataSupport = false
      CanIfPublicCancelTransmitSupport = false
      CanIfPublicHandleTypeEnum = UINT16
      CanIfPublicCanIdTypeEnum = UINT32
      CanIfPublicIcomSupport = false
      CanIfPublicMultipleDrvSupport = true
      CanIfPublicPnSupport = false
      CanIfPublicReadRxPduDataApi = false
      CanIfPublicReadRxPduNotifyStatusApi = false
      CanIfPublicReadTxPduNotifyStatusApi = false
      CanIfPublicSetDynamicTxIdApi = false
      CanIfPublicTxBuffering = true
      CanIfPublicTxConfirmPollingSupport = true
      CanIfPublicWakeupCheckValidByNM = false
      CanIfPublicWakeupCheckValidSupport = false
      CanIfSetBaudrateApi = false
      CanIfTriggerTransmitSupport = false
      CanIfTxOfflineActiveSupport = false
      CanIfVersionInfoApi = false
      CanIfWakeupSupport = true
