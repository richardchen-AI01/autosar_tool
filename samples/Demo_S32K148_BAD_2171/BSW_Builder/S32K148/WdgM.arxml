AUTOSAR XML (schema 00048)
package /S32K148
  module config WdgM
    WdgMGeneral: WdgMDevErrorDetect=true, WdgMImmediateReset=false, WdgMOffModeEnabled=true, WdgMVersionInfoApi=false
      WdgMWatchdog_0 (WdgMWatchdog): WdgMWatchdogName=WdgIfInternalDevice_0, WdgMWatchdogDeviceRef=WdgIfInternalDevice_0
      WdgMSupervisedEntity_0 (WdgMSupervisedEntity): WdgMSupervisedEntityId=0, WdgMInternalTransitionId=65535
        SE0_WdgMCheckpoint_0 (WdgMCheckpoint): WdgMCheckpointId=0
    WdgMConfigSet: WdgMInitialMode=WdgMMode_SlowMode
      WdgMMode_OffMode (WdgMMode): WdgMExpiredSupervisionCycleTol=0, WdgMModeId=0, WdgMSupervisionCycle=0.01
        WdgMTrigger: WdgMTriggerConditionValue=1, WdgMWatchdogMode=WDGIF_OFF_MODE, WdgMTriggerWatchdogRef=WdgMWatchdog_0
      WdgMMode_SlowMode (WdgMMode): WdgMExpiredSupervisionCycleTol=0, WdgMModeId=1, WdgMSupervisionCycle=0.01
        WdgMTrigger_0 (WdgMTrigger): WdgMTriggerConditionValue=800, WdgMWatchdogMode=WDGIF_SLOW_MODE, WdgMTriggerWatchdogRef=WdgMWatchdog_0
        WdgMAliveSupervision_0 (WdgMAliveSupervision):
          WdgMAliveSupervisionId = 0
          WdgMExpectedAliveIndications = 1
          WdgMMaxMargin = 0
          WdgMMinMargin = 0
          WdgMSupervisionReferenceCycle = 1
          WdgMAliveSupervisionCheckpointRef = SE0_WdgMCheckpoint_0
        WdgMLocalStatusParams_0 (WdgMLocalStatusParams): WdgMFailedAliveSupervisionRefCycleTol=0, WdgMLocalStatusSupervisedEntityRef=WdgMSupervisedEntity_0
    WdgMCombinationSet
