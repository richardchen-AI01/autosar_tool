AUTOSAR XML (schema 00048)
package /AUTOSAR/BswOverviews
  bsw module description Com: implemented-entrys=[Com_MainFunctionRx_ComMainFunctionRx, Com_MainFunctionTx_ComMainFunctionTx], module-id=50
    bsw internal behavior IB_Com
      exclusive area MultiCore_Lock
      exclusive area Context
      bsw schedulable entity SE_ComMainFunctionRx_ComMainFunctionRx: reentrancy-level=NON-REENTRANT, implemented-entry=Com_MainFunctionRx_ComMainFunctionRx
      bsw schedulable entity SE_ComMainFunctionTx_ComMainFunctionTx: reentrancy-level=NON-REENTRANT, implemented-entry=Com_MainFunctionTx_ComMainFunctionTx
      bsw timing event TE_ComMainFunctionRxComMainFunctionRx: starts-on-event=SE_ComMainFunctionRx_ComMainFunctionRx, period=0.005
      bsw timing event TE_ComMainFunctionTxComMainFunctionTx: starts-on-event=SE_ComMainFunctionTx_ComMainFunctionTx, period=0.005
package /AUTOSAR/BswInterfaces
  bsw module entry Com_MainFunctionRx_ComMainFunctionRx: service-id=24, is-reentrant=true, is-synchronous=true, call-type=SCHEDULED, execution-context=TASK, sw-service-impl-policy=STANDARD
  bsw module entry Com_MainFunctionTx_ComMainFunctionTx: service-id=25, is-reentrant=true, is-synchronous=true, call-type=SCHEDULED, execution-context=TASK, sw-service-impl-policy=STANDARD
package /AUTOSAR/BswImplementations
  bsw implementation Imp_Com: programming-language=C, sw-version=1.0.0, vendor-id=62, ar-release-version=4.5.0, behavior=IB_Com
    resource consumption RC_Com
      18 x memory section:
        VAR_CLEARED_BOOLEAN: sw-addrmethod=VAR_CLEARED
        VAR_CLEARED_8: sw-addrmethod=VAR_CLEARED
        VAR_CLEARED_16: sw-addrmethod=VAR_CLEARED
        VAR_CLEARED_32: sw-addrmethod=VAR_CLEARED
        VAR_CLEARED_64: sw-addrmethod=VAR_CLEARED
        VAR_CLEARED_UNSPECIFIED: sw-addrmethod=VAR_CLEARED
        VAR_INIT_BOOLEAN: sw-addrmethod=VAR_INIT
        VAR_INIT_8: sw-addrmethod=VAR_INIT
        VAR_INIT_PTR: sw-addrmethod=VAR_INIT
        CONFIG_DATA_BOOLEAN: sw-addrmethod=CONFIG_DATA
        CONFIG_DATA_8: sw-addrmethod=CONFIG_DATA
        CONFIG_DATA_16: sw-addrmethod=CONFIG_DATA
        CONFIG_DATA_32: sw-addrmethod=CONFIG_DATA
        CONFIG_DATA_64: sw-addrmethod=CONFIG_DATA
        CODE: sw-addrmethod=CODE
        CODE_FAST: sw-addrmethod=CODE
        CONFIG_DATA_UNSPECIFIED: sw-addrmethod=CONFIG_DATA
        CONFIG_DATA_PTR: sw-addrmethod=CONFIG_DATA
