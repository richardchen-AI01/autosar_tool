AUTOSAR XML (schema 00048)
package /AUTOSAR/BswOverviews
  bsw module description EcuM: implemented-entrys=EcuM_MainFunction
    bsw internal behavior IB_EcuM
      exclusive area GlobalClock
      exclusive area ShutdownSleep
      exclusive area WkEv
      bsw schedulable entity SE_EcuM_MainFunction: reentrancy-level=MULTICORE-REENTRANT, implemented-entry=EcuM_MainFunction
      bsw timing event TE_EcuM_MainFunction: starts-on-event=SE_EcuM_MainFunction, period=0.01
package /AUTOSAR/BswImplementations
  bsw implementation Imp_EcuM: programming-language=C, sw-version=2.2.0, vendor-id=62, ar-release-version=4.5.0, behavior=IB_EcuM
    resource consumption RC_EcuM
      11 x memory section:
        CALLOUT_CODE: sw-addrmethod=CALLOUT_CODE
        CODE_FAST: sw-addrmethod=CODE_FAST
        CODE: sw-addrmethod=CODE
        CONFIG_DATA_16: sw-addrmethod=CONFIG_DATA
        CONFIG_DATA_8: sw-addrmethod=CONFIG_DATA
        CONFIG_DATA_UNSPECIFIED: sw-addrmethod=CONFIG_DATA
        CONST_32: sw-addrmethod=CONST
        VAR_CLEARED_16: sw-addrmethod=VAR_CLEARED
        VAR_CLEARED_UNSPECIFIED: sw-addrmethod=VAR_CLEARED
        VAR_FAST_CLEARED_UNSPECIFIED: sw-addrmethod=VAR_FAST_CLEARED
        VAR_FAST_CLEARED_BOOLEAN: sw-addrmethod=VAR_FAST_CLEARED
package /AUTOSAR/BswInterfaces
  bsw module entry EcuM_MainFunction: is-reentrant=true, is-synchronous=true, call-type=SCHEDULED, execution-context=TASK, sw-service-impl-policy=STANDARD
