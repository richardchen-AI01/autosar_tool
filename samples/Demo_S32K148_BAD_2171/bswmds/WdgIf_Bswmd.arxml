AUTOSAR XML (schema 00048)
package /AUTOSAR/BswOverviews
  bsw module description WdgIf
    bsw internal behavior IB_WdgIf
      exclusive area Exclusive
package /AUTOSAR/BswImplementations
  bsw implementation Imp_WdgIf: programming-language=C, sw-version=2.2.0, vendor-id=62, ar-release-version=4.5.0, behavior=IB_WdgIf
    resource consumption RC_WdgIf
      memory section CODE: sw-addrmethod=CODE
      memory section CONFIG_DATA_UNSPECIFIED: sw-addrmethod=CONFIG_DATA
