AUTOSAR XML (schema 00048)
package /AUTOSAR_ComM/BswOverviews
  bsw module description ComM: module-id=12, category=BSW_MODULE, implemented-entrys=ComM_MainFunction_ComMCh_ECU
    bsw internal behavior InternalBehavior_ComM
      5 x exclusive area:
        UM
        Pnc
        Global
        Channel
        CommunicationInhibition
      bsw schedulable entity ComM_MainFunction_ComMCh_ECU: implemented-entry=ComM_MainFunction_ComMCh_ECU
      bsw timing event TimingEvent_ComM_MainFunction_ComMCh_ECU: starts-on-event=ComM_MainFunction_ComMCh_ECU, context-limitation=ComM_GLOBAL, period=0.01
package /AUTOSAR_ComM/BswImplementations
  bsw implementation Implementation_ComM: programming-language=C, sw-version=2.2.1, vendor-id=62, ar-release-version=4.9.0, behavior=InternalBehavior_ComM
    resource consumption ResourceConsumption_ComM
      14 x memory section:
        VAR_CLEARED_GLOBAL_UNSPECIFIED: alignment=UNSPECIFIED, sw-addrmethod=VAR_CLEARED
        VAR_CLEARED_UNSPECIFIED: alignment=UNSPECIFIED, sw-addrmethod=VAR_CLEARED
        VAR_CLEARED_PTR: alignment=PTR, sw-addrmethod=VAR_CLEARED
        VAR_CLEARED_32: alignment=32, sw-addrmethod=VAR_CLEARED
        VAR_CLEARED_16: alignment=16, sw-addrmethod=VAR_CLEARED
        VAR_CLEARED_8: alignment=8, sw-addrmethod=VAR_CLEARED
        VAR_CLEARED_BOOLEAN: alignment=BOOLEAN, sw-addrmethod=VAR_CLEARED
        CONFIG_DATA_UNSPECIFIED: alignment=UNSPECIFIED, sw-addrmethod=CONFIG_DATA
        CONFIG_DATA_PTR: alignment=PTR, sw-addrmethod=CONFIG_DATA
        CONFIG_DATA_32: alignment=32, sw-addrmethod=CONFIG_DATA
        CONFIG_DATA_16: alignment=16, sw-addrmethod=CONFIG_DATA
        CONFIG_DATA_8: alignment=8, sw-addrmethod=CONFIG_DATA
        CONFIG_DATA_BOOLEAN: alignment=BOOLEAN, sw-addrmethod=CONFIG_DATA
        CODE: sw-addrmethod=CODE
package /AUTOSAR_ComM/BswInterfaces
  bsw module entry ComM_MainFunction_ComMCh_ECU: call-type=SCHEDULED, execution-context=TASK, sw-service-impl-policy=STANDARD
