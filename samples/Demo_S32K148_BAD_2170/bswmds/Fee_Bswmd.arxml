AUTOSAR XML (schema 00048)
package /AUTOSAR/BswOverviews
  bsw module description Fee: implemented-entrys=Fee_MainFunction
    bsw internal behavior IB_Fee
      bsw schedulable entity SE_Fee_MainFunction: reentrancy-level=NON-REENTRANT, implemented-entry=Fee_MainFunction
      bsw timing event TE_Fee_MainFunction: category=Memory, starts-on-event=SE_Fee_MainFunction, period=0.005
      bsw distinguished partition Fee_EcucPartition
package /AUTOSAR/BswImplementations
  bsw implementation Imp_Fee: category=NO_CODE, programming-language=C, sw-version=2.0.2, vendor-id=62, ar-release-version=4.5.0, behavior=IB_Fee
package /AUTOSAR/BswInterfaces
  bsw module entry Fee_MainFunction: is-synchronous=true, call-type=SCHEDULED, execution-context=TASK, sw-service-impl-policy=STANDARD
