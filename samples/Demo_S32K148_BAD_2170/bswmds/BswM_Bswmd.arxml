AUTOSAR XML (schema 00048)
package /AUTOSAR/BswOverviews
  bsw module description BswM: implemented-entrys=BswM_MainFunction
    bsw internal behavior IB_BswM
      bsw schedulable entity SE_BswM_MainFunction: reentrancy-level=SINGLE-CORE-REENTRANT, implemented-entry=BswM_MainFunction
      bsw timing event TE_BswM_MainFunction_Core0_Par0: starts-on-event=SE_BswM_MainFunction, period=0.01
package /AUTOSAR/BswImplementations
  bsw implementation Imp_BswM: programming-language=C, sw-version=2.2.0, vendor-id=62, ar-release-version=4.5.0, behavior=IB_BswM
    resource consumption RC_BswM
      8 x memory section:
        CODE: sw-addrmethod=CODE
        CONFIG_DATA_UNSPECIFIED: sw-addrmethod=CONFIG_DATA
        CONST_PTR: sw-addrmethod=CONST
        CONST_UNSPECIFIED: sw-addrmethod=CONST
        VAR_CLEARED_UNSPECIFIED: sw-addrmethod=VAR_CLEARED
        VAR_CLONE_CLEARED_UNSPECIFIED: sw-addrmethod=VAR_CLONE
        VAR_INIT_UNSPECIFIED: sw-addrmethod=VAR_INIT
        VAR_FAST_CLEARED_UNSPECIFIED: sw-addrmethod=VAR_FAST_CLEARED
package /AUTOSAR/BswInterfaces
  bsw module entry BswM_MainFunction: service-id=3, is-reentrant=true, is-synchronous=true, call-type=SCHEDULED, execution-context=TASK, sw-service-impl-policy=STANDARD
