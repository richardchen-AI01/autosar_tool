AUTOSAR XML (schema 00048)
package /S32K148
  module config CanSM
    CanSMGeneral:
      CanSMDevErrorDetect = true
      CanSMMainFunctionTimePeriod = 0.001
      CanSMPncSupport = false
      CanSMSetBaudrateApi = false
      CanSMTxOfflineActiveSupport = false
      CanSMVersionInfoApi = false
      CanSMMultipleControllerSupport = false
    CanSMConfiguration: CanSMModeRequestRepetitionMax=10, CanSMModeRequestRepetitionTime=0.01
      CanSMManagerNetwork_ECU (CanSMManagerNetwork):
        CanSMBorCounterL1ToL2 = 10
        CanSMBorTimeL1 = 0.1
        CanSMBorTimeL2 = 1.0
        CanSMBorTimeTxEnsured = 1.0
        CanSMBorTxConfirmationPolling = false
        CanSMEnableBusOffDelay = false
        CanSMComMNetworkHandleRef = ComMCh_ECU
        CanSMController_0 (CanSMController): CanSMControllerId=CANIF_CAN_CONTROLLER_0_ECU_ECU
        CanSMDemEventParameterRefs: CANSM_E_BUS_OFF=EventParameter_0xC07388
