AUTOSAR XML (schema 00048)
package /S32K148
  module config iRte
    RteOsInteraction
      7 x RteUsedOsActivation:
        iSoft_Auto_RteUsedOsActivation_BTE_0: RteActivationOsTaskRef=iSoft_Auto_OsTask_10ms_BSW
        iSoft_Auto_RteUsedOsActivation_OsAlarm_0: RteExpectedActivationOffset=0.001, RteExpectedTickDuration=0.01, RteActivationOsAlarmRef=iSoft_Auto_OsAlarm_10ms_BSW
        iSoft_Auto_RteUsedOsActivation_BTE_1: RteActivationOsTaskRef=iSoft_Auto_OsTask_5ms_BSW
        iSoft_Auto_RteUsedOsActivation_OsAlarm_1: RteExpectedActivationOffset=0.001, RteExpectedTickDuration=0.005, RteActivationOsAlarmRef=iSoft_Auto_OsAlarm_5ms_BSW
        iSoft_Auto_RteUsedOsActivation_BTE_2: RteActivationOsTaskRef=iSoft_Auto_OsTask_1ms_BSW
        iSoft_Auto_RteUsedOsActivation_OsAlarm_2: RteExpectedActivationOffset=0.001, RteExpectedTickDuration=0.001, RteActivationOsAlarmRef=iSoft_Auto_OsAlarm_1ms_BSW
        iSoft_Auto_RteUsedOsActivation_SchM_0: RteActivationOsTaskRef=iSoft_Auto_OsTask_SchM_0
    18 x RteBswModuleInstance:
      iSoft_Auto_BswM_Imp_BswM: RteBswImplementationRef=Imp_BswM
        iSoft_Auto_SE_BswM_MainFunction_TE_BswM_MainFunction_Core0_Par0 (RteBswEventToTaskMapping):
          RteBswPositionInTask = 0
          RteBswEventRef = TE_BswM_MainFunction_Core0_Par0
          RteBswUsedOsAlarmRef = iSoft_Auto_OsAlarm_10ms_BSW
          RteBswMappedToTaskRef = iSoft_Auto_OsTask_10ms_BSW
          RteBswUsedOsEventRef = iSoft_Auto_OsEvent_10ms_BSW
      iSoft_Auto_CanTp_Imp_CanTp: RteBswImplementationRef=Imp_CanTp
        iSoft_Auto_ExclusiveArea (RteBswExclusiveAreaImpl): RteExclusiveAreaImplMechanism=ALL_INTERRUPT_BLOCKING, RteBswExclusiveAreaRef=ExclusiveArea
        6 x RteBswEventToTaskMapping, all with RteBswPositionInTask=0:
          iSoft_Auto_SE_CanTp_MainFunction_TE_CanTp_MainFunction: RteBswEventRef=TE_CanTp_MainFunction, RteBswUsedOsAlarmRef=iSoft_Auto_OsAlarm_5ms_BSW, RteBswMappedToTaskRef=iSoft_Auto_OsTask_5ms_BSW, RteBswUsedOsEventRef=iSoft_Auto_OsEvent_5ms_BSW
          iSoft_Auto_CE_CanTp_RxIndication_OIE_CanTp_RxIndication: RteBswEventRef=OIE_CanTp_RxIndication
          iSoft_Auto_CE_CanTp_TxConfirmation_OIE_CanTp_TxConfirmation: RteBswEventRef=OIE_CanTp_TxConfirmation
          iSoft_Auto_CE_CanTp_CancelReceive_OIE_CanTp_CancelReceive: RteBswEventRef=OIE_CanTp_CancelReceive
          iSoft_Auto_CE_CanTp_CancelTransmit_OIE_CanTp_CancelTransmit: RteBswEventRef=OIE_CanTp_CancelTransmit
          iSoft_Auto_CE_CanTp_Transmit_OIE_CanTp_Transmit: RteBswEventRef=OIE_CanTp_Transmit
      iSoft_Auto_Dcm_Imp_Dcm: RteBswImplementationRef=Imp_Dcm
        iSoft_Auto_ExclusiveArea (RteBswExclusiveAreaImpl): RteExclusiveAreaImplMechanism=ALL_INTERRUPT_BLOCKING, RteBswExclusiveAreaRef=ExclusiveArea
        iSoft_Auto_Dcm_MainFunction_TE_Dcm_MainFunction (RteBswEventToTaskMapping):
          RteBswPositionInTask = 1
          RteBswEventRef = TE_Dcm_MainFunction
          RteBswUsedOsAlarmRef = iSoft_Auto_OsAlarm_5ms_BSW
          RteBswMappedToTaskRef = iSoft_Auto_OsTask_5ms_BSW
          RteBswUsedOsEventRef = iSoft_Auto_OsEvent_5ms_BSW
      iSoft_Auto_Dem_Imp_Dem: RteBswImplementationRef=Imp_Dem
        iSoft_Auto_SE_Dem_MainFunction_TE_Dem_MainFunction (RteBswEventToTaskMapping):
          RteBswPositionInTask = 1
          RteBswEventRef = TE_Dem_MainFunction
          RteBswUsedOsAlarmRef = iSoft_Auto_OsAlarm_10ms_BSW
          RteBswMappedToTaskRef = iSoft_Auto_OsTask_10ms_BSW
          RteBswUsedOsEventRef = iSoft_Auto_OsEvent_10ms_BSW
        4 x RteBswExclusiveAreaImpl, all with RteExclusiveAreaImplMechanism=ALL_INTERRUPT_BLOCKING:
          iSoft_Auto_DEM_EXCLUSIVE_AREA_{0..3}: RteBswExclusiveAreaRef=DEM_EXCLUSIVE_AREA_{0..3}
      iSoft_Auto_Det_Imp_Det: RteBswImplementationRef=Imp_Det
        iSoft_Auto_DET_EXCLUSIVE_AREA_0 (RteBswExclusiveAreaImpl): RteExclusiveAreaImplMechanism=ALL_INTERRUPT_BLOCKING, RteBswExclusiveAreaRef=DET_EXCLUSIVE_AREA_0
        iSoft_Auto_DET_EXCLUSIVE_AREA_1 (RteBswExclusiveAreaImpl): RteExclusiveAreaImplMechanism=ALL_INTERRUPT_BLOCKING, RteBswExclusiveAreaRef=DET_EXCLUSIVE_AREA_1
      iSoft_Auto_EcuM_Imp_EcuM: RteBswImplementationRef=Imp_EcuM
        iSoft_Auto_WkEv (RteBswExclusiveAreaImpl): RteExclusiveAreaImplMechanism=ALL_INTERRUPT_BLOCKING, RteBswExclusiveAreaRef=WkEv
        iSoft_Auto_GlobalClock (RteBswExclusiveAreaImpl): RteExclusiveAreaImplMechanism=ALL_INTERRUPT_BLOCKING, RteBswExclusiveAreaRef=GlobalClock
        iSoft_Auto_SE_EcuM_MainFunction_TE_EcuM_MainFunction (RteBswEventToTaskMapping):
          RteBswPositionInTask = 2
          RteBswEventRef = TE_EcuM_MainFunction
          RteBswUsedOsAlarmRef = iSoft_Auto_OsAlarm_10ms_BSW
          RteBswMappedToTaskRef = iSoft_Auto_OsTask_10ms_BSW
          RteBswUsedOsEventRef = iSoft_Auto_OsEvent_10ms_BSW
        iSoft_Auto_ShutdownSleep (RteBswExclusiveAreaImpl): RteExclusiveAreaImplMechanism=ALL_INTERRUPT_BLOCKING, RteBswExclusiveAreaRef=ShutdownSleep
      iSoft_Auto_Fee_Imp_Fee: RteBswImplementationRef=Imp_Fee
        iSoft_Auto_SE_Fee_MainFunction_TE_Fee_MainFunction (RteBswEventToTaskMapping):
          RteBswPositionInTask = 2
          RteBswEventRef = TE_Fee_MainFunction
          RteBswUsedOsAlarmRef = iSoft_Auto_OsAlarm_5ms_BSW
          RteBswMappedToTaskRef = iSoft_Auto_OsTask_5ms_BSW
          RteBswUsedOsEventRef = iSoft_Auto_OsEvent_5ms_BSW
      iSoft_Auto_NvM_Imp_NvM: RteBswImplementationRef=Imp_NvM
        iSoft_Auto_Queue (RteBswExclusiveAreaImpl): RteExclusiveAreaImplMechanism=ALL_INTERRUPT_BLOCKING, RteBswExclusiveAreaRef=Queue
        iSoft_Auto_SE_NvM_MainFunction_TE_NvM_MainFunction (RteBswEventToTaskMapping):
          RteBswPositionInTask = 3
          RteBswEventRef = TE_NvM_MainFunction
          RteBswMappedToTaskRef = iSoft_Auto_OsTask_5ms_BSW
          RteBswUsedOsAlarmRef = iSoft_Auto_OsAlarm_5ms_BSW
          RteBswUsedOsEventRef = iSoft_Auto_OsEvent_5ms_BSW
      iSoft_Auto_PduR_Imp_PduR: RteBswImplementationRef=Imp_PduR
        iSoft_Auto_ExclusiveArea_Route (RteBswExclusiveAreaImpl): RteExclusiveAreaImplMechanism=ALL_INTERRUPT_BLOCKING, RteBswExclusiveAreaRef=ExclusiveArea_Route
        iSoft_Auto_ExclusiveArea_Init (RteBswExclusiveAreaImpl): RteExclusiveAreaImplMechanism=ALL_INTERRUPT_BLOCKING, RteBswExclusiveAreaRef=ExclusiveArea_Init
      iSoft_Auto_WdgM_Imp_WdgM: RteBswImplementationRef=Imp_WdgM
        iSoft_Auto_Exclusive (RteBswExclusiveAreaImpl): RteExclusiveAreaImplMechanism=ALL_INTERRUPT_BLOCKING, RteBswExclusiveAreaRef=Exclusive
        iSoft_Auto_SE_WdgM_MainFunction_TE_WdgM_MainFunction (RteBswEventToTaskMapping):
          RteBswPositionInTask = 3
          RteBswEventRef = TE_WdgM_MainFunction
          RteBswUsedOsAlarmRef = iSoft_Auto_OsAlarm_10ms_BSW
          RteBswMappedToTaskRef = iSoft_Auto_OsTask_10ms_BSW
          RteBswUsedOsEventRef = iSoft_Auto_OsEvent_10ms_BSW
      iSoft_Auto_CanNm_Imp_CanNm: RteBswImplementationRef=Imp_CanNm
        iSoft_Auto_CanNm_MainFunction_ComMCh_ECU_TimingEvent_CanNm_MainFunction_ComMCh_ECU (RteBswEventToTaskMapping):
          RteBswPositionInTask = 4
          RteBswEventRef = TimingEvent_CanNm_MainFunction_ComMCh_ECU
          RteBswUsedOsAlarmRef = iSoft_Auto_OsAlarm_5ms_BSW
          RteBswMappedToTaskRef = iSoft_Auto_OsTask_5ms_BSW
          RteBswUsedOsEventRef = iSoft_Auto_OsEvent_5ms_BSW
        iSoft_Auto_Context (RteBswExclusiveAreaImpl): RteExclusiveAreaImplMechanism=ALL_INTERRUPT_BLOCKING, RteBswExclusiveAreaRef=Context
      iSoft_Auto_CanSM_Imp_CanSM: RteBswImplementationRef=Imp_CanSM
        iSoft_Auto_CanSM_MainFunction_CanSMManagerNetwork_ECU_TimingEvent_CanSM_MainFunction_CanSMManagerNetwork_ECU (RteBswEventToTaskMapping):
          RteBswPositionInTask = 0
          RteBswEventRef = TimingEvent_CanSM_MainFunction_CanSMManagerNetwork_ECU
          RteBswUsedOsAlarmRef = iSoft_Auto_OsAlarm_1ms_BSW
          RteBswMappedToTaskRef = iSoft_Auto_OsTask_1ms_BSW
          RteBswUsedOsEventRef = iSoft_Auto_OsEvent_1ms_BSW
        iSoft_Auto_Context (RteBswExclusiveAreaImpl): RteExclusiveAreaImplMechanism=ALL_INTERRUPT_BLOCKING, RteBswExclusiveAreaRef=Context
      iSoft_Auto_Com_Imp_Com: RteBswImplementationRef=Imp_Com
        iSoft_Auto_SE_ComMainFunctionRx_ComMainFunctionRx_TE_ComMainFunctionRxComMainFunctionRx (RteBswEventToTaskMapping):
          RteBswPositionInTask = 5
          RteBswEventRef = TE_ComMainFunctionRxComMainFunctionRx
          RteBswUsedOsAlarmRef = iSoft_Auto_OsAlarm_5ms_BSW
          RteBswMappedToTaskRef = iSoft_Auto_OsTask_5ms_BSW
          RteBswUsedOsEventRef = iSoft_Auto_OsEvent_5ms_BSW
        iSoft_Auto_SE_ComMainFunctionTx_ComMainFunctionTx_TE_ComMainFunctionTxComMainFunctionTx (RteBswEventToTaskMapping):
          RteBswPositionInTask = 6
          RteBswEventRef = TE_ComMainFunctionTxComMainFunctionTx
          RteBswUsedOsAlarmRef = iSoft_Auto_OsAlarm_5ms_BSW
          RteBswMappedToTaskRef = iSoft_Auto_OsTask_5ms_BSW
          RteBswUsedOsEventRef = iSoft_Auto_OsEvent_5ms_BSW
        iSoft_Auto_MultiCore_Lock (RteBswExclusiveAreaImpl): RteExclusiveAreaImplMechanism=ALL_INTERRUPT_BLOCKING, RteBswExclusiveAreaRef=MultiCore_Lock
        iSoft_Auto_Context (RteBswExclusiveAreaImpl): RteExclusiveAreaImplMechanism=ALL_INTERRUPT_BLOCKING, RteBswExclusiveAreaRef=Context
      iSoft_Auto_ComM_Implementation_ComM: RteBswImplementationRef=Implementation_ComM
        iSoft_Auto_ComM_MainFunction_ComMCh_ECU_TimingEvent_ComM_MainFunction_ComMCh_ECU (RteBswEventToTaskMapping):
          RteBswPositionInTask = 4
          RteBswEventRef = TimingEvent_ComM_MainFunction_ComMCh_ECU
          RteBswUsedOsAlarmRef = iSoft_Auto_OsAlarm_10ms_BSW
          RteBswMappedToTaskRef = iSoft_Auto_OsTask_10ms_BSW
          RteBswUsedOsEventRef = iSoft_Auto_OsEvent_10ms_BSW
        5 x RteBswExclusiveAreaImpl, all with RteExclusiveAreaImplMechanism=ALL_INTERRUPT_BLOCKING:
          iSoft_Auto_UM: RteBswExclusiveAreaRef=UM
          iSoft_Auto_Pnc: RteBswExclusiveAreaRef=Pnc
          iSoft_Auto_Global: RteBswExclusiveAreaRef=Global
          iSoft_Auto_Channel: RteBswExclusiveAreaRef=Channel
          iSoft_Auto_CommunicationInhibition: RteBswExclusiveAreaRef=CommunicationInhibition
      iSoft_Auto_Nm_Imp_Nm: RteBswImplementationRef=Imp_Nm
        iSoft_Auto_Nm_MainFunction_ComMCh_ECU_TE_Nm_MainFunction_ComMCh_ECU (RteBswEventToTaskMapping):
          RteBswPositionInTask = 7
          RteBswEventRef = TE_Nm_MainFunction_ComMCh_ECU
          RteBswUsedOsAlarmRef = iSoft_Auto_OsAlarm_5ms_BSW
          RteBswMappedToTaskRef = iSoft_Auto_OsTask_5ms_BSW
          RteBswUsedOsEventRef = iSoft_Auto_OsEvent_5ms_BSW
        iSoft_Auto_Coordinator (RteBswExclusiveAreaImpl): RteExclusiveAreaImplMechanism=ALL_INTERRUPT_BLOCKING, RteBswExclusiveAreaRef=Coordinator
        iSoft_Auto_IRA (RteBswExclusiveAreaImpl): RteExclusiveAreaImplMechanism=ALL_INTERRUPT_BLOCKING, RteBswExclusiveAreaRef=IRA
      iSoft_Auto_SchM_Imp_SchM: RteBswImplementationRef=Imp_SchM
        iSoft_Auto_CE_SchM_Service_Function_Core0_BOIE_SchM_Service_Function_Core0 (RteBswEventToTaskMapping):
          RteBswPositionInTask = 0
          RteBswEventRef = BOIE_SchM_Service_Function_Core0
          RteBswMappedToTaskRef = iSoft_Auto_OsTask_SchM_0
          RteBswUsedOsEventRef = iSoft_Auto_OsEvent_Imp_SchM_BOIE_SchM_Service_Function_Core0
      iSoft_Auto_WdgIf_Imp_WdgIf: RteBswImplementationRef=Imp_WdgIf
        iSoft_Auto_Exclusive (RteBswExclusiveAreaImpl): RteExclusiveAreaImplMechanism=ALL_INTERRUPT_BLOCKING, RteBswExclusiveAreaRef=Exclusive
      iSoft_Auto_CanIf_Imp_CanIf: RteBswImplementationRef=Imp_CanIf
        iSoft_Auto_ExclusiveArea_Channel (RteBswExclusiveAreaImpl): RteExclusiveAreaImplMechanism=ALL_INTERRUPT_BLOCKING, RteBswExclusiveAreaRef=ExclusiveArea_Channel
