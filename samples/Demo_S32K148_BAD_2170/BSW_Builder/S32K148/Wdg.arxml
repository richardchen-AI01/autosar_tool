AUTOSAR XML (schema 00048)
package /S32K148
  module config Wdg: implementation-config-variant=VARIANT-POST-BUILD
    CommonPublishedInformation:
      ArReleaseMajorVersion = 4
      ArReleaseMinorVersion = 7
      ArReleaseRevisionVersion = 0
      ModuleId = 102
      SwMajorVersion = 2
      SwMinorVersion = 0
      SwPatchVersion = 0
      VendorApiInfix = Instance0
      VendorId = 43
    WdgClockReferencePoint_0 (WdgClockReferencePoint): WdgClockReference=McuClockReferencePoint_LPIT0_CLK
    WdgClockReferencePoint_1 (WdgClockReferencePoint): WdgClockReference=McuClockReferencePoint_FTM0_CLK
    WdgGeneral:
      WdgCallbackNotification = NULL_PTR
      WdgDevErrorDetect = 1
      WdgDisableAllowed = 0
      WdgEnableDirectService = 0
      WdgEnableMultiCoreSupport = 0
      WdgEnableUserModeSupport = 0
      WdgIndex = 0
      WdgInitialTimeout = 0.5
      WdgMaxTimeout = 1.0
      WdgOsifTimeoutVal = 3000
      WdgRunArea = ROM
      WdgTimeoutMethod = OSIF_COUNTER_DUMMY
      WdgVersionInfoApi = 1
      AutosarExt: WdgDisableDemReportErrorStatus=1
    WdgPublishedInformation: WdgTriggerMode=WDG_BOTH
    WdgSettingsConfig: WdgDefaultMode=WDGIF_SLOW_MODE, WdgInstance=WDOG, WdgInterruptContentEnable=1, WdgExternalTriggerCounterRef=GptChannelConfiguration_1
      WdgSettingsFast:
        WdgAllowUpdates = 1
        WdgClockSelection = SIRC_Clock
        WdgClockValue = 8000
        WdgOperationMode = Interrupt
        WdgPrescalerEnabled = 1
        WdgRunsInDebugMode = 0
        WdgRunsInStopMode = 0
        WdgRunsInWaitMode = 0
        WdgTimeoutPeriod = 0.02
        WdgWindowMode = 0
        WdgWindowPeriod = 0.0
        WdgClkSrcRef = WdgClockReferencePoint_1
      WdgSettingsOff: WdgAllowUpdates=1
      WdgSettingsSlow:
        WdgAllowUpdates = 1
        WdgClockSelection = SIRC_Clock
        WdgClockValue = 8000
        WdgOperationMode = Interrupt
        WdgPrescalerEnabled = 1
        WdgRunsInDebugMode = 0
        WdgRunsInStopMode = 0
        WdgRunsInWaitMode = 0
        WdgTimeoutPeriod = 0.5
        WdgWindowMode = 0
        WdgWindowPeriod = 0.0
        WdgClkSrcRef = WdgClockReferencePoint_1
