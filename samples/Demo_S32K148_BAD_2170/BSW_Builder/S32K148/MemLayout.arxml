AUTOSAR XML (schema 00048)
package /S32K148
  module config MemLayout
    5 x HwMemory:
      DSRAM_GLOBAL: Name=int_sram, MemoryType=RAM
      FLASH_GLOBAL: Name=int_flash, MemoryType=ROM
      DSRAM_CLONE: Name=int_sram, MemoryType=RAM
      DSRAM_CORE_0: Name=int_sram, MemoryType=RAM
      FLASH_CORE_0: Name=int_flash, MemoryType=ROM
    19 x SectionGroup, all with ReadAllow=true, Align=8, Block=8:
      DEFAULT_VAR_CLEARED: InitPolicy=CLEARED, Position=0, WriteAllow=true, ExecuteAllow=false, RunMemoryRef=DSRAM_GLOBAL
        7 x Section:
          VAR_CLEARED_64: Value=VAR_CLEARED.GLOBAL.*.64, Position=0
          VAR_CLEARED_UNSPECIFIED: Value=VAR_CLEARED.GLOBAL.*.UNSPECIFIED, Position=1
          VAR_CLEARED_PTR: Value=VAR_CLEARED.GLOBAL.*.PTR, Position=2
          VAR_CLEARED_32: Value=VAR_CLEARED.GLOBAL.*.32, Position=3
          VAR_CLEARED_16: Value=VAR_CLEARED.GLOBAL.*.16, Position=4
          VAR_CLEARED_8: Value=VAR_CLEARED.GLOBAL.*.8, Position=5
          VAR_CLEARED_BOOLEAN: Value=VAR_CLEARED.GLOBAL.*.BOOLEAN, Position=6
      DEFAULT_VAR_INIT: InitPolicy=INIT, Position=1, WriteAllow=true, ExecuteAllow=false, LoadMemoryRef=FLASH_GLOBAL, RunMemoryRef=DSRAM_GLOBAL
        7 x Section:
          VAR_INIT_64: Value=VAR_INIT.GLOBAL.*.64, Position=0
          VAR_INIT_UNSPECIFIED: Value=VAR_INIT.GLOBAL.*.UNSPECIFIED, Position=1
          VAR_INIT_PTR: Value=VAR_INIT.GLOBAL.*.PTR, Position=2
          VAR_INIT_32: Value=VAR_INIT.GLOBAL.*.32, Position=3
          VAR_INIT_16: Value=VAR_INIT.GLOBAL.*.16, Position=4
          VAR_INIT_8: Value=VAR_INIT.GLOBAL.*.8, Position=5
          VAR_INIT_BOOLEAN: Value=VAR_INIT.GLOBAL.*.BOOLEAN, Position=6
      DEFAULT_VAR_POWER_ON_CLEARED: InitPolicy=POWER-ON-CLEARED, Position=2, WriteAllow=true, ExecuteAllow=false, RunMemoryRef=DSRAM_GLOBAL
        7 x Section:
          VAR_POWER_ON_CLEARED_64: Value=VAR_POWER_ON_CLEARED.GLOBAL.*.64, Position=0
          VAR_POWER_ON_CLEARED_UNSPECIFIED: Value=VAR_POWER_ON_CLEARED.GLOBAL.*.UNSPECIFIED, Position=1
          VAR_POWER_ON_CLEARED_PTR: Value=VAR_POWER_ON_CLEARED.GLOBAL.*.PTR, Position=2
          VAR_POWER_ON_CLEARED_32: Value=VAR_POWER_ON_CLEARED.GLOBAL.*.32, Position=3
          VAR_POWER_ON_CLEARED_16: Value=VAR_POWER_ON_CLEARED.GLOBAL.*.16, Position=4
          VAR_POWER_ON_CLEARED_8: Value=VAR_POWER_ON_CLEARED.GLOBAL.*.8, Position=5
          VAR_POWER_ON_CLEARED_BOOLEAN: Value=VAR_POWER_ON_CLEARED.GLOBAL.*.BOOLEAN, Position=6
      DEFAULT_VAR_FAST_CLEARED: InitPolicy=CLEARED, Position=3, WriteAllow=true, ExecuteAllow=false, RunMemoryRef=DSRAM_GLOBAL
        7 x Section:
          VAR_FAST_CLEARED_64: Value=VAR_FAST_CLEARED.GLOBAL.*.64, Position=0
          VAR_FAST_CLEARED_UNSPECIFIED: Value=VAR_FAST_CLEARED.GLOBAL.*.UNSPECIFIED, Position=1
          VAR_FAST_CLEARED_PTR: Value=VAR_FAST_CLEARED.GLOBAL.*.PTR, Position=2
          VAR_FAST_CLEARED_32: Value=VAR_FAST_CLEARED.GLOBAL.*.32, Position=3
          VAR_FAST_CLEARED_16: Value=VAR_FAST_CLEARED.GLOBAL.*.16, Position=4
          VAR_FAST_CLEARED_8: Value=VAR_FAST_CLEARED.GLOBAL.*.8, Position=5
          VAR_FAST_CLEARED_BOOLEAN: Value=VAR_FAST_CLEARED.GLOBAL.*.BOOLEAN, Position=6
      DEFAULT_VAR_FAST_INIT: InitPolicy=INIT, Position=4, WriteAllow=true, ExecuteAllow=false, LoadMemoryRef=FLASH_GLOBAL, RunMemoryRef=DSRAM_GLOBAL
        7 x Section:
          VAR_FAST_INIT_64: Value=VAR_FAST_INIT.GLOBAL.*.64, Position=0
          VAR_FAST_INIT_UNSPECIFIED: Value=VAR_FAST_INIT.GLOBAL.*.UNSPECIFIED, Position=1
          VAR_FAST_INIT_PTR: Value=VAR_FAST_INIT.GLOBAL.*.PTR, Position=2
          VAR_FAST_INIT_32: Value=VAR_FAST_INIT.GLOBAL.*.32, Position=3
          VAR_FAST_INIT_16: Value=VAR_FAST_INIT.GLOBAL.*.16, Position=4
          VAR_FAST_INIT_8: Value=VAR_FAST_INIT.GLOBAL.*.8, Position=5
          VAR_FAST_INIT_BOOLEAN: Value=VAR_FAST_INIT.GLOBAL.*.BOOLEAN, Position=6
      DEFAULT_VAR_FAST_POWER_ON_CLEARED: InitPolicy=POWER-ON-CLEARED, Position=5, WriteAllow=true, ExecuteAllow=false, RunMemoryRef=DSRAM_GLOBAL
        7 x Section:
          VAR_FAST_POWER_ON_CLEARED_64: Value=VAR_FAST_POWER_ON_CLEARED.GLOBAL.*.64, Position=0
          VAR_FAST_POWER_ON_CLEARED_UNSPECIFIED: Value=VAR_FAST_POWER_ON_CLEARED.GLOBAL.*.UNSPECIFIED, Position=1
          VAR_FAST_POWER_ON_CLEARED_PTR: Value=VAR_FAST_POWER_ON_CLEARED.GLOBAL.*.PTR, Position=2
          VAR_FAST_POWER_ON_CLEARED_32: Value=VAR_FAST_POWER_ON_CLEARED.GLOBAL.*.32, Position=3
          VAR_FAST_POWER_ON_CLEARED_16: Value=VAR_FAST_POWER_ON_CLEARED.GLOBAL.*.16, Position=4
          VAR_FAST_POWER_ON_CLEARED_8: Value=VAR_FAST_POWER_ON_CLEARED.GLOBAL.*.8, Position=5
          VAR_FAST_POWER_ON_CLEARED_BOOLEAN: Value=VAR_FAST_POWER_ON_CLEARED.GLOBAL.*.BOOLEAN, Position=6
      DEFAULT_VAR_CLONE: InitPolicy=CLEARED, Position=6, WriteAllow=true, ExecuteAllow=false, RunMemoryRef=DSRAM_CLONE
        7 x Section:
          VAR_CLONE_64: Value=VAR_CLONE.GLOBAL.*.64, Position=0
          VAR_CLONE_UNSPECIFIED: Value=VAR_CLONE.GLOBAL.*.UNSPECIFIED, Position=1
          VAR_CLONE_PTR: Value=VAR_CLONE.GLOBAL.*.PTR, Position=2
          VAR_CLONE_32: Value=VAR_CLONE.GLOBAL.*.32, Position=3
          VAR_CLONE_16: Value=VAR_CLONE.GLOBAL.*.16, Position=4
          VAR_CLONE_8: Value=VAR_CLONE.GLOBAL.*.8, Position=5
          VAR_CLONE_BOOLEAN: Value=VAR_CLONE.GLOBAL.*.BOOLEAN, Position=6
      DEFAULT_INTERNAL_VAR_CLEARED: InitPolicy=CLEARED, Position=7, WriteAllow=true, ExecuteAllow=false, RunMemoryRef=DSRAM_GLOBAL
        7 x Section:
          INTERNAL_VAR_CLEARED_64: Value=INTERNAL_VAR_CLEARED.GLOBAL.*.64, Position=0
          INTERNAL_VAR_CLEARED_UNSPECIFIED: Value=INTERNAL_VAR_CLEARED.GLOBAL.*.UNSPECIFIED, Position=1
          INTERNAL_VAR_CLEARED_PTR: Value=INTERNAL_VAR_CLEARED.GLOBAL.*.PTR, Position=2
          INTERNAL_VAR_CLEARED_32: Value=INTERNAL_VAR_CLEARED.GLOBAL.*.32, Position=3
          INTERNAL_VAR_CLEARED_16: Value=INTERNAL_VAR_CLEARED.GLOBAL.*.16, Position=4
          INTERNAL_VAR_CLEARED_8: Value=INTERNAL_VAR_CLEARED.GLOBAL.*.8, Position=5
          INTERNAL_VAR_CLEARED_BOOLEAN: Value=INTERNAL_VAR_CLEARED.GLOBAL.*.BOOLEAN, Position=6
      DEFAULT_INTERNAL_VAR_INIT: InitPolicy=INIT, Position=8, WriteAllow=true, ExecuteAllow=false, LoadMemoryRef=FLASH_GLOBAL, RunMemoryRef=DSRAM_GLOBAL
        7 x Section:
          INTERNAL_VAR_INIT_64: Value=INTERNAL_VAR_INIT.GLOBAL.*.64, Position=0
          INTERNAL_VAR_INIT_UNSPECIFIED: Value=INTERNAL_VAR_INIT.GLOBAL.*.UNSPECIFIED, Position=1
          INTERNAL_VAR_INIT_PTR: Value=INTERNAL_VAR_INIT.GLOBAL.*.PTR, Position=2
          INTERNAL_VAR_INIT_32: Value=INTERNAL_VAR_INIT.GLOBAL.*.32, Position=3
          INTERNAL_VAR_INIT_16: Value=INTERNAL_VAR_INIT.GLOBAL.*.16, Position=4
          INTERNAL_VAR_INIT_8: Value=INTERNAL_VAR_INIT.GLOBAL.*.8, Position=5
          INTERNAL_VAR_INIT_BOOLEAN: Value=INTERNAL_VAR_INIT.GLOBAL.*.BOOLEAN, Position=6
      DEFAULT_INTERNAL_VAR_POWER_ON_CLEARED: InitPolicy=POWER-ON-CLEARED, Position=9, WriteAllow=true, ExecuteAllow=false, RunMemoryRef=DSRAM_GLOBAL
        7 x Section:
          INTERNAL_VAR_POWER_ON_CLEARED_64: Value=INTERNAL_VAR_POWER_ON_CLEARED.GLOBAL.*.64, Position=0
          INTERNAL_VAR_POWER_ON_CLEARED_UNSPECIFIED: Value=INTERNAL_VAR_POWER_ON_CLEARED.GLOBAL.*.UNSPECIFIED, Position=1
          INTERNAL_VAR_POWER_ON_CLEARED_PTR: Value=INTERNAL_VAR_POWER_ON_CLEARED.GLOBAL.*.PTR, Position=2
          INTERNAL_VAR_POWER_ON_CLEARED_32: Value=INTERNAL_VAR_POWER_ON_CLEARED.GLOBAL.*.32, Position=3
          INTERNAL_VAR_POWER_ON_CLEARED_16: Value=INTERNAL_VAR_POWER_ON_CLEARED.GLOBAL.*.16, Position=4
          INTERNAL_VAR_POWER_ON_CLEARED_8: Value=INTERNAL_VAR_POWER_ON_CLEARED.GLOBAL.*.8, Position=5
          INTERNAL_VAR_POWER_ON_CLEARED_BOOLEAN: Value=INTERNAL_VAR_POWER_ON_CLEARED.GLOBAL.*.BOOLEAN, Position=6
      DEFAULT_VAR_SAVED_ZONE: InitPolicy=POWER-ON-CLEARED, Position=10, WriteAllow=true, ExecuteAllow=false, RunMemoryRef=DSRAM_GLOBAL
        7 x Section:
          VAR_SAVED_ZONE_64: Value=VAR_SAVED_ZONE.GLOBAL.*.64, Position=0
          VAR_SAVED_ZONE_UNSPECIFIED: Value=VAR_SAVED_ZONE.GLOBAL.*.UNSPECIFIED, Position=1
          VAR_SAVED_ZONE_PTR: Value=VAR_SAVED_ZONE.GLOBAL.*.PTR, Position=2
          VAR_SAVED_ZONE_32: Value=VAR_SAVED_ZONE.GLOBAL.*.32, Position=3
          VAR_SAVED_ZONE_16: Value=VAR_SAVED_ZONE.GLOBAL.*.16, Position=4
          VAR_SAVED_ZONE_8: Value=VAR_SAVED_ZONE.GLOBAL.*.8, Position=5
          VAR_SAVED_ZONE_BOOLEAN: Value=VAR_SAVED_ZONE.GLOBAL.*.BOOLEAN, Position=6
      DEFAULT_CONST: InitPolicy=NONE, Position=11, WriteAllow=false, ExecuteAllow=false, RunMemoryRef=FLASH_GLOBAL
        7 x Section:
          CONST_64: Value=CONST.GLOBAL.*.64, Position=0
          CONST_UNSPECIFIED: Value=CONST.GLOBAL.*.UNSPECIFIED, Position=1
          CONST_PTR: Value=CONST.GLOBAL.*.PTR, Position=2
          CONST_32: Value=CONST.GLOBAL.*.32, Position=3
          CONST_16: Value=CONST.GLOBAL.*.16, Position=4
          CONST_8: Value=CONST.GLOBAL.*.8, Position=5
          CONST_BOOLEAN: Value=CONST.GLOBAL.*.BOOLEAN, Position=6
      DEFAULT_CONFIG_DATA: InitPolicy=NONE, Position=12, WriteAllow=false, ExecuteAllow=false, RunMemoryRef=FLASH_GLOBAL
        7 x Section:
          CONFIG_DATA_64: Value=CONFIG_DATA.GLOBAL.*.64, Position=0
          CONFIG_DATA_UNSPECIFIED: Value=CONFIG_DATA.GLOBAL.*.UNSPECIFIED, Position=1
          CONFIG_DATA_PTR: Value=CONFIG_DATA.GLOBAL.*.PTR, Position=2
          CONFIG_DATA_32: Value=CONFIG_DATA.GLOBAL.*.32, Position=3
          CONFIG_DATA_16: Value=CONFIG_DATA.GLOBAL.*.16, Position=4
          CONFIG_DATA_8: Value=CONFIG_DATA.GLOBAL.*.8, Position=5
          CONFIG_DATA_BOOLEAN: Value=CONFIG_DATA.GLOBAL.*.BOOLEAN, Position=6
      DEFAULT_CALIB: InitPolicy=NONE, Position=13, WriteAllow=false, ExecuteAllow=false, RunMemoryRef=FLASH_GLOBAL
        7 x Section:
          CALIB_64: Value=CALIB.GLOBAL.*.64, Position=0
          CALIB_UNSPECIFIED: Value=CALIB.GLOBAL.*.UNSPECIFIED, Position=1
          CALIB_PTR: Value=CALIB.GLOBAL.*.PTR, Position=2
          CALIB_32: Value=CALIB.GLOBAL.*.32, Position=3
          CALIB_16: Value=CALIB.GLOBAL.*.16, Position=4
          CALIB_8: Value=CALIB.GLOBAL.*.8, Position=5
          CALIB_BOOLEAN: Value=CALIB.GLOBAL.*.BOOLEAN, Position=6
      DEFAULT_CODE: InitPolicy=NONE, Position=14, WriteAllow=false, ExecuteAllow=true, RunMemoryRef=FLASH_GLOBAL
        7 x Section:
          CODE_64: Value=CODE.GLOBAL.*.64, Position=0
          CODE_UNSPECIFIED: Value=CODE.GLOBAL.*.UNSPECIFIED, Position=1
          CODE_PTR: Value=CODE.GLOBAL.*.PTR, Position=2
          CODE_32: Value=CODE.GLOBAL.*.32, Position=3
          CODE_16: Value=CODE.GLOBAL.*.16, Position=4
          CODE_8: Value=CODE.GLOBAL.*.8, Position=5
          CODE_BOOLEAN: Value=CODE.GLOBAL.*.BOOLEAN, Position=6
      DEFAULT_CODE_FAST: InitPolicy=NONE, Position=15, WriteAllow=false, ExecuteAllow=true, RunMemoryRef=FLASH_GLOBAL
        7 x Section:
          CODE_FAST_64: Value=CODE_FAST.GLOBAL.*.64, Position=0
          CODE_FAST_UNSPECIFIED: Value=CODE_FAST.GLOBAL.*.UNSPECIFIED, Position=1
          CODE_FAST_PTR: Value=CODE_FAST.GLOBAL.*.PTR, Position=2
          CODE_FAST_32: Value=CODE_FAST.GLOBAL.*.32, Position=3
          CODE_FAST_16: Value=CODE_FAST.GLOBAL.*.16, Position=4
          CODE_FAST_8: Value=CODE_FAST.GLOBAL.*.8, Position=5
          CODE_FAST_BOOLEAN: Value=CODE_FAST.GLOBAL.*.BOOLEAN, Position=6
      DEFAULT_CALLOUT_CODE: InitPolicy=NONE, Position=16, WriteAllow=false, ExecuteAllow=true, RunMemoryRef=FLASH_GLOBAL
        7 x Section:
          CALLOUT_CODE_64: Value=CALLOUT_CODE.GLOBAL.*.64, Position=0
          CALLOUT_CODE_UNSPECIFIED: Value=CALLOUT_CODE.GLOBAL.*.UNSPECIFIED, Position=1
          CALLOUT_CODE_PTR: Value=CALLOUT_CODE.GLOBAL.*.PTR, Position=2
          CALLOUT_CODE_32: Value=CALLOUT_CODE.GLOBAL.*.32, Position=3
          CALLOUT_CODE_16: Value=CALLOUT_CODE.GLOBAL.*.16, Position=4
          CALLOUT_CODE_8: Value=CALLOUT_CODE.GLOBAL.*.8, Position=5
          CALLOUT_CODE_BOOLEAN: Value=CALLOUT_CODE.GLOBAL.*.BOOLEAN, Position=6
      VAR_INIT_CORE0: InitPolicy=INIT, Position=17, WriteAllow=true, ExecuteAllow=false, InitCore=0, RunMemoryRef=DSRAM_CORE_0, LoadMemoryRef=FLASH_GLOBAL
        7 x Section:
          VAR_INIT_CORE0_64: Value=VAR_INIT.CORE0.*.64, Position=0
          VAR_INIT_CORE0_UNSPECIFIED: Value=VAR_INIT.CORE0.*.UNSPECIFIED, Position=1
          VAR_INIT_CORE0_PTR: Value=VAR_INIT.CORE0.*.PTR, Position=2
          VAR_INIT_CORE0_32: Value=VAR_INIT.CORE0.*.32, Position=3
          VAR_INIT_CORE0_16: Value=VAR_INIT.CORE0.*.16, Position=4
          VAR_INIT_CORE0_8: Value=VAR_INIT.CORE0.*.8, Position=5
          VAR_INIT_CORE0_BOOLEAN: Value=VAR_INIT.CORE0.*.BOOLEAN, Position=6
      VAR_CLEARED_CORE0: InitPolicy=CLEARED, Position=18, WriteAllow=true, ExecuteAllow=false, InitCore=0, RunMemoryRef=DSRAM_CORE_0
        7 x Section:
          VAR_CLEARED_CORE0_64: Value=VAR_CLEARED.CORE0.*.64, Position=0
          VAR_CLEARED_CORE0_UNSPECIFIED: Value=VAR_CLEARED.CORE0.*.UNSPECIFIED, Position=1
          VAR_CLEARED_CORE0_PTR: Value=VAR_CLEARED.CORE0.*.PTR, Position=2
          VAR_CLEARED_CORE0_32: Value=VAR_CLEARED.CORE0.*.32, Position=3
          VAR_CLEARED_CORE0_16: Value=VAR_CLEARED.CORE0.*.16, Position=4
          VAR_CLEARED_CORE0_8: Value=VAR_CLEARED.CORE0.*.8, Position=5
          VAR_CLEARED_CORE0_BOOLEAN: Value=VAR_CLEARED.CORE0.*.BOOLEAN, Position=6
