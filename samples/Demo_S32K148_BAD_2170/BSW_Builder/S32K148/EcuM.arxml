AUTOSAR XML (schema 00048)
package /S32K148
  module config EcuM
    EcuMGeneral: EcuMDevErrorDetect=true, EcuMMainFunctionPeriod=0.01, EcuMVersionInfoApi=false, EcuMCloneVariableSupport=false
    EcuMConfiguration
      EcuMCommonConfiguration: EcuMConfigConsistencyHash=666, EcuMOSResource=OsUseResScheduler, EcuMIgnoreWakeupEvValOffPreOS=false, EcuMDefaultAppMode=OSDEFAULTAPPMODE
        EcuMDefaultShutdownTarget: EcuMDefaultShutdownTarget=EcuMShutdownTargetOff
        EcuMSleepMode:
          EcuMSleepModeId = 0
          EcuMSleepModeSuspend = true
          EcuMWakeupSourceMask = EcuMWakeupSource_CAN
          EcuMSleepModeMcuModeRef = McuModeSettingConf_0
          EcuMWakeupSourceMask = EcuMWakeupSource_Local
        EcuMWakeupSource_CAN (EcuMWakeupSource): EcuMCheckWakeupTimeout=0.0, EcuMValidationTimeout=3.0, EcuMWakeupSourceId=5, EcuMWakeupSourcePolling=false, EcuMComMChannelRef=ComMCh_ECU
        EcuMDriverInitListOne
          5 x EcuMDriverInitItem, all with EcuMModuleParameter=POSTBUILD_PTR:
            Mcu: EcuMModuleService=Mcu_Init, EditModuleService=false, EcuMModulePbConfigName=Mcu_Config, EditPbConfigName=false, IncludeHeaderFile=Mcu.h, EditHeaderFile=false, EcuMModuleRef=Mcu
            Port: EcuMModuleService=Port_Init, EditModuleService=false, EcuMModulePbConfigName=Port_Config, EditPbConfigName=false, IncludeHeaderFile=Port.h, EditHeaderFile=false, EcuMModuleRef=Port
            Gpt: EcuMModuleService=Gpt_Init, EditModuleService=false, EcuMModulePbConfigName=Gpt_Config, EditPbConfigName=false, IncludeHeaderFile=Gpt.h, EditHeaderFile=false, EcuMModuleRef=Gpt
            Can: EcuMModuleService=Can_43_FLEXCAN_Init, EditModuleService=true, EcuMModulePbConfigName=Can_43_FLEXCAN_Config, EditPbConfigName=true, IncludeHeaderFile=Can_43_FLEXCAN.h, EditHeaderFile=true, EcuMModuleRef=Can
            Wdg: EcuMModuleService=Wdg_43_Instance0_Init, EditModuleService=true, EcuMModulePbConfigName=Wdg_Config_0, EditPbConfigName=true, IncludeHeaderFile=Wdg_43_Instance0.h, EditHeaderFile=true, EcuMModuleRef=Wdg
        EcuMDriverInitListZero
          Det (EcuMDriverInitItem):
            EcuMModuleParameter = NULL_PTR
            EcuMModuleService = Det_Init
            EditModuleService = false
            EcuMModulePbConfigName = NULL_PTR
            EditPbConfigName = false
            IncludeHeaderFile = Det.h
            EditHeaderFile = false
            EcuMModuleRef = Det
          Dem_PreInit (EcuMDriverInitItem):
            EcuMModuleParameter = POSTBUILD_PTR
            EcuMModuleService = Dem_PreInit
            EditModuleService = true
            EcuMModulePbConfigName = Dem_Config
            EditPbConfigName = false
            IncludeHeaderFile = Dem.h
            EditHeaderFile = false
            EcuMModuleRef = Dem
        EcuMWakeupSource_Local (EcuMWakeupSource): EcuMCheckWakeupTimeout=0.0, EcuMValidationTimeout=3.0, EcuMWakeupSourceId=6, EcuMWakeupSourcePolling=false, EcuMComMChannelRef=ComMCh_ECU
      EcuMFlexConfiguration: EcuMTimerSrcSelect=OS, EcuMNormalMcuModeRef=McuModeSettingConf_0
        EcuMFlexUserConfig: EcuMFlexUser=0
        EcuMResetMode: EcuMResetModeId=0
        ECUM_CAUSE_UNKNOWN (EcuMShutdownCause): EcuMShutdownCauseId=0
        EcuMDriverInitListBswM_0 (EcuMDriverInitListBswM)
          10 x EcuMDriverInitItem, all with EcuMModuleParameter=POSTBUILD_PTR, EditModuleService=false, EditHeaderFile=false:
            CanIf: EcuMModuleService=CanIf_Init, EcuMModulePbConfigName=CanIf_Config, EditPbConfigName=false, IncludeHeaderFile=CanIf.h, EcuMModuleRef=CanIf
            CanSM: EcuMModuleService=CanSM_Init, EcuMModulePbConfigName=CanSM_Config, EditPbConfigName=false, IncludeHeaderFile=CanSM.h, EcuMModuleRef=CanSM
            PduR: EcuMModuleService=PduR_Init, EcuMModulePbConfigName=PduR_Config, EditPbConfigName=false, IncludeHeaderFile=PduR.h, EcuMModuleRef=PduR
            Com: EcuMModuleService=Com_Init, EcuMModulePbConfigName=Com_Config, EditPbConfigName=false, IncludeHeaderFile=Com.h, EcuMModuleRef=Com
            ComM: EcuMModuleService=ComM_Init, EcuMModulePbConfigName=ComM_Config, EditPbConfigName=false, IncludeHeaderFile=ComM.h, EcuMModuleRef=ComM
            CanTP: EcuMModuleService=CanTp_Init, EcuMModulePbConfigName=CanTp_Config, EditPbConfigName=false, IncludeHeaderFile=CanTp.h, EcuMModuleRef=CanTp
            Nm: EcuMModuleService=Nm_Init, EcuMModulePbConfigName=Nm_Config, EditPbConfigName=false, IncludeHeaderFile=Nm.h, EcuMModuleRef=Nm
            CanNm: EcuMModuleService=CanNm_Init, EcuMModulePbConfigName=CanNm_Config, EditPbConfigName=false, IncludeHeaderFile=CanNm.h, EcuMModuleRef=CanNm
            xfrm: EcuMModuleService=Xfrm_Init, EcuMModulePbConfigName=Xfrm_Config, EditPbConfigName=false, IncludeHeaderFile=Xfrm.h, EcuMModuleRef=Xfrm
            WdgM: EcuMModuleService=WdgM_Init, EcuMModulePbConfigName=WdgM_Config_Core0, EditPbConfigName=true, IncludeHeaderFile=WdgM.h, EcuMModuleRef=WdgM
        EcuMGoDownAllowedUsers: EcuMGoDownAllowedUserRef=EcuMFlexUserConfig
        3 x EcuMShutdownCause:
          ECUM_CAUSE_ECU_STATE: EcuMShutdownCauseId=1
          ECUM_CAUSE_WDGM: EcuMShutdownCauseId=2
          ECUM_CAUSE_DCM: EcuMShutdownCauseId=3
    EcuMFlexGeneral: EcuMAlarmClockPresent=false, EcuMModeHandling=true, EcuMResetLoopDetection=false, EcuMSetProgrammableInterrupts=false
