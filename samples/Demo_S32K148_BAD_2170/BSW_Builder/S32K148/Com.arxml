AUTOSAR XML (schema 00048)
package /S32K148
  module config Com
    ComGeneral:
      ComCancellationSupport = true
      ComConfigurationUseDet = false
      ComVersionInfoApi = false
      ComEnableMDTForCyclicTransmission = true
      ComEnableSignalGroupArrayApi = false
      ComMetaDataSupport = false
      ComRetryFailedTransmitRequests = false
      ComSupportedIPduGroups = 6
      ComConfigType = PC_CONFIG
    ComConfig
      Com_RxPduGroup_CAN_CONTROLLER_0_ECU_ECU (ComIPduGroup): ComIPduGroupHandleId=Com_RxPduGroup_CAN_CONTROLLER_0_ECU_ECU
      Com_TxPduGroup_CAN_CONTROLLER_0_ECU_ECU (ComIPduGroup): ComIPduGroupHandleId=Com_TxPduGroup_CAN_CONTROLLER_0_ECU_ECU
      ComMainFunctionRx: ComMainRxTimeBase=0.005
      CAN0_Rx_0x260_E2E_P01 (ComIPdu):
        ComIPduCancellationSupport = false
        ComIPduDirection = RECEIVE
        ComIPduHandleId = COM_RXPDU_COM_CAN0_Rx_0x260_E2E_P01
        ComIPduSignalProcessing = DEFERRED
        ComIPduType = NORMAL
        ComIPduCallout = E2E_Rx_0x260_P01_0x1234_IpduCallOut
        ComPduIdRef = COM_CAN0_Rx_0x260_E2E_P01
        ComIPduSignalGroupRef = Rx_0x260_E2E_P01_CAN0_Rx_0x260_E2E_P01
        ComIPduGroupRef = Com_RxPduGroup_CAN_CONTROLLER_0_ECU_ECU
      Rx_0x260_E2E_P01_CAN0_Rx_0x260_E2E_P01 (ComSignalGroup):
        ComHandleId = ComConf_ComSignalGroup_Rx_0x260_E2E_P01_CAN0_Rx_0x260_E2E_P01
        ComInvalidNotification = NULL_PTR
        ComRxDataTimeoutAction = NONE
        ComTransferProperty = PENDING
        ComTimeout = 0.0
        ComFirstTimeout = 0.0
        ComNotification = Rte_COMCbk
        10 x ComGroupSignal, all with ComSignalEndianness=BIG_ENDIAN, ComSignalInitValue=0x0, ComSignalLength=0:
          CAN0_Rx_0x260_Sig_8_U8_CAN0_Rx_0x260_E2E_P01: ComBitPosition=56, ComBitSize=8, ComHandleId=ComConf_ComGroupSignal_CAN0_Rx_0x260_Sig_8_U8_CAN0_Rx_0x260_E2E_P01, ComSignalType=UINT8
          CAN0_Rx_0x260_Sig_7_U5_CAN0_Rx_0x260_E2E_P01: ComBitPosition=50, ComBitSize=5, ComHandleId=ComConf_ComGroupSignal_CAN0_Rx_0x260_Sig_7_U5_CAN0_Rx_0x260_E2E_P01, ComSignalType=UINT8
          CAN0_Rx_0x260_Sig_6_U2_CAN0_Rx_0x260_E2E_P01: ComBitPosition=48, ComBitSize=2, ComHandleId=ComConf_ComGroupSignal_CAN0_Rx_0x260_Sig_6_U2_CAN0_Rx_0x260_E2E_P01, ComSignalType=UINT8
          CAN0_Rx_0x260_Sig_5_U16_CAN0_Rx_0x260_E2E_P01: ComBitPosition=40, ComBitSize=16, ComHandleId=ComConf_ComGroupSignal_CAN0_Rx_0x260_Sig_5_U16_CAN0_Rx_0x260_E2E_P01, ComSignalType=UINT16
          CAN0_Rx_0x260_Sig_4_U8_CAN0_Rx_0x260_E2E_P01: ComBitPosition=24, ComBitSize=8, ComHandleId=ComConf_ComGroupSignal_CAN0_Rx_0x260_Sig_4_U8_CAN0_Rx_0x260_E2E_P01, ComSignalType=UINT8
          CAN0_Rx_0x260_Sig_2_U3_CAN0_Rx_0x260_E2E_P01: ComBitPosition=17, ComBitSize=3, ComHandleId=ComConf_ComGroupSignal_CAN0_Rx_0x260_Sig_2_U3_CAN0_Rx_0x260_E2E_P01, ComSignalType=UINT8
          CAN0_Rx_0x260_Sig_3_U4_CAN0_Rx_0x260_E2E_P01: ComBitPosition=20, ComBitSize=4, ComHandleId=ComConf_ComGroupSignal_CAN0_Rx_0x260_Sig_3_U4_CAN0_Rx_0x260_E2E_P01, ComSignalType=UINT8
          CAN0_Rx_0x260_Sig_1_U1_CAN0_Rx_0x260_E2E_P01: ComBitPosition=16, ComBitSize=1, ComHandleId=ComConf_ComGroupSignal_CAN0_Rx_0x260_Sig_1_U1_CAN0_Rx_0x260_E2E_P01, ComSignalType=BOOLEAN
          CAN0_Rx_0x260_Counter_CAN0_Rx_0x260_E2E_P01: ComBitPosition=8, ComBitSize=4, ComHandleId=ComConf_ComGroupSignal_CAN0_Rx_0x260_Counter_CAN0_Rx_0x260_E2E_P01, ComSignalType=UINT8
          CAN0_Rx_0x260_CRC_CAN0_Rx_0x260_E2E_P01: ComBitPosition=0, ComBitSize=8, ComHandleId=ComConf_ComGroupSignal_CAN0_Rx_0x260_CRC_CAN0_Rx_0x260_E2E_P01, ComSignalType=UINT8
      CAN0_Rx_0x251_Cyclic_PN29 (ComIPdu):
        ComIPduCancellationSupport = false
        ComIPduDirection = RECEIVE
        ComIPduHandleId = COM_RXPDU_COM_CAN0_Rx_0x251_Cyclic_PN29
        ComIPduSignalProcessing = DEFERRED
        ComIPduType = NORMAL
        ComPduIdRef = COM_CAN0_Rx_0x251_Cyclic_PN29
        ComIPduSignalRef = CAN0_Rx_0x251_Cyclic_PN29_Sig_CAN0_Rx_0x251_Cyclic_PN29
        ComIPduGroupRef = ComIPduGroup_PN29_Rx
      CAN0_Rx_0x251_Cyclic_PN29_Sig_CAN0_Rx_0x251_Cyclic_PN29 (ComSignal):
        ComBitPosition = 8
        ComBitSize = 16
        ComHandleId = ComConf_ComSignal_CAN0_Rx_0x251_Cyclic_PN29_Sig_CAN0_Rx_0x251_Cyclic_PN29
        ComInvalidNotification = NULL_PTR
        ComRxDataTimeoutAction = NONE
        ComSignalEndianness = BIG_ENDIAN
        ComSignalInitValue = 0x0
        ComSignalLength = 0
        ComSignalType = UINT16
        ComTransferProperty = PENDING
        ComTimeout = 0.0
        ComFirstTimeout = 0.0
        ComNotification = Rte_COMCbk
      CAN0_Rx_0x250_Cyclic_PN17 (ComIPdu):
        ComIPduCancellationSupport = false
        ComIPduDirection = RECEIVE
        ComIPduHandleId = COM_RXPDU_COM_CAN0_Rx_0x250_Cyclic_PN17
        ComIPduSignalProcessing = DEFERRED
        ComIPduType = NORMAL
        ComPduIdRef = COM_CAN0_Rx_0x250_Cyclic_PN17
        ComIPduSignalRef = CAN0_Rx_0x250_Cyclic_PN17_Sig_CAN0_Rx_0x250_Cyclic_PN17
        ComIPduGroupRef = ComIPduGroup_PN17_Rx
      CAN0_Rx_0x250_Cyclic_PN17_Sig_CAN0_Rx_0x250_Cyclic_PN17 (ComSignal):
        ComBitPosition = 8
        ComBitSize = 16
        ComHandleId = ComConf_ComSignal_CAN0_Rx_0x250_Cyclic_PN17_Sig_CAN0_Rx_0x250_Cyclic_PN17
        ComInvalidNotification = NULL_PTR
        ComRxDataTimeoutAction = NONE
        ComSignalEndianness = BIG_ENDIAN
        ComSignalInitValue = 0x0
        ComSignalLength = 0
        ComSignalType = UINT16
        ComTransferProperty = PENDING
        ComTimeout = 0.0
        ComFirstTimeout = 0.0
        ComNotification = Rte_COMCbk
      CAN0_Rx_0x200_Cyclic (ComIPdu):
        ComIPduCancellationSupport = false
        ComIPduDirection = RECEIVE
        ComIPduHandleId = COM_RXPDU_COM_CAN0_Rx_0x200_Cyclic
        ComIPduSignalProcessing = DEFERRED
        ComIPduType = NORMAL
        ComPduIdRef = COM_CAN0_Rx_0x200_Cyclic
        ComIPduSignalRef = CAN0_Rx_0x200_Sig_4_U31_CAN0_Rx_0x200_Cyclic
        ComIPduSignalRef = CAN0_Rx_0x200_Sig_3_U15_CAN0_Rx_0x200_Cyclic
        ComIPduSignalRef = CAN0_Rx_0x200_Sig_2_U6_CAN0_Rx_0x200_Cyclic
        ComIPduSignalRef = CAN0_Rx_0x200_Sig_1_U4_CAN0_Rx_0x200_Cyclic
        ComIPduGroupRef = Com_RxPduGroup_CAN_CONTROLLER_0_ECU_ECU
      4 x ComSignal, all with ComInvalidNotification=NULL_PTR, ComRxDataTimeoutAction=NONE, ComSignalEndianness=BIG_ENDIAN, ComSignalInitValue=0x0, ComSignalLength=0, ComTransferProperty=PENDING, ComTimeout=0.0, ComFirstTimeout=0.0, ComNotification=Rte_COMCbk:
        CAN0_Rx_0x200_Sig_4_U31_CAN0_Rx_0x200_Cyclic: ComBitPosition=57, ComBitSize=31, ComHandleId=ComConf_ComSignal_CAN0_Rx_0x200_Sig_4_U31_CAN0_Rx_0x200_Cyclic, ComSignalType=UINT32, ComUpdateBitPosition=56
        CAN0_Rx_0x200_Sig_3_U15_CAN0_Rx_0x200_Cyclic: ComBitPosition=25, ComBitSize=15, ComHandleId=ComConf_ComSignal_CAN0_Rx_0x200_Sig_3_U15_CAN0_Rx_0x200_Cyclic, ComSignalType=UINT16, ComUpdateBitPosition=24
        CAN0_Rx_0x200_Sig_2_U6_CAN0_Rx_0x200_Cyclic: ComBitPosition=10, ComBitSize=6, ComHandleId=ComConf_ComSignal_CAN0_Rx_0x200_Sig_2_U6_CAN0_Rx_0x200_Cyclic, ComSignalType=UINT8, ComUpdateBitPosition=9
        CAN0_Rx_0x200_Sig_1_U4_CAN0_Rx_0x200_Cyclic: ComBitPosition=4, ComBitSize=4, ComHandleId=ComConf_ComSignal_CAN0_Rx_0x200_Sig_1_U4_CAN0_Rx_0x200_Cyclic, ComSignalType=UINT8, ComUpdateBitPosition=3
      CAN0_Rx_0x201_Event (ComIPdu):
        ComIPduCancellationSupport = false
        ComIPduDirection = RECEIVE
        ComIPduHandleId = COM_RXPDU_COM_CAN0_Rx_0x201_Event
        ComIPduSignalProcessing = DEFERRED
        ComIPduType = NORMAL
        ComIPduCallout = IPDU_COM_CAN0_Rx_0x201_Callout
        ComPduIdRef = COM_CAN0_Rx_0x201_Event
        ComIPduSignalRef = CAN0_Rx_0x201_Sig_4_U32_CAN0_Rx_0x201_Event
        ComIPduSignalRef = CAN0_Rx_0x201_Sig_3_U16_CAN0_Rx_0x201_Event
        ComIPduSignalRef = CAN0_Rx_0x201_Sig_2_U8_CAN0_Rx_0x201_Event
        ComIPduSignalRef = CAN0_Rx_0x201_Sig_1_U3_CAN0_Rx_0x201_Event
        ComIPduGroupRef = Com_RxPduGroup_CAN_CONTROLLER_0_ECU_ECU
      4 x ComSignal, all with ComInvalidNotification=NULL_PTR, ComRxDataTimeoutAction=NONE, ComSignalEndianness=BIG_ENDIAN, ComSignalInitValue=0x0, ComSignalLength=0, ComTransferProperty=PENDING, ComTimeout=0.0, ComFirstTimeout=0.0, ComNotification=Rte_COMCbk:
        CAN0_Rx_0x201_Sig_4_U32_CAN0_Rx_0x201_Event: ComBitPosition=56, ComBitSize=32, ComHandleId=ComConf_ComSignal_CAN0_Rx_0x201_Sig_4_U32_CAN0_Rx_0x201_Event, ComSignalType=UINT32
        CAN0_Rx_0x201_Sig_3_U16_CAN0_Rx_0x201_Event: ComBitPosition=28, ComBitSize=16, ComHandleId=ComConf_ComSignal_CAN0_Rx_0x201_Sig_3_U16_CAN0_Rx_0x201_Event, ComSignalType=UINT16
        CAN0_Rx_0x201_Sig_2_U8_CAN0_Rx_0x201_Event: ComBitPosition=12, ComBitSize=8, ComHandleId=ComConf_ComSignal_CAN0_Rx_0x201_Sig_2_U8_CAN0_Rx_0x201_Event, ComSignalType=UINT8
        CAN0_Rx_0x201_Sig_1_U3_CAN0_Rx_0x201_Event: ComBitPosition=5, ComBitSize=3, ComHandleId=ComConf_ComSignal_CAN0_Rx_0x201_Sig_1_U3_CAN0_Rx_0x201_Event, ComSignalType=UINT8
      CAN0_Rx_0x202_Mixed (ComIPdu):
        ComIPduCancellationSupport = false
        ComIPduDirection = RECEIVE
        ComIPduHandleId = COM_RXPDU_COM_CAN0_Rx_0x202_Mixed
        ComIPduSignalProcessing = DEFERRED
        ComIPduType = NORMAL
        ComIPduCallout = IPDU_COM_CAN0_Rx_0x202_Mixed_Callout
        ComPduIdRef = COM_CAN0_Rx_0x202_Mixed
        ComIPduSignalRef = CAN0_Rx_0x202_Sig_7_U2_CAN0_Rx_0x202_Mixed
        ComIPduSignalRef = CAN0_Rx_0x202_Sig_6_U1_CAN0_Rx_0x202_Mixed
        ComIPduSignalRef = CAN0_Rx_0x202_Sig_4_U8_CAN0_Rx_0x202_Mixed
        ComIPduSignalRef = CAN0_Rx_0x202_Sig_3_U16_CAN0_Rx_0x202_Mixed
        ComIPduSignalRef = CAN0_Rx_0x202_Sig_2_U8_CAN0_Rx_0x202_Mixed
        ComIPduSignalRef = CAN0_Rx_0x202_Sig_1_U4_CAN0_Rx_0x202_Mixed
        ComIPduSignalRef = CAN0_Rx_0x202_Sig_5_U1_CAN0_Rx_0x202_Mixed
        ComIPduGroupRef = Com_RxPduGroup_CAN_CONTROLLER_0_ECU_ECU
      7 x ComSignal, all with ComInvalidNotification=NULL_PTR, ComRxDataTimeoutAction=NONE, ComSignalEndianness=BIG_ENDIAN, ComSignalInitValue=0x0, ComSignalLength=0, ComTransferProperty=PENDING, ComNotification=Rte_COMCbk:
        CAN0_Rx_0x202_Sig_7_U2_CAN0_Rx_0x202_Mixed: ComBitPosition=51, ComBitSize=2, ComHandleId=ComConf_ComSignal_CAN0_Rx_0x202_Sig_7_U2_CAN0_Rx_0x202_Mixed, ComSignalType=UINT8, ComTimeoutNotification=Rte_COMCbkRxTOut, ComTimeout=2.5, ComFirstTimeout=2.5
        CAN0_Rx_0x202_Sig_6_U1_CAN0_Rx_0x202_Mixed: ComBitPosition=11, ComBitSize=1, ComHandleId=ComConf_ComSignal_CAN0_Rx_0x202_Sig_6_U1_CAN0_Rx_0x202_Mixed, ComSignalType=BOOLEAN, ComTimeout=0.0, ComFirstTimeout=0.0
        CAN0_Rx_0x202_Sig_4_U8_CAN0_Rx_0x202_Mixed: ComBitPosition=32, ComBitSize=8, ComHandleId=ComConf_ComSignal_CAN0_Rx_0x202_Sig_4_U8_CAN0_Rx_0x202_Mixed, ComSignalType=UINT8, ComTimeout=0.0, ComFirstTimeout=0.0
        CAN0_Rx_0x202_Sig_3_U16_CAN0_Rx_0x202_Mixed: ComBitPosition=24, ComBitSize=16, ComHandleId=ComConf_ComSignal_CAN0_Rx_0x202_Sig_3_U16_CAN0_Rx_0x202_Mixed, ComSignalType=UINT16, ComTimeout=0.0, ComFirstTimeout=0.0
        CAN0_Rx_0x202_Sig_2_U8_CAN0_Rx_0x202_Mixed: ComBitPosition=12, ComBitSize=8, ComHandleId=ComConf_ComSignal_CAN0_Rx_0x202_Sig_2_U8_CAN0_Rx_0x202_Mixed, ComSignalType=UINT8, ComTimeout=0.0, ComFirstTimeout=0.0
        CAN0_Rx_0x202_Sig_1_U4_CAN0_Rx_0x202_Mixed: ComBitPosition=4, ComBitSize=4, ComHandleId=ComConf_ComSignal_CAN0_Rx_0x202_Sig_1_U4_CAN0_Rx_0x202_Mixed, ComSignalType=UINT8, ComTimeout=0.0, ComFirstTimeout=0.0
        CAN0_Rx_0x202_Sig_5_U1_CAN0_Rx_0x202_Mixed: ComBitPosition=47, ComBitSize=1, ComHandleId=ComConf_ComSignal_CAN0_Rx_0x202_Sig_5_U1_CAN0_Rx_0x202_Mixed, ComSignalType=BOOLEAN, ComTimeout=0.0, ComFirstTimeout=0.0
      CAN0_Rx_0x203_Cyclic_Counter (ComIPdu):
        ComIPduCancellationSupport = false
        ComIPduDirection = RECEIVE
        ComIPduHandleId = COM_RXPDU_COM_CAN0_Rx_0x203_Cyclic_Counter
        ComIPduSignalProcessing = DEFERRED
        ComIPduType = NORMAL
        ComPduIdRef = COM_CAN0_Rx_0x203_Cyclic_Counter
        ComIPduSignalRef = CAN0_Rx_0x203_Sig_4_U32_CAN0_Rx_0x203_Cyclic_Counter
        ComIPduSignalRef = CAN0_Rx_0x203_Sig_3_U16_CAN0_Rx_0x203_Cyclic_Counter
        ComIPduSignalRef = CAN0_Rx_0x203_Sig_2_U8_CAN0_Rx_0x203_Cyclic_Counter
        ComIPduSignalRef = CAN0_Rx_0x203_Sig_1_U4_CAN0_Rx_0x203_Cyclic_Counter
        ComIPduSignalRef = CAN0_Rx_0x203_Sig_RollingCounter_CAN0_Rx_0x203_Cyclic_Counter
        ComIPduGroupRef = Com_RxPduGroup_CAN_CONTROLLER_0_ECU_ECU
      5 x ComSignal, all with ComInvalidNotification=NULL_PTR, ComRxDataTimeoutAction=NONE, ComSignalEndianness=BIG_ENDIAN, ComSignalInitValue=0x0, ComSignalLength=0, ComTransferProperty=PENDING, ComTimeout=0.0, ComFirstTimeout=0.0, ComNotification=Rte_COMCbk:
        CAN0_Rx_0x203_Sig_4_U32_CAN0_Rx_0x203_Cyclic_Counter: ComBitPosition=56, ComBitSize=32, ComHandleId=ComConf_ComSignal_CAN0_Rx_0x203_Sig_4_U32_CAN0_Rx_0x203_Cyclic_Counter, ComSignalType=UINT32
        CAN0_Rx_0x203_Sig_3_U16_CAN0_Rx_0x203_Cyclic_Counter: ComBitPosition=24, ComBitSize=16, ComHandleId=ComConf_ComSignal_CAN0_Rx_0x203_Sig_3_U16_CAN0_Rx_0x203_Cyclic_Counter, ComSignalType=UINT16
        CAN0_Rx_0x203_Sig_2_U8_CAN0_Rx_0x203_Cyclic_Counter: ComBitPosition=12, ComBitSize=8, ComHandleId=ComConf_ComSignal_CAN0_Rx_0x203_Sig_2_U8_CAN0_Rx_0x203_Cyclic_Counter, ComSignalType=UINT8
        CAN0_Rx_0x203_Sig_1_U4_CAN0_Rx_0x203_Cyclic_Counter: ComBitPosition=4, ComBitSize=4, ComHandleId=ComConf_ComSignal_CAN0_Rx_0x203_Sig_1_U4_CAN0_Rx_0x203_Cyclic_Counter, ComSignalType=UINT8
        CAN0_Rx_0x203_Sig_RollingCounter_CAN0_Rx_0x203_Cyclic_Counter: ComBitPosition=8, ComBitSize=4, ComHandleId=ComConf_ComSignal_CAN0_Rx_0x203_Sig_RollingCounter_CAN0_Rx_0x203_Cyclic_Counter, ComSignalType=UINT8
      ComMainFunctionTx: ComMainTxTimeBase=0.005
      CAN0_Tx_0x360_E2E_P01 (ComIPdu):
        ComIPduCancellationSupport = false
        ComIPduDirection = SEND
        ComIPduHandleId = COM_TXPDU_COM_CAN0_Tx_0x360_E2E_P01
        ComIPduSignalProcessing = DEFERRED
        ComIPduType = NORMAL
        ComIPduCallout = E2E_Tx_0x360_P01_0x1234_IpduCallOut
        ComPduIdRef = COM_CAN0_Tx_0x360_E2E_P01
        ComIPduSignalGroupRef = Tx_0x360_E2E_P01_CAN0_Tx_0x360_E2E_P01
        ComIPduGroupRef = Com_TxPduGroup_CAN_CONTROLLER_0_ECU_ECU
        ComTxIPdu: ComMinimumDelayTime=0.0, ComTxIPduUnusedAreasDefault=0
          ComTxModeTrue
            ComTxMode: ComTxModeMode=PERIODIC, ComTxModeNumberOfRepetitions=0, ComTxModeRepetitionPeriod=0.0, ComTxModeTimeOffset=0.0, ComTxModeTimePeriod=0.1
      Tx_0x360_E2E_P01_CAN0_Tx_0x360_E2E_P01 (ComSignalGroup):
        ComHandleId = ComConf_ComSignalGroup_Tx_0x360_E2E_P01_CAN0_Tx_0x360_E2E_P01
        ComInvalidNotification = NULL_PTR
        ComRxDataTimeoutAction = NONE
        ComTransferProperty = PENDING
        ComTimeout = 0.0
        ComFirstTimeout = 0.0
        ComNotification = Rte_COMCbkTAck
        10 x ComGroupSignal, all with ComSignalEndianness=BIG_ENDIAN, ComSignalInitValue=0x0, ComSignalLength=0:
          CAN0_Tx_0x360_Sig_8_U8_CAN0_Tx_0x360_E2E_P01: ComBitPosition=56, ComBitSize=8, ComHandleId=ComConf_ComGroupSignal_CAN0_Tx_0x360_Sig_8_U8_CAN0_Tx_0x360_E2E_P01, ComSignalType=UINT8
          CAN0_Tx_0x360_Sig_7_U5_CAN0_Tx_0x360_E2E_P01: ComBitPosition=50, ComBitSize=5, ComHandleId=ComConf_ComGroupSignal_CAN0_Tx_0x360_Sig_7_U5_CAN0_Tx_0x360_E2E_P01, ComSignalType=UINT8
          CAN0_Tx_0x360_Sig_6_U2_CAN0_Tx_0x360_E2E_P01: ComBitPosition=48, ComBitSize=2, ComHandleId=ComConf_ComGroupSignal_CAN0_Tx_0x360_Sig_6_U2_CAN0_Tx_0x360_E2E_P01, ComSignalType=UINT8
          CAN0_Tx_0x360_Sig_5_U16_CAN0_Tx_0x360_E2E_P01: ComBitPosition=40, ComBitSize=16, ComHandleId=ComConf_ComGroupSignal_CAN0_Tx_0x360_Sig_5_U16_CAN0_Tx_0x360_E2E_P01, ComSignalType=UINT16
          CAN0_Tx_0x360_Sig_4_U8_CAN0_Tx_0x360_E2E_P01: ComBitPosition=24, ComBitSize=8, ComHandleId=ComConf_ComGroupSignal_CAN0_Tx_0x360_Sig_4_U8_CAN0_Tx_0x360_E2E_P01, ComSignalType=UINT8
          CAN0_Tx_0x360_Sig_2_U3_CAN0_Tx_0x360_E2E_P01: ComBitPosition=17, ComBitSize=3, ComHandleId=ComConf_ComGroupSignal_CAN0_Tx_0x360_Sig_2_U3_CAN0_Tx_0x360_E2E_P01, ComSignalType=UINT8
          CAN0_Tx_0x360_Sig_3_U4_CAN0_Tx_0x360_E2E_P01: ComBitPosition=20, ComBitSize=4, ComHandleId=ComConf_ComGroupSignal_CAN0_Tx_0x360_Sig_3_U4_CAN0_Tx_0x360_E2E_P01, ComSignalType=UINT8
          CAN0_Tx_0x360_Sig_1_U1_CAN0_Tx_0x360_E2E_P01: ComBitPosition=16, ComBitSize=1, ComHandleId=ComConf_ComGroupSignal_CAN0_Tx_0x360_Sig_1_U1_CAN0_Tx_0x360_E2E_P01, ComSignalType=BOOLEAN
          CAN0_Tx_0x360_Counter_CAN0_Tx_0x360_E2E_P01: ComBitPosition=8, ComBitSize=4, ComHandleId=ComConf_ComGroupSignal_CAN0_Tx_0x360_Counter_CAN0_Tx_0x360_E2E_P01, ComSignalType=UINT8
          CAN0_Tx_0x360_CRC_CAN0_Tx_0x360_E2E_P01: ComBitPosition=0, ComBitSize=8, ComHandleId=ComConf_ComGroupSignal_CAN0_Tx_0x360_CRC_CAN0_Tx_0x360_E2E_P01, ComSignalType=UINT8
      CAN0_Tx_0x351_Cyclic_PN29 (ComIPdu):
        ComIPduCancellationSupport = false
        ComIPduDirection = SEND
        ComIPduHandleId = COM_TXPDU_COM_CAN0_Tx_0x351_Cyclic_PN29
        ComIPduSignalProcessing = DEFERRED
        ComIPduType = NORMAL
        ComPduIdRef = COM_CAN0_Tx_0x351_Cyclic_PN29
        ComIPduSignalRef = CAN0_Tx_0x351_Cyclic_PN29_Sig_CAN0_Tx_0x351_Cyclic_PN29
        ComIPduGroupRef = ComIPduGroup_PN29_Tx
        ComTxIPdu: ComMinimumDelayTime=0.0, ComTxIPduUnusedAreasDefault=0
          ComTxModeTrue
            ComTxMode: ComTxModeMode=PERIODIC, ComTxModeNumberOfRepetitions=0, ComTxModeRepetitionPeriod=0.0, ComTxModeTimeOffset=0.0, ComTxModeTimePeriod=0.1
      CAN0_Tx_0x351_Cyclic_PN29_Sig_CAN0_Tx_0x351_Cyclic_PN29 (ComSignal):
        ComBitPosition = 8
        ComBitSize = 16
        ComHandleId = ComConf_ComSignal_CAN0_Tx_0x351_Cyclic_PN29_Sig_CAN0_Tx_0x351_Cyclic_PN29
        ComInvalidNotification = NULL_PTR
        ComRxDataTimeoutAction = NONE
        ComSignalEndianness = BIG_ENDIAN
        ComSignalInitValue = 0x0
        ComSignalLength = 0
        ComSignalType = UINT16
        ComTransferProperty = PENDING
        ComTimeout = 0.0
        ComFirstTimeout = 0.0
        ComNotification = Rte_COMCbkTAck
      CAN0_Tx_0x350_Cyclic_PN17 (ComIPdu):
        ComIPduCancellationSupport = false
        ComIPduDirection = SEND
        ComIPduHandleId = COM_TXPDU_COM_CAN0_Tx_0x350_Cyclic_PN17
        ComIPduSignalProcessing = DEFERRED
        ComIPduType = NORMAL
        ComPduIdRef = COM_CAN0_Tx_0x350_Cyclic_PN17
        ComIPduSignalRef = CAN0_Tx_0x350_Cyclic_PN17_Sig_CAN0_Tx_0x350_Cyclic_PN17
        ComIPduGroupRef = ComIPduGroup_PN17_Tx
        ComTxIPdu: ComMinimumDelayTime=0.0, ComTxIPduUnusedAreasDefault=0
          ComTxModeTrue
            ComTxMode: ComTxModeMode=PERIODIC, ComTxModeNumberOfRepetitions=0, ComTxModeRepetitionPeriod=0.0, ComTxModeTimeOffset=0.0, ComTxModeTimePeriod=0.1
      CAN0_Tx_0x350_Cyclic_PN17_Sig_CAN0_Tx_0x350_Cyclic_PN17 (ComSignal):
        ComBitPosition = 8
        ComBitSize = 16
        ComHandleId = ComConf_ComSignal_CAN0_Tx_0x350_Cyclic_PN17_Sig_CAN0_Tx_0x350_Cyclic_PN17
        ComInvalidNotification = NULL_PTR
        ComRxDataTimeoutAction = NONE
        ComSignalEndianness = BIG_ENDIAN
        ComSignalInitValue = 0x0
        ComSignalLength = 0
        ComSignalType = UINT16
        ComTransferProperty = PENDING
        ComTimeout = 0.0
        ComFirstTimeout = 0.0
        ComNotification = Rte_COMCbkTAck
      CAN0_Tx_0x300_Cyclic (ComIPdu):
        ComIPduCancellationSupport = false
        ComIPduDirection = SEND
        ComIPduHandleId = COM_TXPDU_COM_CAN0_Tx_0x300_Cyclic
        ComIPduSignalProcessing = DEFERRED
        ComIPduType = NORMAL
        ComPduIdRef = COM_CAN0_Tx_0x300_Cyclic
        ComIPduSignalRef = CAN0_Tx_0x300_Sig_4_U31_CAN0_Tx_0x300_Cyclic
        ComIPduSignalRef = CAN0_Tx_0x300_Sig_3_U15_CAN0_Tx_0x300_Cyclic
        ComIPduSignalRef = CAN0_Tx_0x300_Sig_2_U6_CAN0_Tx_0x300_Cyclic
        ComIPduSignalRef = CAN0_Tx_0x300_Sig_1_U4_CAN0_Tx_0x300_Cyclic
        ComIPduGroupRef = Com_TxPduGroup_CAN_CONTROLLER_0_ECU_ECU
        ComTxIPdu: ComMinimumDelayTime=0.0, ComTxIPduUnusedAreasDefault=0, ComTxIPduClearUpdateBit=Confirmation
          ComTxModeTrue
            ComTxMode: ComTxModeMode=PERIODIC, ComTxModeNumberOfRepetitions=0, ComTxModeRepetitionPeriod=0.0, ComTxModeTimeOffset=0.0, ComTxModeTimePeriod=0.1
      4 x ComSignal, all with ComInvalidNotification=NULL_PTR, ComRxDataTimeoutAction=NONE, ComSignalEndianness=BIG_ENDIAN, ComSignalInitValue=0x0, ComSignalLength=0, ComTransferProperty=PENDING, ComTimeout=0.0, ComFirstTimeout=0.0, ComNotification=Rte_COMCbkTAck:
        CAN0_Tx_0x300_Sig_4_U31_CAN0_Tx_0x300_Cyclic: ComBitPosition=57, ComBitSize=31, ComHandleId=ComConf_ComSignal_CAN0_Tx_0x300_Sig_4_U31_CAN0_Tx_0x300_Cyclic, ComSignalType=UINT32, ComUpdateBitPosition=56
        CAN0_Tx_0x300_Sig_3_U15_CAN0_Tx_0x300_Cyclic: ComBitPosition=25, ComBitSize=15, ComHandleId=ComConf_ComSignal_CAN0_Tx_0x300_Sig_3_U15_CAN0_Tx_0x300_Cyclic, ComSignalType=UINT16, ComUpdateBitPosition=24
        CAN0_Tx_0x300_Sig_2_U6_CAN0_Tx_0x300_Cyclic: ComBitPosition=10, ComBitSize=6, ComHandleId=ComConf_ComSignal_CAN0_Tx_0x300_Sig_2_U6_CAN0_Tx_0x300_Cyclic, ComSignalType=UINT8, ComUpdateBitPosition=9
        CAN0_Tx_0x300_Sig_1_U4_CAN0_Tx_0x300_Cyclic: ComBitPosition=4, ComBitSize=4, ComHandleId=ComConf_ComSignal_CAN0_Tx_0x300_Sig_1_U4_CAN0_Tx_0x300_Cyclic, ComSignalType=UINT8, ComUpdateBitPosition=3
      CAN0_Tx_0x301_Event (ComIPdu):
        ComIPduCancellationSupport = false
        ComIPduDirection = SEND
        ComIPduHandleId = COM_TXPDU_COM_CAN0_Tx_0x301_Event
        ComIPduSignalProcessing = DEFERRED
        ComIPduType = NORMAL
        ComPduIdRef = COM_CAN0_Tx_0x301_Event
        ComIPduSignalRef = CAN0_Tx_0x301_Sig_4_U32_CAN0_Tx_0x301_Event
        ComIPduSignalRef = CAN0_Tx_0x301_Sig_3_U16_CAN0_Tx_0x301_Event
        ComIPduSignalRef = CAN0_Tx_0x301_Sig_2_U8_CAN0_Tx_0x301_Event
        ComIPduSignalRef = CAN0_Tx_0x301_Sig_1_U3_CAN0_Tx_0x301_Event
        ComIPduGroupRef = Com_TxPduGroup_CAN_CONTROLLER_0_ECU_ECU
        ComTxIPdu: ComMinimumDelayTime=0.01, ComTxIPduUnusedAreasDefault=0
          ComTxModeTrue
            ComTxMode: ComTxModeMode=DIRECT, ComTxModeNumberOfRepetitions=3, ComTxModeRepetitionPeriod=0.05, ComTxModeTimeOffset=0.0, ComTxModeTimePeriod=0.0
      4 x ComSignal, all with ComInvalidNotification=NULL_PTR, ComRxDataTimeoutAction=NONE, ComSignalEndianness=BIG_ENDIAN, ComSignalInitValue=0x0, ComSignalLength=0, ComTransferProperty=TRIGGERED_WITHOUT_REPETITION, ComTimeout=0.0, ComFirstTimeout=0.0, ComNotification=Rte_COMCbkTAck:
        CAN0_Tx_0x301_Sig_4_U32_CAN0_Tx_0x301_Event: ComBitPosition=56, ComBitSize=32, ComHandleId=ComConf_ComSignal_CAN0_Tx_0x301_Sig_4_U32_CAN0_Tx_0x301_Event, ComSignalType=UINT32
        CAN0_Tx_0x301_Sig_3_U16_CAN0_Tx_0x301_Event: ComBitPosition=28, ComBitSize=16, ComHandleId=ComConf_ComSignal_CAN0_Tx_0x301_Sig_3_U16_CAN0_Tx_0x301_Event, ComSignalType=UINT16
        CAN0_Tx_0x301_Sig_2_U8_CAN0_Tx_0x301_Event: ComBitPosition=12, ComBitSize=8, ComHandleId=ComConf_ComSignal_CAN0_Tx_0x301_Sig_2_U8_CAN0_Tx_0x301_Event, ComSignalType=UINT8
        CAN0_Tx_0x301_Sig_1_U3_CAN0_Tx_0x301_Event: ComBitPosition=5, ComBitSize=3, ComHandleId=ComConf_ComSignal_CAN0_Tx_0x301_Sig_1_U3_CAN0_Tx_0x301_Event, ComSignalType=UINT8
      CAN0_Tx_0x302_Mixed (ComIPdu):
        ComIPduCancellationSupport = false
        ComIPduDirection = SEND
        ComIPduHandleId = COM_TXPDU_COM_CAN0_Tx_0x302_Mixed
        ComIPduSignalProcessing = DEFERRED
        ComIPduType = NORMAL
        ComPduIdRef = COM_CAN0_Tx_0x302_Mixed
        ComIPduSignalRef = CAN0_Tx_0x302_Sig_7_U2_CAN0_Tx_0x302_Mixed
        ComIPduSignalRef = CAN0_Tx_0x302_Sig_6_U1_CAN0_Tx_0x302_Mixed
        ComIPduSignalRef = CAN0_Tx_0x302_Sig_4_U8_CAN0_Tx_0x302_Mixed
        ComIPduSignalRef = CAN0_Tx_0x302_Sig_3_U16_CAN0_Tx_0x302_Mixed
        ComIPduSignalRef = CAN0_Tx_0x302_Sig_2_U8_CAN0_Tx_0x302_Mixed
        ComIPduSignalRef = CAN0_Tx_0x302_Sig_1_U4_CAN0_Tx_0x302_Mixed
        ComIPduSignalRef = CAN0_Tx_0x302_Sig_5_U1_CAN0_Tx_0x302_Mixed
        ComIPduGroupRef = Com_TxPduGroup_CAN_CONTROLLER_0_ECU_ECU
        ComTxIPdu: ComMinimumDelayTime=0.01, ComTxIPduUnusedAreasDefault=0
          ComTxModeTrue
            ComTxMode: ComTxModeMode=MIXED, ComTxModeNumberOfRepetitions=3, ComTxModeRepetitionPeriod=0.05, ComTxModeTimeOffset=0.0, ComTxModeTimePeriod=0.5
      7 x ComSignal, all with ComInvalidNotification=NULL_PTR, ComRxDataTimeoutAction=NONE, ComSignalEndianness=BIG_ENDIAN, ComSignalInitValue=0x0, ComSignalLength=0, ComTransferProperty=TRIGGERED, ComTimeout=0.0, ComFirstTimeout=0.0, ComNotification=Rte_COMCbkTAck:
        CAN0_Tx_0x302_Sig_7_U2_CAN0_Tx_0x302_Mixed: ComBitPosition=51, ComBitSize=2, ComHandleId=ComConf_ComSignal_CAN0_Tx_0x302_Sig_7_U2_CAN0_Tx_0x302_Mixed, ComSignalType=UINT8
        CAN0_Tx_0x302_Sig_6_U1_CAN0_Tx_0x302_Mixed: ComBitPosition=11, ComBitSize=1, ComHandleId=ComConf_ComSignal_CAN0_Tx_0x302_Sig_6_U1_CAN0_Tx_0x302_Mixed, ComSignalType=BOOLEAN
        CAN0_Tx_0x302_Sig_4_U8_CAN0_Tx_0x302_Mixed: ComBitPosition=32, ComBitSize=8, ComHandleId=ComConf_ComSignal_CAN0_Tx_0x302_Sig_4_U8_CAN0_Tx_0x302_Mixed, ComSignalType=UINT8
        CAN0_Tx_0x302_Sig_3_U16_CAN0_Tx_0x302_Mixed: ComBitPosition=24, ComBitSize=16, ComHandleId=ComConf_ComSignal_CAN0_Tx_0x302_Sig_3_U16_CAN0_Tx_0x302_Mixed, ComSignalType=UINT16
        CAN0_Tx_0x302_Sig_2_U8_CAN0_Tx_0x302_Mixed: ComBitPosition=12, ComBitSize=8, ComHandleId=ComConf_ComSignal_CAN0_Tx_0x302_Sig_2_U8_CAN0_Tx_0x302_Mixed, ComSignalType=UINT8
        CAN0_Tx_0x302_Sig_1_U4_CAN0_Tx_0x302_Mixed: ComBitPosition=4, ComBitSize=4, ComHandleId=ComConf_ComSignal_CAN0_Tx_0x302_Sig_1_U4_CAN0_Tx_0x302_Mixed, ComSignalType=UINT8
        CAN0_Tx_0x302_Sig_5_U1_CAN0_Tx_0x302_Mixed: ComBitPosition=47, ComBitSize=1, ComHandleId=ComConf_ComSignal_CAN0_Tx_0x302_Sig_5_U1_CAN0_Tx_0x302_Mixed, ComSignalType=BOOLEAN
      CAN0_Tx_0x303_Cyclic_Counter (ComIPdu):
        ComIPduCancellationSupport = false
        ComIPduDirection = SEND
        ComIPduHandleId = COM_TXPDU_COM_CAN0_Tx_0x303_Cyclic_Counter
        ComIPduSignalProcessing = DEFERRED
        ComIPduType = NORMAL
        ComPduIdRef = COM_CAN0_Tx_0x303_Cyclic_Counter
        ComIPduSignalRef = CAN0_Tx_0x303_Sig_4_U32_CAN0_Tx_0x303_Cyclic_Counter
        ComIPduSignalRef = CAN0_Tx_0x303_Sig_3_U16_CAN0_Tx_0x303_Cyclic_Counter
        ComIPduSignalRef = CAN0_Tx_0x303_Sig_2_U8_CAN0_Tx_0x303_Cyclic_Counter
        ComIPduSignalRef = CAN0_Tx_0x303_Sig_1_U4_CAN0_Tx_0x303_Cyclic_Counter
        ComIPduSignalRef = CAN0_Tx_0x303_Sig_RollingCounter_CAN0_Tx_0x303_Cyclic_Counter
        ComIPduGroupRef = Com_TxPduGroup_CAN_CONTROLLER_0_ECU_ECU
        ComTxIPdu: ComMinimumDelayTime=0.0, ComTxIPduUnusedAreasDefault=0
          ComTxModeTrue
            ComTxMode: ComTxModeMode=PERIODIC, ComTxModeNumberOfRepetitions=0, ComTxModeRepetitionPeriod=0.0, ComTxModeTimeOffset=0.0, ComTxModeTimePeriod=0.05
      5 x ComSignal, all with ComInvalidNotification=NULL_PTR, ComRxDataTimeoutAction=NONE, ComSignalEndianness=BIG_ENDIAN, ComSignalInitValue=0x0, ComSignalLength=0, ComTransferProperty=PENDING, ComTimeout=0.0, ComFirstTimeout=0.0, ComNotification=Rte_COMCbkTAck:
        CAN0_Tx_0x303_Sig_4_U32_CAN0_Tx_0x303_Cyclic_Counter: ComBitPosition=56, ComBitSize=32, ComHandleId=ComConf_ComSignal_CAN0_Tx_0x303_Sig_4_U32_CAN0_Tx_0x303_Cyclic_Counter, ComSignalType=UINT32
        CAN0_Tx_0x303_Sig_3_U16_CAN0_Tx_0x303_Cyclic_Counter: ComBitPosition=24, ComBitSize=16, ComHandleId=ComConf_ComSignal_CAN0_Tx_0x303_Sig_3_U16_CAN0_Tx_0x303_Cyclic_Counter, ComSignalType=UINT16
        CAN0_Tx_0x303_Sig_2_U8_CAN0_Tx_0x303_Cyclic_Counter: ComBitPosition=12, ComBitSize=8, ComHandleId=ComConf_ComSignal_CAN0_Tx_0x303_Sig_2_U8_CAN0_Tx_0x303_Cyclic_Counter, ComSignalType=UINT8
        CAN0_Tx_0x303_Sig_1_U4_CAN0_Tx_0x303_Cyclic_Counter: ComBitPosition=4, ComBitSize=4, ComHandleId=ComConf_ComSignal_CAN0_Tx_0x303_Sig_1_U4_CAN0_Tx_0x303_Cyclic_Counter, ComSignalType=UINT8
        CAN0_Tx_0x303_Sig_RollingCounter_CAN0_Tx_0x303_Cyclic_Counter: ComBitPosition=8, ComBitSize=4, ComHandleId=ComConf_ComSignal_CAN0_Tx_0x303_Sig_RollingCounter_CAN0_Tx_0x303_Cyclic_Counter, ComSignalType=UINT8
      4 x ComIPduGroup:
        ComIPduGroup_PN17_Tx: ComIPduGroupHandleId=ComIPduGroup_PN17_Tx
        ComIPduGroup_PN29_Tx: ComIPduGroupHandleId=ComIPduGroup_PN29_Tx
        ComIPduGroup_PN17_Rx: ComIPduGroupHandleId=ComIPduGroup_PN17_Rx
        ComIPduGroup_PN29_Rx: ComIPduGroupHandleId=ComIPduGroup_PN29_Rx
