AUTOSAR XML (schema 00048)
package /S32K148
  module config EcuC
    EcuCGeneral: ByteOrder=LITTLE_ENDIAN
    EcucHardware
      EcucCoreDefinition_0 (EcucCoreDefinition): EcucCoreId=0
    EcucConfigSet
      EcucPduCollection: PduIdTypeEnum=UINT16, PduLengthTypeEnum=UINT16
        41 x Pdu:
          COM_CAN0_Rx_0x260_E2E_P01: PduLength=8
          CANIF_CAN0_Rx_0x260_E2E_P01: PduLength=8
          COM_CAN0_Rx_0x251_Cyclic_PN29: PduLength=8
          CANIF_CAN0_Rx_0x251_Cyclic_PN29: PduLength=8
          COM_CAN0_Rx_0x250_Cyclic_PN17: PduLength=8
          CANIF_CAN0_Rx_0x250_Cyclic_PN17: PduLength=8
          COM_CAN0_Rx_0x200_Cyclic: PduLength=8
          CANIF_CAN0_Rx_0x200_Cyclic: PduLength=8
          COM_CAN0_Rx_0x201_Event: PduLength=8
          CANIF_CAN0_Rx_0x201_Event: PduLength=8
          COM_CAN0_Rx_0x202_Mixed: PduLength=8
          CANIF_CAN0_Rx_0x202_Mixed: PduLength=8
          COM_CAN0_Rx_0x203_Cyclic_Counter: PduLength=8
          CANIF_CAN0_Rx_0x203_Cyclic_Counter: PduLength=8
          COM_CAN0_Tx_0x360_E2E_P01: PduLength=8
          CANIF_CAN0_Tx_0x360_E2E_P01: PduLength=8
          COM_CAN0_Tx_0x351_Cyclic_PN29: PduLength=8
          CANIF_CAN0_Tx_0x351_Cyclic_PN29: PduLength=8
          COM_CAN0_Tx_0x350_Cyclic_PN17: PduLength=8
          CANIF_CAN0_Tx_0x350_Cyclic_PN17: PduLength=8
          COM_CAN0_Tx_0x300_Cyclic: PduLength=8
          CANIF_CAN0_Tx_0x300_Cyclic: PduLength=8
          COM_CAN0_Tx_0x301_Event: PduLength=8
          CANIF_CAN0_Tx_0x301_Event: PduLength=8
          COM_CAN0_Tx_0x302_Mixed: PduLength=8
          CANIF_CAN0_Tx_0x302_Mixed: PduLength=8
          COM_CAN0_Tx_0x303_Cyclic_Counter: PduLength=8
          CANIF_CAN0_Tx_0x303_Cyclic_Counter: PduLength=8
          CANIF_CAN0_Rx_0x5xx_NM_ECU: PduLength=8
          CANIF_CAN0_Tx_0x501_NM_ECU: PduLength=8
          CanNm_UserDataPdu_ECU: PduLength=7
          Com_NmUserDataPdu_ECU: PduLength=7
          CAN_Dcm_Phys_Rx: PduLength=1024
          CAN_Dcm_Func_Rx: PduLength=1024
          CAN_Dcm_USDT_Tx: PduLength=1024
          CAN_CanIf_Func_Rx: PduLength=8
          CAN_CanIf_Phys_Rx: PduLength=8
          CAN_CanIf_USDT_Tx: PduLength=8
          CAN_CanTp_Phys_Rx: PduLength=8
          CAN_CanTp_Func_Rx: PduLength=8
          CAN_CanTp_USDT_Tx: PduLength=8
    EcucPartitionCollection
