AUTOSAR XML (schema 00048)
package /S32K148
  module config Fee: implementation-config-variant=VARIANT-PRE-COMPILE
    CommonPublishedInformation:
      ArReleaseMajorVersion = 4
      ArReleaseMinorVersion = 7
      ArReleaseRevisionVersion = 0
      ModuleId = 21
      SwMajorVersion = 2
      SwMinorVersion = 0
      SwPatchVersion = 0
      VendorId = 43
    28 x FeeBlockConfiguration, all with FeeBlockAssignment=APPLICATION, FeeImmediateData=0, FeeNumberOfWriteCycles=0, FeeClusterGroupRef=FeeClusterGroup_0, FeeMemAccAddressArea=MemAccAddressAreaConfiguration_0:
      FeeBlockConfiguration_0: FeeBlockNumber=256, FeeBlockSize=32
      FeeBlockConfiguration_1: FeeBlockNumber=257, FeeBlockSize=32
      FeeBlockConfiguration_DIDF183: FeeBlockNumber=2048, FeeBlockSize=64
      FeeBlockConfiguration_DIDF190: FeeBlockNumber=1792, FeeBlockSize=64
      FeeBlockConfiguration_Dcm: FeeBlockNumber=1024, FeeBlockSize=256
      FeeBlockConfiguration_Dem_Data: FeeBlockNumber=512, FeeBlockSize=1024
      FeeBlockConfiguration_Dem_Status: FeeBlockNumber=768, FeeBlockSize=512
      FeeBlockConfiguration_SecurityLevel01: FeeBlockNumber=1280, FeeBlockSize=64
      FeeBlockConfiguration_SecurityLevel02: FeeBlockNumber=1536, FeeBlockSize=64
      Fee_DemAdminData: FeeBlockNumber=6656, FeeBlockSize=32
      Fee_EventEntryPrimary_0: FeeBlockNumber=2304, FeeBlockSize=64
      Fee_EventEntryPrimary_1: FeeBlockNumber=2560, FeeBlockSize=64
      Fee_EventEntryPrimary_10: FeeBlockNumber=4864, FeeBlockSize=64
      Fee_EventEntryPrimary_11: FeeBlockNumber=5120, FeeBlockSize=64
      Fee_EventEntryPrimary_12: FeeBlockNumber=5376, FeeBlockSize=64
      Fee_EventEntryPrimary_13: FeeBlockNumber=5632, FeeBlockSize=64
      Fee_EventEntryPrimary_14: FeeBlockNumber=5888, FeeBlockSize=64
      Fee_EventEntryPrimary_15: FeeBlockNumber=6144, FeeBlockSize=64
      Fee_EventEntryPrimary_16: FeeBlockNumber=6400, FeeBlockSize=64
      Fee_EventEntryPrimary_2: FeeBlockNumber=2816, FeeBlockSize=64
      Fee_EventEntryPrimary_3: FeeBlockNumber=3072, FeeBlockSize=64
      Fee_EventEntryPrimary_4: FeeBlockNumber=3328, FeeBlockSize=64
      Fee_EventEntryPrimary_5: FeeBlockNumber=3584, FeeBlockSize=64
      Fee_EventEntryPrimary_6: FeeBlockNumber=3840, FeeBlockSize=64
      Fee_EventEntryPrimary_7: FeeBlockNumber=4096, FeeBlockSize=64
      Fee_EventEntryPrimary_8: FeeBlockNumber=4352, FeeBlockSize=64
      Fee_EventEntryPrimary_9: FeeBlockNumber=4608, FeeBlockSize=64
      Fee_EventStatusData: FeeBlockNumber=6912, FeeBlockSize=256
    FeeClusterGroup_0 (FeeClusterGroup)
      FeeCluster_0 (FeeCluster)
        FeeSubAddressArea_0 (FeeSubAddressArea): FeeSubAddressAreaIndex=0, FeeSubAddressAreaRef=MemAccSubAddressAreaConfiguration_0
      FeeCluster_1 (FeeCluster)
        FeeSubAddressArea_0 (FeeSubAddressArea): FeeSubAddressAreaIndex=0, FeeSubAddressAreaRef=MemAccSubAddressAreaConfiguration_1
    FeeGeneral:
      FeeBlockAlwaysAvailable = 0
      FeeConfigAssignment = APPLICATION
      FeeDataBufferSize = 96
      FeeDevErrorDetect = 1
      FeeEnableUserModeSupport = 0
      FeeLegacyEraseMode = 0
      FeeMainFunctionPeriod = 0.005
      FeeMarkEmptyBlocksInvalid = 0
      FeeMaximumNumberBlocks = 1
      FeeMinimumReadPageSize = 1
      FeePollingMode = 0
      FeeSetModeSupported = 0
      FeeSubAddressAreaEraseRetries = 3
      FeeSubAddressAreaRetirement = 0
      FeeSwapForeignBlocksEnabled = 0
      FeeVersionInfoApi = 1
      FeeVirtualPageSize = 32
      FeeBufferAlignmentValue = MemAccAddressAreaConfiguration_0
    FeePublishedInformation: FeeBlockOverhead=0, FeePageOverhead=0
