AUTOSAR XML (schema 00048)
package /S32K148
  module config CanTp
    CanTpConfig: CanTpMainFunctionPeriod=0.005, CanTpMaxChannelCnt=1
      CanTpChannel: CanTpSupportCanWithCanFD=false
        CanTpRxNSdu_CAN_Phys_Rx (CanTpRxNSdu):
          CanTpRxAddressingFormat = CANTP_STANDARD
          CanTpRxNSduId = 0
          CanTpRxPaddingActivation = CANTP_ON
          CanTpRxTaType = CANTP_PHYSICAL
          CanTpBs = 0
          CanTpNar = 0.07
          CanTpNbr = 0.01
          CanTpNcr = 0.15
          CanTpRxWftMax = 255
          CanTpSTmin = 0.01
          CanTpRxNSduRef = CAN_CanTp_Phys_Rx
          CanTpRxNPdu_Phy (CanTpRxNPdu): CanTpRxNPduId=0, CanTpRxNPduRef=CAN_CanIf_Phys_Rx
          CanTpTxFcNPdu: CanTpTxFcNPduConfirmationPduId=0, CanTpTxFcNPduRef=CAN_CanIf_USDT_Tx
          CanTpNAe: CanTpNAe=0
        CanTpRxNSdu_CAN_Func_Rx (CanTpRxNSdu):
          CanTpRxAddressingFormat = CANTP_STANDARD
          CanTpRxNSduId = 1
          CanTpRxPaddingActivation = CANTP_ON
          CanTpRxTaType = CANTP_FUNCTIONAL
          CanTpBs = 0
          CanTpNar = 0.07
          CanTpNbr = 0.01
          CanTpNcr = 0.15
          CanTpRxWftMax = 255
          CanTpSTmin = 0.01
          CanTpRxNSduRef = CAN_CanTp_Func_Rx
          CanTpRxNPdu_Func (CanTpRxNPdu): CanTpRxNPduId=1, CanTpRxNPduRef=CAN_CanIf_Func_Rx
          CanTpNAe: CanTpNAe=0
        CanTpTxNSdu_CAN_USDT_Tx (CanTpTxNSdu):
          CanTpNas = 0.07
          CanTpTc = false
          CanTpTxAddressingFormat = CANTP_STANDARD
          CanTpTxNSduId = 0
          CanTpTxPaddingActivation = CANTP_ON
          CanTpTxTaType = CANTP_PHYSICAL
          CanTpNbs = 0.15
          CanTpNcs = 0.15
          CanTpTxNSduRef = CAN_CanTp_USDT_Tx
          CanTpTxNPdu: CanTpTxNPduConfirmationPduId=0, CanTpTxNPduRef=CAN_CanIf_USDT_Tx
          CanTpRxFcNPdu: CanTpRxFcNPduId=0, CanTpRxFcNPduRef=CAN_CanIf_Phys_Rx
          CanTpNAe: CanTpNAe=0
    CanTpGeneral:
      CanTpChangeParameterApi = true
      CanTpDevErrorDetect = true
      CanTpPaddingByte = 170
      CanTpReadParameterApi = false
      CanTpVersionInfoApi = false
      CanTpSynchronousRxIndication = true
      CanTpRuntimeErrorDetect = true
      CanTpRxQueue = false
      CanTpSynchronousTransmission = false
      CanTpFlexibleDataRateSupport = false
