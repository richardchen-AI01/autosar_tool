AUTOSAR XML (schema 00048)
package /S32K148
  module config CanNm
    CanNmGlobalConfig:
      CanNmBusLoadReductionEnabled = false
      CanNmBusSynchronizationEnabled = false
      CanNmComControlEnabled = true
      CanNmComUserDataSupport = false
      CanNmCoordinatorSyncSupport = false
      CanNmDevErrorDetect = false
      CanNmGlobalPnSupport = true
      CanNmImmediateRestartEnabled = false
      CanNmImmediateTxconfEnabled = false
      CanNmMainFunctionPeriod = 0.005
      CanNmPassiveModeEnabled = false
      CanNmPduRxIndicationEnabled = false
      CanNmRemoteSleepIndEnabled = false
      CanNmStateChangeIndEnabled = true
      CanNmUserDataEnabled = false
      CanNmVersionInfoApi = false
      CanNmChCfg_ECU (CanNmChannelConfig):
        CanNmBusLoadReductionActive = false
        CanNmCarWakeUpRxEnabled = false
        CanNmImmediateNmTransmissions = 10
        CanNmMsgCycleOffset = 0.0
        CanNmMsgCycleTime = 1.0
        CanNmMsgReducedTime = 65.0
        CanNmNodeDetectionEnabled = true
        CanNmNodeId = 1
        CanNmNodeIdEnabled = true
        CanNmPduCbvPosition = CANNM_PDU_BYTE_1
        CanNmPduNidPosition = CANNM_PDU_BYTE_0
        CanNmRepeatMessageTime = 3.0
        CanNmRepeatMsgIndEnabled = false
        CanNmStayInPbsEnabled = false
        CanNmTimeoutTime = 3.0
        CanNmWaitBusSleepTime = 1.5
        CanNmActiveWakeupBitEnabled = true
        CanNmPnEnabled = true
        CanNmPnHandleMultipleNetworkRequests = false
        CanNmRetryFirstMessageRequest = true
        CanNmImmediateNmCycleTime = 0.02
        CanNmAllNmMessagesKeepAwake = true
        CanNmMsgTimeoutTime = 0.5
        CanNmComMNetworkHandleRef = ComMCh_ECU
        CanNmRx_CAN0_Rx_0x5xx_NM_ECU (CanNmRxPdu): CanNmRxPduId=0, CanNmRxPduRef=CANIF_CAN0_Rx_0x5xx_NM_ECU
        CanNmTx_CAN0_Tx_0x501_NM_ECU (CanNmTxPdu): CanNmTxConfirmationPduId=0, CanNmTxPduRef=CANIF_CAN0_Tx_0x501_NM_ECU
