AUTOSAR XML (schema 00048)
package /AUTOSAR/BswOverviews
  bsw module description CanTp: implemented-entrys=CanTp_MainFunction
    provided-client-server-entrys:
      5 x bsw module client server entry, all with is-synchronous=true:
        pCanTp_RxIndication: encapsulated-entry=CanTp_RxIndication
        pCanTp_TxConfirmation: encapsulated-entry=CanTp_TxConfirmation
        pCanTp_CancelReceive: encapsulated-entry=CanTp_CancelReceive
        pCanTp_CancelTransmit: encapsulated-entry=CanTp_CancelTransmit
        pCanTp_Transmit: encapsulated-entry=CanTp_Transmit
    bsw internal behavior IB_CanTp
      exclusive area ExclusiveArea
      bsw schedulable entity SE_CanTp_MainFunction: reentrancy-level=NON-REENTRANT, implemented-entry=CanTp_MainFunction
      5 x bsw called entity:
        CE_CanTp_RxIndication: implemented-entry=CanTp_RxIndication
        CE_CanTp_TxConfirmation: implemented-entry=CanTp_TxConfirmation
        CE_CanTp_CancelReceive: implemented-entry=CanTp_CancelReceive
        CE_CanTp_CancelTransmit: implemented-entry=CanTp_CancelTransmit
        CE_CanTp_Transmit: implemented-entry=CanTp_Transmit
      bsw timing event TE_CanTp_MainFunction: starts-on-event=SE_CanTp_MainFunction, period=0.005
      5 x bsw operation invoked event:
        OIE_CanTp_RxIndication: starts-on-event=CE_CanTp_RxIndication, entry=pCanTp_RxIndication
        OIE_CanTp_TxConfirmation: starts-on-event=CE_CanTp_TxConfirmation, entry=pCanTp_TxConfirmation
        OIE_CanTp_CancelReceive: starts-on-event=CE_CanTp_CancelReceive, entry=pCanTp_CancelReceive
        OIE_CanTp_CancelTransmit: starts-on-event=CE_CanTp_CancelTransmit, entry=pCanTp_CancelTransmit
        OIE_CanTp_Transmit: starts-on-event=CE_CanTp_Transmit, entry=pCanTp_Transmit
package /AUTOSAR/BswImplementations
  bsw implementation Imp_CanTp: programming-language=C, sw-version=2.1.2, vendor-id=62, ar-release-version=4.5.0, behavior=IB_CanTp
    code-descriptors:
      code code_0: artifact-descriptors=autosar-engineering-object={short-label=ComStack_Types.h, category=SWHDR}
    resource consumption RC_CanTp
      10 x memory section:
        CODE: sw-addrmethod=CODE
        CODE_FAST: sw-addrmethod=CODE
        CONFIG_DATA_UNSPECIFIED: sw-addrmethod=CONFIG_DATA
        CONFIG_DATA_8: sw-addrmethod=CONFIG_DATA
        VAR_CLEARED_8: sw-addrmethod=VAR_CLEARED
        VAR_CLEARED_32: sw-addrmethod=VAR_CLEARED
        VAR_CLEARED_BOOLEAN: sw-addrmethod=VAR_CLEARED
        VAR_CLEARED_UNSPECIFIED: sw-addrmethod=VAR_CLEARED
        VAR_CLEARED_PTR: sw-addrmethod=VAR_CLEARED
        VAR_INIT_UNSPECIFIED: sw-addrmethod=VAR_INIT
package /AUTOSAR/BswInterfaces
  6 x bsw module entry, all with is-synchronous=true, sw-service-impl-policy=STANDARD:
    CanTp_MainFunction: call-type=SCHEDULED, execution-context=TASK
    CanTp_RxIndication: service-id=66, call-type=CALLBACK, execution-context=UNSPECIFIED
      sw service arg RxPduId: direction=IN, implementation-data-type=PduInfoType
      sw service arg PduInfoPtr: direction=INOUT, implementation-data-type=PduInfoType, sw-impl-policy=CONST
    CanTp_TxConfirmation: service-id=64, call-type=CALLBACK, execution-context=UNSPECIFIED
      sw service arg TxPduId: direction=IN, implementation-data-type=PduIdType
      sw service arg result: direction=IN, implementation-data-type=Std_ReturnType
    CanTp_CancelReceive: service-id=73, call-type=REGULAR, execution-context=UNSPECIFIED
      return type ret: direction=OUT, implementation-data-type=Std_ReturnType
      sw service arg RxPduId: direction=IN, implementation-data-type=PduIdType
    CanTp_CancelTransmit: service-id=74, call-type=REGULAR, execution-context=UNSPECIFIED
      return type ret: direction=OUT, implementation-data-type=Std_ReturnType
      sw service arg TxPduId: direction=IN, implementation-data-type=PduIdType
    CanTp_Transmit: service-id=76, call-type=REGULAR, execution-context=UNSPECIFIED
      return type ret: direction=OUT, implementation-data-type=Std_ReturnType
      sw service arg TxPduId: direction=IN, implementation-data-type=PduIdType
      sw service arg PduInfoPtr: direction=INOUT, implementation-data-type=PduInfoType, sw-impl-policy=CONST
