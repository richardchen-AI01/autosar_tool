AUTOSAR XML (schema 00048)
package /AUTOSAR/BswOverviews
  bsw module description PduR: module-id=51
    bsw internal behavior IB_PduR
      exclusive area ExclusiveArea_Route
      exclusive area ExclusiveArea_Init
package /AUTOSAR/BswInterfaces
  bsw module entry PduR_Init: service-id=240, is-synchronous=true, call-type=REGULAR, execution-context=UNSPECIFIED, sw-service-impl-policy=STANDARD
package /AUTOSAR/BswImplementations
  bsw implementation Imp_PduR: programming-language=C, sw-version=1.0.0, ar-release-version=4.5.0, behavior=IB_PduR
    resource consumption RC_PduR
      13 x memory section:
        CODE: sw-addrmethod=CODE
        VAR_INIT_8: sw-addrmethod=VAR_INIT
        VAR_INIT_PTR: sw-addrmethod=VAR_INIT
        VAR_INIT_UNSPECIFIED: sw-addrmethod=VAR_INIT
        VAR_CLEARED_BOOLEAN: sw-addrmethod=VAR_CLEARED
        VAR_CLEARED_8: sw-addrmethod=VAR_CLEARED
        VAR_CLEARED_16: sw-addrmethod=VAR_CLEARED
        VAR_CLEARED_32: sw-addrmethod=VAR_CLEARED
        VAR_CLEARED_PTR: sw-addrmethod=VAR_CLEARED
        VAR_CLEARED_UNSPECIFIED: sw-addrmethod=VAR_CLEARED
        CONFIG_DATA_8: sw-addrmethod=CONFIG_DATA
        CONFIG_DATA_16: sw-addrmethod=CONFIG_DATA
        CONFIG_DATA_UNSPECIFIED: sw-addrmethod=CONFIG_DATA
