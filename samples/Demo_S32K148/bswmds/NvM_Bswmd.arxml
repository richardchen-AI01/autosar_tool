AUTOSAR XML (schema 00048)
package /AUTOSAR/BswOverviews
  bsw module description NvM: implemented-entrys=NvM_MainFunction
    bsw internal behavior IB_NvM
      exclusive area Queue
      bsw schedulable entity SE_NvM_MainFunction: reentrancy-level=NON-REENTRANT, implemented-entry=NvM_MainFunction
      bsw timing event TE_NvM_MainFunction: category=Memory, starts-on-event=SE_NvM_MainFunction, period=0.005
      bsw distinguished partition NvM_EcucPartition
package /AUTOSAR/BswImplementations
  bsw implementation Imp_NvM: programming-language=C, sw-version=3.0.0, vendor-id=62, ar-release-version=4.9.0, behavior=IB_NvM
    resource consumption RC_NvM
      11 x memory section:
        CODE: sw-addrmethod=CODE
        CONST_UNSPECIFIED: sw-addrmethod=CONST
        VAR_INIT_UNSPECIFIED: sw-addrmethod=VAR_INIT
        VAR_INIT_16: sw-addrmethod=VAR_INIT
        VAR_CLEARED_UNSPECIFIED: sw-addrmethod=VAR_CLEARED
        VAR_CLEARED_8: sw-addrmethod=VAR_CLEARED
        VAR_CLEARED_16: sw-addrmethod=VAR_CLEARED
        VAR_CLEARED_32: sw-addrmethod=VAR_CLEARED
        CONST_PTR: sw-addrmethod=CONST
        CONFIG_DATA_PTR: sw-addrmethod=CONFIG_DATA
        CONFIG_DATA_UNSPECIFIED: sw-addrmethod=CONFIG_DATA
package /AUTOSAR/BswInterfaces
  bsw module entry NvM_MainFunction: is-synchronous=true, call-type=SCHEDULED, execution-context=TASK, sw-service-impl-policy=STANDARD
