AUTOSAR XML (schema 00048)
package /AUTOSAR/BswOverviews
  bsw module description WdgM: implemented-entrys=WdgM_MainFunction
    bsw internal behavior IB_WdgM
      exclusive area Exclusive
      bsw schedulable entity SE_WdgM_MainFunction: implemented-entry=WdgM_MainFunction
      bsw timing event TE_WdgM_MainFunction: starts-on-event=SE_WdgM_MainFunction, period=0.01
package /AUTOSAR/BswInterfaces
  bsw module entry WdgM_MainFunction: is-reentrant=true, is-synchronous=true, call-type=SCHEDULED, execution-context=TASK, sw-service-impl-policy=STANDARD
package /AUTOSAR/BswImplementations
  bsw implementation Imp_WdgM: programming-language=C, sw-version=2.2.0, vendor-id=62, ar-release-version=4.5.0, behavior=IB_WdgM
    resource consumption RC_WdgM
      10 x memory section:
        CODE: sw-addrmethod=CODE
        CONFIG_DATA_UNSPECIFIED: sw-addrmethod=CONFIG_DATA
        VAR_CLEARED_CORE0_UNSPECIFIED: sw-addrmethod=VAR_CLEARED
        VAR_INIT_CORE0_UNSPECIFIED: sw-addrmethod=VAR_INIT
        VAR_CLEARED_8: sw-addrmethod=VAR_CLEARED
        VAR_CLEARED_16: sw-addrmethod=VAR_CLEARED
        VAR_CLEARED_UNSPECIFIED: sw-addrmethod=VAR_CLEARED
        VAR_INIT_8: sw-addrmethod=VAR_INIT
        VAR_FAST_INIT_GLOBAL_PTR: sw-addrmethod=VAR_FAST_INIT
        VAR_POWER_ON_CLEARED_16: sw-addrmethod=VAR_POWER_ON_CLEARED
