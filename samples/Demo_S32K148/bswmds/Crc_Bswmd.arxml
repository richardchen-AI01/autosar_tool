AUTOSAR XML (schema 00048)
package /AUTOSAR/BswImplementations
  bsw implementation Imp_Crc: programming-language=CPP, sw-version=3.0.0, ar-release-version=4.9.0, behavior=IB_Crc
    resource consumption RC
      5 x memory section:
        CODE: sw-addrmethod=CODE
        CONST_16: sw-addrmethod=CONST
        CONST_32: sw-addrmethod=CONST
        CONST_64: sw-addrmethod=CONST
        CONST_8: sw-addrmethod=CONST
package /AUTOSAR/BswOverviews
  bsw module description Crc
    bsw internal behavior IB_Crc
