AUTOSAR XML (schema 00048)
package /AUTOSAR/BswOverviews
  bsw module description Nm: module-id=29, category=BSW_MODULE, implemented-entrys=Nm_MainFunction_ComMCh_ECU
    bsw internal behavior IB_Nm
      exclusive area Coordinator
      exclusive area IRA
      bsw schedulable entity Nm_MainFunction_ComMCh_ECU: implemented-entry=Nm_MainFunction_ComMCh_ECU
      bsw timing event TE_Nm_MainFunction_ComMCh_ECU: starts-on-event=Nm_MainFunction_ComMCh_ECU, context-limitation=Nm_, period=0.005
package /AUTOSAR/BswImplementations
  bsw implementation Imp_Nm: programming-language=C, sw-version=2.2.1, vendor-id=62, ar-release-version=4.9.0, behavior=IB_Nm
    resource consumption RC_Nm
      9 x memory section:
        CONFIG_DATA_PTR: alignment=PTR, sw-addrmethod=CONFIG_DATA
        CONFIG_DATA_UNSPECIFIED: alignment=UNSPECIFIED, sw-addrmethod=CONFIG_DATA
        CONFIG_DATA_32: alignment=32, sw-addrmethod=CONFIG_DATA
        CONFIG_DATA_8: alignment=8, sw-addrmethod=CONFIG_DATA
        VAR_CLEARED_16: alignment=16, sw-addrmethod=VAR_CLEARED
        CODE: sw-addrmethod=CODE
        VAR_CLEARED_8: alignment=8, sw-addrmethod=VAR_CLEARED
        VAR_CLEARED_BOOLEAN: alignment=BOOLEAN, sw-addrmethod=VAR_CLEARED
        VAR_CLEARED_UNSPECIFIED: alignment=UNSPECIFIED, sw-addrmethod=VAR_CLEARED
package /AUTOSAR/BswInterfaces
  bsw module entry Nm_MainFunction_ComMCh_ECU: call-type=SCHEDULED, execution-context=TASK, sw-service-impl-policy=STANDARD
