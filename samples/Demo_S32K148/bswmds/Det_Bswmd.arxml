AUTOSAR XML (schema 00048)
package /AUTOSAR/BswOverviews
  bsw module description Det: category=BSW_MODULE, module-id=34  # Det Driver
    bsw internal behavior IB_Det
      exclusive area DET_EXCLUSIVE_AREA_0
      exclusive area DET_EXCLUSIVE_AREA_1
package /AUTOSAR/BswImplementations
  bsw implementation Imp_Det: programming-language=C, sw-version=2.2.0, vendor-id=62, ar-release-version=4.5.0, behavior=IB_Det, vendor-api-infix=abc
    code-descriptors:
      code Code: artifact-descriptors=autosar-engineering-object={short-label=ComStack_Types.h, category=SWHDR}
    resource consumption RC_Det
      14 x memory section:
        CODE: sw-addrmethod=CODE
        CONFIG_DATA_16: sw-addrmethod=CONFIG_DATA
        CONFIG_DATA_32: sw-addrmethod=CONFIG_DATA
        CONFIG_DATA_8: sw-addrmethod=CONFIG_DATA
        CONFIG_DATA_UNSPECIFIED: sw-addrmethod=CONFIG_DATA
        CONST_UNSPECIFIED: sw-addrmethod=CONST
        VAR_CLEARED_16: sw-addrmethod=VAR_CLEARED
        VAR_CLEARED_32: sw-addrmethod=VAR_CLEARED
        VAR_CLEARED_8: sw-addrmethod=VAR_CLEARED
        VAR_CLEARED_BOOLEAN: sw-addrmethod=VAR_CLEARED
        VAR_CLEARED_UNSPECIFIED: sw-addrmethod=VAR_CLEARED
        VAR_INIT_8: sw-addrmethod=VAR_INIT
        VAR_INIT_PTR: sw-addrmethod=VAR_INIT
        VAR_CLEARED__UNSPECIFIED: sw-addrmethod=VAR_CLEARED
