AUTOSAR XML (schema 00048)
package /AUTOSAR/BswOverviews
  bsw module description MemIf
    bsw internal behavior IB_MemIf
package /AUTOSAR/BswImplementations
  bsw implementation Imp_MemIf: programming-language=C, sw-version=3.0.0, vendor-id=62, ar-release-version=4.9.0, behavior=IB_MemIf
    resource consumption RC_MemIf
      memory section CODE: sw-addrmethod=CODE
      memory section CONFIG_DATA_PTR: sw-addrmethod=CONFIG_DATA
