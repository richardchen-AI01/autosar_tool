AUTOSAR XML (schema 00048)
package /AUTOSAR/BswOverviews
  bsw module description Dcm: implemented-entrys=Dcm_MainFunction, module-id=53
    provided-mode-groups:
      5 x mode declaration group prototype:
        DcmDiagnosticSessionControl: type=DcmDiagnosticSessionControl
        DcmEcuReset: type=DcmEcuReset
        DcmModeRapidPowerShutDown: type=DcmModeRapidPowerShutDown
        DcmControlDTCSetting: type=DcmControlDTCSetting
        DcmSecurityAccess: type=DcmSecurityAccess
    bsw internal behavior IB_Dcm
      exclusive area ExclusiveArea
      bsw schedulable entity Dcm_MainFunction: implemented-entry=Dcm_MainFunction
      bsw timing event TE_Dcm_MainFunction: starts-on-event=Dcm_MainFunction, period=0.005
package /AUTOSAR/BswInterfaces
  13 x bsw module entry, all with sw-service-impl-policy=STANDARD:
    Dcm_MainFunction: service-id=37, call-type=SCHEDULED, execution-context=TASK
    Dcm_StartOfReception: service-id=70, is-reentrant=true, is-synchronous=true, call-type=CALLBACK, execution-context=INTERRUPT-CAT-2
      return type ret: direction=OUT, implementation-data-type=BufReq_ReturnType
      4 x sw service arg, all with category=TYPE_REFERENCE:
        id: direction=IN, implementation-data-type=PduIdType
        info: direction=INOUT, implementation-data-type=PduInfoType, sw-impl-policy=CONST
        TpSduLength: direction=IN, implementation-data-type=PduLengthType
        bufferSizePtr: direction=OUT, implementation-data-type=PduLengthType
    Dcm_CopyRxData: service-id=68, is-reentrant=true, is-synchronous=true, call-type=CALLBACK, execution-context=INTERRUPT-CAT-2
      return type ret: direction=OUT, implementation-data-type=BufReq_ReturnType
      sw service arg id: direction=IN, implementation-data-type=PduIdType
      sw service arg info: direction=INOUT, implementation-data-type=PduInfoType, sw-impl-policy=CONST
      sw service arg bufferSizePtr: direction=OUT, implementation-data-type=PduLengthType
    Dcm_TpRxIndication: service-id=69, is-reentrant=true, is-synchronous=true, call-type=CALLBACK, execution-context=INTERRUPT-CAT-2
      sw service arg id: direction=IN, implementation-data-type=PduIdType
      sw service arg result: direction=IN, implementation-data-type=Std_ReturnType
    Dcm_CopyTxData: service-id=67, is-reentrant=true, is-synchronous=true, call-type=CALLBACK, execution-context=INTERRUPT-CAT-2
      return type ret: direction=OUT, implementation-data-type=BufReq_ReturnType
      4 x sw service arg, all with category=TYPE_REFERENCE:
        id: direction=IN, implementation-data-type=PduIdType
        info: direction=INOUT, implementation-data-type=PduInfoType, sw-impl-policy=CONST
        retry: direction=INOUT, implementation-data-type=RetryInfoType, sw-impl-policy=CONST
        availableDataPtr: direction=OUT, implementation-data-type=PduLengthType
    Dcm_TpTxConfirmation: service-id=72, is-reentrant=true, is-synchronous=true, call-type=CALLBACK, execution-context=INTERRUPT-CAT-2
      sw service arg id: direction=IN, implementation-data-type=PduIdType
      sw service arg result: direction=IN, implementation-data-type=Std_ReturnType
    Dcm_TxConfirmation: service-id=64, is-reentrant=true, is-synchronous=true, call-type=CALLBACK, execution-context=INTERRUPT-CAT-2
      sw service arg TxPduId: direction=IN, implementation-data-type=PduIdType
      sw service arg result: direction=IN, implementation-data-type=Std_ReturnType
    Dcm_ComM_NoComModeEntered: service-id=33, is-reentrant=true, is-synchronous=true, call-type=CALLBACK, execution-context=TASK
      sw service arg NetworkId: category=VALUE, direction=IN, base-type=uint8
    Dcm_ComM_SilentComModeEntered: service-id=34, is-reentrant=true, is-synchronous=true, call-type=CALLBACK, execution-context=TASK
      sw service arg NetworkId: category=VALUE, direction=IN, base-type=uint8
    Dcm_ComM_FullComModeEntered: service-id=35, is-reentrant=true, is-synchronous=true, call-type=CALLBACK, execution-context=TASK
      sw service arg NetworkId: category=VALUE, direction=IN, base-type=uint8
    Dcm_CsmAsyncJobFinished: is-reentrant=true, is-synchronous=true, call-type=CALLBACK, execution-context=TASK
      sw service arg jobId: category=VALUE, direction=IN, base-type=uint32
      sw service arg result: direction=IN, implementation-data-type=Crypto_ResultType
    Dcm_KeyMAsyncCertificateVerifyFinished: is-reentrant=true, is-synchronous=true, call-type=CALLBACK, execution-context=TASK
      sw service arg CertID: direction=IN, implementation-data-type=KeyM_CertificateIdType
      sw service arg Result: direction=IN, implementation-data-type=KeyM_CertificateStatusType
    Dcm_SatelliteMainFunction: is-reentrant=false, call-type=SCHEDULED, execution-context=TASK
package /AUTOSAR/BswImplementations
  bsw implementation Imp_Dcm: programming-language=C, sw-version=2.2.1, vendor-id=62, ar-release-version=4.9.0, behavior=IB_Dcm
    resource consumption RC_Dem
      16 x memory section:
        CODE: sw-addrmethod=CODE
        CODE_FAST: sw-addrmethod=CODE
        CALLOUT_CODE: sw-addrmethod=CODE
        VAR_CLEARED_16: sw-addrmethod=VAR_CLEARED
        VAR_CLEARED_32: sw-addrmethod=VAR_CLEARED
        VAR_CLEARED_8: sw-addrmethod=VAR_CLEARED
        VAR_CLEARED_BOOLEAN: sw-addrmethod=VAR_CLEARED
        VAR_CLEARED_UNSPECIFIED: sw-addrmethod=VAR_CLEARED
        VAR_INIT_8: sw-addrmethod=VAR_INIT
        VAR_INIT_16: sw-addrmethod=VAR_INIT
        VAR_INIT_BOOLEAN: sw-addrmethod=VAR_INIT
        VAR_INIT_PTR: sw-addrmethod=VAR_INIT
        CONFIG_DATA_8: sw-addrmethod=CONFIG_DATA
        CONFIG_DATA_16: sw-addrmethod=CONFIG_DATA
        CONFIG_DATA_UNSPECIFIED: sw-addrmethod=CONFIG_DATA
        CONFIG_DATA_BOOLEAN: sw-addrmethod=CONFIG_DATA
package /AUTOSAR/ModeDeclarationGroups
  mode declaration group DcmDiagnosticSessionControl: category=EXPLICIT_ORDER, initial-mode=DCM_DEFAULT_SESSION, on-transition-value=255
    4 x mode:
      DCM_DEFAULT_SESSION: value=0
      DCM_PROGRAMMING_SESSION: value=1
      DCM_EXTENDED_DIAGNOSTIC_SESSION: value=2
      DCM_SAFETY_SYSTEM_DIAGNOSTIC_SESSION: value=3
  data type mapping set DCMDataTypeMappingSet
    mode-request-type-maps:
      implementation-data-type=UInt8, mode-group=DcmDiagnosticSessionControl
      implementation-data-type=UInt8, mode-group=DcmEcuReset
      implementation-data-type=UInt8, mode-group=DcmModeRapidPowerShutDown
      implementation-data-type=UInt8, mode-group=DcmCommunicationControl
      implementation-data-type=UInt8, mode-group=DcmCommunicationControl
      implementation-data-type=UInt8, mode-group=DcmControlDTCSetting
      implementation-data-type=UInt8, mode-group=DcmSecurityAccess
  5 x mode declaration group, all with category=EXPLICIT_ORDER:
    DcmEcuReset
      7 x mode:
        DCM_NONE: value=0
        DCM_HARD: value=1
        DCM_KEYONOFF: value=2
        DCM_SOFT: value=3
        DCM_JUMPTOBOOTLOADER: value=4
        DCM_JUMPTOSYSSUPPLIERBOOTLOADER: value=5
        DCM_EXECUTE: value=6
    DcmModeRapidPowerShutDown: initial-mode=DCM_ENABLE_RAPIDPOWERSHUTDOWN, on-transition-value=255
      mode DCM_ENABLE_RAPIDPOWERSHUTDOWN: value=0
      mode DCM_DISABLE_RAPIDPOWERSHUTDOWN: value=1
    DcmCommunicationControl: initial-mode=DCM_ENABLE_RX_TX_NORM_NM, on-transition-value=255
      12 x mode:
        DCM_ENABLE_RX_TX_NORM: value=0
        DCM_ENABLE_RX_DISABLE_TX_NORM: value=1
        DCM_DISABLE_RX_ENABLE_TX_NORM: value=2
        DCM_DISABLE_RX_TX_NORMAL: value=3
        DCM_ENABLE_RX_TX_NM: value=4
        DCM_ENABLE_RX_DISABLE_TX_NM: value=5
        DCM_DISABLE_RX_ENABLE_TX_NM: value=6
        DCM_DISABLE_RX_TX_NM: value=7
        DCM_ENABLE_RX_TX_NORM_NM: value=8
        DCM_ENABLE_RX_DISABLE_TX_NORM_NM: value=9
        DCM_DISABLE_RX_ENABLE_TX_NORM_NM: value=10
        DCM_DISABLE_RX_TX_NORM_NM: value=11
    DcmControlDTCSetting: initial-mode=ENABLEDTCSETTING, on-transition-value=255
      mode ENABLEDTCSETTING: value=0
      mode DISABLEDTCSETTING: value=1
    DcmSecurityAccess: initial-mode=DCM_SEC_LEV_LOCKED, on-transition-value=255
      mode DCM_SEC_LEV_LOCKED: value=0
