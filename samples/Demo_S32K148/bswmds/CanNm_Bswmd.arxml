AUTOSAR XML (schema 00048)
package /AUTOSAR_CanNm/BswOverviews
  bsw module description CanNm: module-id=33, category=BSW_MODULE, implemented-entrys=CanNm_MainFunction_ComMCh_ECU
    bsw internal behavior IB_CanNm
      exclusive area Context
      bsw schedulable entity CanNm_MainFunction_ComMCh_ECU: implemented-entry=CanNm_MainFunction_ComMCh_ECU
      bsw timing event TimingEvent_CanNm_MainFunction_ComMCh_ECU: starts-on-event=CanNm_MainFunction_ComMCh_ECU, period=0.005
package /AUTOSAR_CanNm/BswImplementations
  bsw implementation Imp_CanNm: programming-language=C, sw-version=2.2.1, vendor-id=62, ar-release-version=4.9.0, behavior=IB_CanNm
    resource consumption RC_CanNm
      13 x memory section:
        VAR_CLEARED_UNSPECIFIED: alignment=UNSPECIFIED, sw-addrmethod=VAR_CLEARED
        VAR_CLEARED_PTR: alignment=PTR, sw-addrmethod=VAR_CLEARED
        VAR_CLEARED_32: alignment=32, sw-addrmethod=VAR_CLEARED
        VAR_CLEARED_16: alignment=16, sw-addrmethod=VAR_CLEARED
        VAR_CLEARED_8: alignment=8, sw-addrmethod=VAR_CLEARED
        VAR_CLEARED_BOOLEAN: alignment=BOOLEAN, sw-addrmethod=VAR_CLEARED
        CONFIG_DATA_UNSPECIFIED: alignment=UNSPECIFIED, sw-addrmethod=CONFIG_DATA
        CONFIG_DATA_PTR: alignment=PTR, sw-addrmethod=CONFIG_DATA
        CONFIG_DATA_32: alignment=32, sw-addrmethod=CONFIG_DATA
        CONFIG_DATA_16: alignment=16, sw-addrmethod=CONFIG_DATA
        CONFIG_DATA_8: alignment=8, sw-addrmethod=CONFIG_DATA
        CONFIG_DATA_BOOLEAN: alignment=BOOLEAN, sw-addrmethod=CONFIG_DATA
        CODE: sw-addrmethod=CODE
package /AUTOSAR_CanNm/BswInterfaces
  bsw module entry CanNm_MainFunction_ComMCh_ECU: call-type=SCHEDULED, execution-context=TASK, sw-service-impl-policy=STANDARD
