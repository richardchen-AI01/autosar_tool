AUTOSAR XML (schema 00048)
standard types defined: Std_ReturnType
package /AUTOSAR/RteOverviews
  bsw module description Rte
    bsw internal behavior IB_Rte
package /AUTOSAR/BswOverviews
  bsw module description SchM
    bsw internal behavior IB_SchM
      bsw called entity CE_SchM_Service_Function_Core0: implemented-entry=SchM_Service_Function_Core0
      bsw operation invoked event BOIE_SchM_Service_Function_Core0: starts-on-event=CE_SchM_Service_Function_Core0, context-limitation=SchM_Core0
      bsw distinguished partition SchM_Core0
package /AUTOSAR/BswImplementations
  bsw implementation Imp_Rte: behavior=IB_Rte
    resource consumption RC_Rte
      91 x memory section:
        VAR_CLEARED_GLOBAL_BOOLEAN: alignment=BOOLEAN, sw-addrmethod=VAR_CLEARED
        VAR_CLEARED_GLOBAL_8: alignment=8, sw-addrmethod=VAR_CLEARED
        VAR_CLEARED_GLOBAL_16: alignment=16, sw-addrmethod=VAR_CLEARED
        VAR_CLEARED_GLOBAL_32: alignment=32, sw-addrmethod=VAR_CLEARED
        VAR_CLEARED_GLOBAL_64: alignment=64, sw-addrmethod=VAR_CLEARED
        VAR_CLEARED_GLOBAL_PTR: alignment=PTR, sw-addrmethod=VAR_CLEARED
        VAR_CLEARED_GLOBAL_UNSPECIFIED: alignment=UNSPECIFIED, sw-addrmethod=VAR_CLEARED
        VAR_INIT_GLOBAL_BOOLEAN: alignment=BOOLEAN, sw-addrmethod=VAR_INIT
        VAR_INIT_GLOBAL_8: alignment=8, sw-addrmethod=VAR_INIT
        VAR_INIT_GLOBAL_16: alignment=16, sw-addrmethod=VAR_INIT
        VAR_INIT_GLOBAL_32: alignment=32, sw-addrmethod=VAR_INIT
        VAR_INIT_GLOBAL_64: alignment=64, sw-addrmethod=VAR_INIT
        VAR_INIT_GLOBAL_PTR: alignment=PTR, sw-addrmethod=VAR_INIT
        VAR_INIT_GLOBAL_UNSPECIFIED: alignment=UNSPECIFIED, sw-addrmethod=VAR_INIT
        VAR_POWER_ON_CLEARED_GLOBAL_BOOLEAN: alignment=BOOLEAN, sw-addrmethod=VAR_POWER_ON_CLEARED
        VAR_POWER_ON_CLEARED_GLOBAL_8: alignment=8, sw-addrmethod=VAR_POWER_ON_CLEARED
        VAR_POWER_ON_CLEARED_GLOBAL_16: alignment=16, sw-addrmethod=VAR_POWER_ON_CLEARED
        VAR_POWER_ON_CLEARED_GLOBAL_32: alignment=32, sw-addrmethod=VAR_POWER_ON_CLEARED
        VAR_POWER_ON_CLEARED_GLOBAL_64: alignment=64, sw-addrmethod=VAR_POWER_ON_CLEARED
        VAR_POWER_ON_CLEARED_GLOBAL_PTR: alignment=PTR, sw-addrmethod=VAR_POWER_ON_CLEARED
        VAR_POWER_ON_CLEARED_GLOBAL_UNSPECIFIED: alignment=UNSPECIFIED, sw-addrmethod=VAR_POWER_ON_CLEARED
        VAR_FAST_CLEARED_GLOBAL_BOOLEAN: alignment=BOOLEAN, sw-addrmethod=VAR_FAST_CLEARED
        VAR_FAST_CLEARED_GLOBAL_8: alignment=8, sw-addrmethod=VAR_FAST_CLEARED
        VAR_FAST_CLEARED_GLOBAL_16: alignment=16, sw-addrmethod=VAR_FAST_CLEARED
        VAR_FAST_CLEARED_GLOBAL_32: alignment=32, sw-addrmethod=VAR_FAST_CLEARED
        VAR_FAST_CLEARED_GLOBAL_64: alignment=64, sw-addrmethod=VAR_FAST_CLEARED
        VAR_FAST_CLEARED_GLOBAL_PTR: alignment=PTR, sw-addrmethod=VAR_FAST_CLEARED
        VAR_FAST_CLEARED_GLOBAL_UNSPECIFIED: alignment=UNSPECIFIED, sw-addrmethod=VAR_FAST_CLEARED
        VAR_FAST_INIT_GLOBAL_BOOLEAN: alignment=BOOLEAN, sw-addrmethod=VAR_FAST_INIT
        VAR_FAST_INIT_GLOBAL_8: alignment=8, sw-addrmethod=VAR_FAST_INIT
        VAR_FAST_INIT_GLOBAL_16: alignment=16, sw-addrmethod=VAR_FAST_INIT
        VAR_FAST_INIT_GLOBAL_32: alignment=32, sw-addrmethod=VAR_FAST_INIT
        VAR_FAST_INIT_GLOBAL_64: alignment=64, sw-addrmethod=VAR_FAST_INIT
        VAR_FAST_INIT_GLOBAL_PTR: alignment=PTR, sw-addrmethod=VAR_FAST_INIT
        VAR_FAST_INIT_GLOBAL_UNSPECIFIED: alignment=UNSPECIFIED, sw-addrmethod=VAR_FAST_INIT
        VAR_FAST_POWER_ON_CLEARED_GLOBAL_BOOLEAN: alignment=BOOLEAN, sw-addrmethod=VAR_FAST_POWER_ON_CLEARED
        VAR_FAST_POWER_ON_CLEARED_GLOBAL_8: alignment=8, sw-addrmethod=VAR_FAST_POWER_ON_CLEARED
        VAR_FAST_POWER_ON_CLEARED_GLOBAL_16: alignment=16, sw-addrmethod=VAR_FAST_POWER_ON_CLEARED
        VAR_FAST_POWER_ON_CLEARED_GLOBAL_32: alignment=32, sw-addrmethod=VAR_FAST_POWER_ON_CLEARED
        VAR_FAST_POWER_ON_CLEARED_GLOBAL_64: alignment=64, sw-addrmethod=VAR_FAST_POWER_ON_CLEARED
        VAR_FAST_POWER_ON_CLEARED_GLOBAL_PTR: alignment=PTR, sw-addrmethod=VAR_FAST_POWER_ON_CLEARED
        VAR_FAST_POWER_ON_CLEARED_GLOBAL_UNSPECIFIED: alignment=UNSPECIFIED, sw-addrmethod=VAR_FAST_POWER_ON_CLEARED
        INTERNAL_VAR_CLEARED_GLOBAL_BOOLEAN: alignment=BOOLEAN, sw-addrmethod=INTERNAL_VAR_CLEARED
        INTERNAL_VAR_CLEARED_GLOBAL_8: alignment=8, sw-addrmethod=INTERNAL_VAR_CLEARED
        INTERNAL_VAR_CLEARED_GLOBAL_16: alignment=16, sw-addrmethod=INTERNAL_VAR_CLEARED
        INTERNAL_VAR_CLEARED_GLOBAL_32: alignment=32, sw-addrmethod=INTERNAL_VAR_CLEARED
        INTERNAL_VAR_CLEARED_GLOBAL_64: alignment=64, sw-addrmethod=INTERNAL_VAR_CLEARED
        INTERNAL_VAR_CLEARED_GLOBAL_PTR: alignment=PTR, sw-addrmethod=INTERNAL_VAR_CLEARED
        INTERNAL_VAR_CLEARED_GLOBAL_UNSPECIFIED: alignment=UNSPECIFIED, sw-addrmethod=INTERNAL_VAR_CLEARED
        INTERNAL_VAR_INIT_GLOBAL_BOOLEAN: alignment=BOOLEAN, sw-addrmethod=INTERNAL_VAR_INIT
        INTERNAL_VAR_INIT_GLOBAL_8: alignment=8, sw-addrmethod=INTERNAL_VAR_INIT
        INTERNAL_VAR_INIT_GLOBAL_16: alignment=16, sw-addrmethod=INTERNAL_VAR_INIT
        INTERNAL_VAR_INIT_GLOBAL_32: alignment=32, sw-addrmethod=INTERNAL_VAR_INIT
        INTERNAL_VAR_INIT_GLOBAL_64: alignment=64, sw-addrmethod=INTERNAL_VAR_INIT
        INTERNAL_VAR_INIT_GLOBAL_PTR: alignment=PTR, sw-addrmethod=INTERNAL_VAR_INIT
        INTERNAL_VAR_INIT_GLOBAL_UNSPECIFIED: alignment=UNSPECIFIED, sw-addrmethod=INTERNAL_VAR_INIT
        INTERNAL_VAR_POWER_ON_CLEARED_GLOBAL_BOOLEAN: alignment=BOOLEAN, sw-addrmethod=INTERNAL_VAR_POWER_ON_CLEARED
        INTERNAL_VAR_POWER_ON_CLEARED_GLOBAL_8: alignment=8, sw-addrmethod=INTERNAL_VAR_POWER_ON_CLEARED
        INTERNAL_VAR_POWER_ON_CLEARED_GLOBAL_16: alignment=16, sw-addrmethod=INTERNAL_VAR_POWER_ON_CLEARED
        INTERNAL_VAR_POWER_ON_CLEARED_GLOBAL_32: alignment=32, sw-addrmethod=INTERNAL_VAR_POWER_ON_CLEARED
        INTERNAL_VAR_POWER_ON_CLEARED_GLOBAL_64: alignment=64, sw-addrmethod=INTERNAL_VAR_POWER_ON_CLEARED
        INTERNAL_VAR_POWER_ON_CLEARED_GLOBAL_PTR: alignment=PTR, sw-addrmethod=INTERNAL_VAR_POWER_ON_CLEARED
        INTERNAL_VAR_POWER_ON_CLEARED_GLOBAL_UNSPECIFIED: alignment=UNSPECIFIED, sw-addrmethod=INTERNAL_VAR_POWER_ON_CLEARED
        CONST_BOOLEAN: alignment=BOOLEAN, sw-addrmethod=CONST
        CONST_8: alignment=8, sw-addrmethod=CONST
        CONST_16: alignment=16, sw-addrmethod=CONST
        CONST_32: alignment=32, sw-addrmethod=CONST
        CONST_64: alignment=64, sw-addrmethod=CONST
        CONST_PTR: alignment=PTR, sw-addrmethod=CONST
        CONST_UNSPECIFIED: alignment=UNSPECIFIED, sw-addrmethod=CONST
        CONFIG_DATA_BOOLEAN: alignment=BOOLEAN, sw-addrmethod=CONFIG_DATA
        CONFIG_DATA_8: alignment=8, sw-addrmethod=CONFIG_DATA
        CONFIG_DATA_16: alignment=16, sw-addrmethod=CONFIG_DATA
        CONFIG_DATA_32: alignment=32, sw-addrmethod=CONFIG_DATA
        CONFIG_DATA_64: alignment=64, sw-addrmethod=CONFIG_DATA
        CONFIG_DATA_PTR: alignment=PTR, sw-addrmethod=CONFIG_DATA
        CONFIG_DATA_UNSPECIFIED: alignment=UNSPECIFIED, sw-addrmethod=CONFIG_DATA
        CALIB_BOOLEAN: alignment=BOOLEAN, sw-addrmethod=CALIB
        CALIB_8: alignment=8, sw-addrmethod=CALIB
        CALIB_16: alignment=16, sw-addrmethod=CALIB
        CALIB_32: alignment=32, sw-addrmethod=CALIB
        CALIB_64: alignment=64, sw-addrmethod=CALIB
        CALIB_PTR: alignment=PTR, sw-addrmethod=CALIB
        CALIB_UNSPECIFIED: alignment=UNSPECIFIED, sw-addrmethod=CALIB
        CODE_GLOBAL: sw-addrmethod=CODE
        CODE_FAST_GLOBAL: sw-addrmethod=CODE_FAST
        CALLOUT_CODE_GLOBAL: sw-addrmethod=CALLOUT_CODE
        VAR_INIT_UNSPECIFIED: alignment=UNSPECIFIED, sw-addrmethod=VAR_INIT
        VAR_CLEARED_UNSPECIFIED: alignment=UNSPECIFIED, sw-addrmethod=VAR_CLEARED
        CONST_UNSPECIFIED: alignment=UNSPECIFIED, sw-addrmethod=CONST
        CODE: sw-addrmethod=CODE
  bsw implementation Imp_SchM: programming-language=C, sw-version=3.0.0, vendor-id=62, ar-release-version=4.9.0, behavior=IB_SchM
package /AUTOSAR/BswInterfaces
  bsw module entry SchM_Service_Function_Core0: call-type=REGULAR
package /AUTOSAR/DataTypes
  78 x impl type:
    Rte_CAN0_Rx_0x251_Cyclic_PN29_Sig_CAN0_Rx_0x251_Cyclic_PN29_IOCData_Type: category=STRUCTURE
    Rte_CAN0_Rx_0x250_Cyclic_PN17_Sig_CAN0_Rx_0x250_Cyclic_PN17_IOCData_Type: category=STRUCTURE
    Rte_CAN0_Rx_0x200_Sig_4_U31_CAN0_Rx_0x200_Cyclic_IOCData_Type: category=STRUCTURE
    Rte_CAN0_Rx_0x200_Sig_3_U15_CAN0_Rx_0x200_Cyclic_IOCData_Type: category=STRUCTURE
    Rte_CAN0_Rx_0x200_Sig_2_U6_CAN0_Rx_0x200_Cyclic_IOCData_Type: category=STRUCTURE
    Rte_CAN0_Rx_0x200_Sig_1_U4_CAN0_Rx_0x200_Cyclic_IOCData_Type: category=STRUCTURE
    Rte_CAN0_Rx_0x201_Sig_4_U32_CAN0_Rx_0x201_Event_IOCData_Type: category=STRUCTURE
    Rte_CAN0_Rx_0x201_Sig_3_U16_CAN0_Rx_0x201_Event_IOCData_Type: category=STRUCTURE
    Rte_CAN0_Rx_0x201_Sig_2_U8_CAN0_Rx_0x201_Event_IOCData_Type: category=STRUCTURE
    Rte_CAN0_Rx_0x201_Sig_1_U3_CAN0_Rx_0x201_Event_IOCData_Type: category=STRUCTURE
    Rte_CAN0_Rx_0x202_Sig_7_U2_CAN0_Rx_0x202_Mixed_IOCData_Type: category=STRUCTURE
    Rte_CAN0_Rx_0x202_Sig_6_U1_CAN0_Rx_0x202_Mixed_IOCData_Type: category=STRUCTURE
    Rte_CAN0_Rx_0x202_Sig_4_U8_CAN0_Rx_0x202_Mixed_IOCData_Type: category=STRUCTURE
    Rte_CAN0_Rx_0x202_Sig_3_U16_CAN0_Rx_0x202_Mixed_IOCData_Type: category=STRUCTURE
    Rte_CAN0_Rx_0x202_Sig_2_U8_CAN0_Rx_0x202_Mixed_IOCData_Type: category=STRUCTURE
    Rte_CAN0_Rx_0x202_Sig_1_U4_CAN0_Rx_0x202_Mixed_IOCData_Type: category=STRUCTURE
    Rte_CAN0_Rx_0x202_Sig_5_U1_CAN0_Rx_0x202_Mixed_IOCData_Type: category=STRUCTURE
    Rte_CAN0_Rx_0x203_Sig_4_U32_CAN0_Rx_0x203_Cyclic_Counter_IOCData_Type: category=STRUCTURE
    Rte_CAN0_Rx_0x203_Sig_3_U16_CAN0_Rx_0x203_Cyclic_Counter_IOCData_Type: category=STRUCTURE
    Rte_CAN0_Rx_0x203_Sig_2_U8_CAN0_Rx_0x203_Cyclic_Counter_IOCData_Type: category=STRUCTURE
    Rte_CAN0_Rx_0x203_Sig_1_U4_CAN0_Rx_0x203_Cyclic_Counter_IOCData_Type: category=STRUCTURE
    Rte_CAN0_Rx_0x203_Sig_RollingCounter_CAN0_Rx_0x203_Cyclic_Counter_IOCData_Type: category=STRUCTURE
    Rte_CAN0_Tx_0x351_Cyclic_PN29_Sig_CAN0_Tx_0x351_Cyclic_PN29_IOCData_Type: category=STRUCTURE
    Rte_CAN0_Tx_0x350_Cyclic_PN17_Sig_CAN0_Tx_0x350_Cyclic_PN17_IOCData_Type: category=STRUCTURE
    Rte_CAN0_Tx_0x300_Sig_4_U31_CAN0_Tx_0x300_Cyclic_IOCData_Type: category=STRUCTURE
    Rte_CAN0_Tx_0x300_Sig_3_U15_CAN0_Tx_0x300_Cyclic_IOCData_Type: category=STRUCTURE
    Rte_CAN0_Tx_0x300_Sig_2_U6_CAN0_Tx_0x300_Cyclic_IOCData_Type: category=STRUCTURE
    Rte_CAN0_Tx_0x300_Sig_1_U4_CAN0_Tx_0x300_Cyclic_IOCData_Type: category=STRUCTURE
    Rte_CAN0_Tx_0x301_Sig_4_U32_CAN0_Tx_0x301_Event_IOCData_Type: category=STRUCTURE
    Rte_CAN0_Tx_0x301_Sig_3_U16_CAN0_Tx_0x301_Event_IOCData_Type: category=STRUCTURE
    Rte_CAN0_Tx_0x301_Sig_2_U8_CAN0_Tx_0x301_Event_IOCData_Type: category=STRUCTURE
    Rte_CAN0_Tx_0x301_Sig_1_U3_CAN0_Tx_0x301_Event_IOCData_Type: category=STRUCTURE
    Rte_CAN0_Tx_0x302_Sig_7_U2_CAN0_Tx_0x302_Mixed_IOCData_Type: category=STRUCTURE
    Rte_CAN0_Tx_0x302_Sig_6_U1_CAN0_Tx_0x302_Mixed_IOCData_Type: category=STRUCTURE
    Rte_CAN0_Tx_0x302_Sig_4_U8_CAN0_Tx_0x302_Mixed_IOCData_Type: category=STRUCTURE
    Rte_CAN0_Tx_0x302_Sig_3_U16_CAN0_Tx_0x302_Mixed_IOCData_Type: category=STRUCTURE
    Rte_CAN0_Tx_0x302_Sig_2_U8_CAN0_Tx_0x302_Mixed_IOCData_Type: category=STRUCTURE
    Rte_CAN0_Tx_0x302_Sig_1_U4_CAN0_Tx_0x302_Mixed_IOCData_Type: category=STRUCTURE
    Rte_CAN0_Tx_0x302_Sig_5_U1_CAN0_Tx_0x302_Mixed_IOCData_Type: category=STRUCTURE
    Rte_CAN0_Tx_0x303_Sig_4_U32_CAN0_Tx_0x303_Cyclic_Counter_IOCData_Type: category=STRUCTURE
    Rte_CAN0_Tx_0x303_Sig_3_U16_CAN0_Tx_0x303_Cyclic_Counter_IOCData_Type: category=STRUCTURE
    Rte_CAN0_Tx_0x303_Sig_2_U8_CAN0_Tx_0x303_Cyclic_Counter_IOCData_Type: category=STRUCTURE
    Rte_CAN0_Tx_0x303_Sig_1_U4_CAN0_Tx_0x303_Cyclic_Counter_IOCData_Type: category=STRUCTURE
    Rte_CAN0_Tx_0x303_Sig_RollingCounter_CAN0_Tx_0x303_Cyclic_Counter_IOCData_Type: category=STRUCTURE
    Rte_CAN0_Rx_0x260_Sig_8_U8_CAN0_Rx_0x260_E2E_P01_IOCData_Type: category=STRUCTURE
    Rte_CAN0_Rx_0x260_Sig_7_U5_CAN0_Rx_0x260_E2E_P01_IOCData_Type: category=STRUCTURE
    Rte_CAN0_Rx_0x260_Sig_6_U2_CAN0_Rx_0x260_E2E_P01_IOCData_Type: category=STRUCTURE
    Rte_CAN0_Rx_0x260_Sig_5_U16_CAN0_Rx_0x260_E2E_P01_IOCData_Type: category=STRUCTURE
    Rte_CAN0_Rx_0x260_Sig_4_U8_CAN0_Rx_0x260_E2E_P01_IOCData_Type: category=STRUCTURE
    Rte_CAN0_Rx_0x260_Sig_2_U3_CAN0_Rx_0x260_E2E_P01_IOCData_Type: category=STRUCTURE
    Rte_CAN0_Rx_0x260_Sig_3_U4_CAN0_Rx_0x260_E2E_P01_IOCData_Type: category=STRUCTURE
    Rte_CAN0_Rx_0x260_Sig_1_U1_CAN0_Rx_0x260_E2E_P01_IOCData_Type: category=STRUCTURE
    Rte_CAN0_Rx_0x260_Counter_CAN0_Rx_0x260_E2E_P01_IOCData_Type: category=STRUCTURE
    Rte_CAN0_Rx_0x260_CRC_CAN0_Rx_0x260_E2E_P01_IOCData_Type: category=STRUCTURE
    Rte_CAN0_Tx_0x360_Sig_8_U8_CAN0_Tx_0x360_E2E_P01_IOCData_Type: category=STRUCTURE
    Rte_CAN0_Tx_0x360_Sig_7_U5_CAN0_Tx_0x360_E2E_P01_IOCData_Type: category=STRUCTURE
    Rte_CAN0_Tx_0x360_Sig_6_U2_CAN0_Tx_0x360_E2E_P01_IOCData_Type: category=STRUCTURE
    Rte_CAN0_Tx_0x360_Sig_5_U16_CAN0_Tx_0x360_E2E_P01_IOCData_Type: category=STRUCTURE
    Rte_CAN0_Tx_0x360_Sig_4_U8_CAN0_Tx_0x360_E2E_P01_IOCData_Type: category=STRUCTURE
    Rte_CAN0_Tx_0x360_Sig_2_U3_CAN0_Tx_0x360_E2E_P01_IOCData_Type: category=STRUCTURE
    Rte_CAN0_Tx_0x360_Sig_3_U4_CAN0_Tx_0x360_E2E_P01_IOCData_Type: category=STRUCTURE
    Rte_CAN0_Tx_0x360_Sig_1_U1_CAN0_Tx_0x360_E2E_P01_IOCData_Type: category=STRUCTURE
    Rte_CAN0_Tx_0x360_Counter_CAN0_Tx_0x360_E2E_P01_IOCData_Type: category=STRUCTURE
    Rte_CAN0_Tx_0x360_CRC_CAN0_Tx_0x360_E2E_P01_IOCData_Type: category=STRUCTURE
    Rte_Rx_0x260_E2E_P01_CAN0_Rx_0x260_E2E_P01_IOCData_Type: category=STRUCTURE
    Rte_Tx_0x360_E2E_P01_CAN0_Tx_0x360_E2E_P01_IOCData_Type: category=STRUCTURE
    Rte_Cs_TransactionHandleType: category=STRUCTURE
    uint8_ptr: category=DATA_REFERENCE
    SchM_CrossCore_BufferType: category=STRUCTURE
    SchM_AsynCrossCore_BufferType: category=STRUCTURE
    uint8_Cs: category=VALUE, base-type=uint8
    uint16_Cs: category=VALUE, base-type=uint16
    Rte_ModeType_DcmDiagnosticSessionControl: category=VALUE, base-type=uint8
    Rte_ModeType_DcmEcuReset: category=VALUE, base-type=uint8
    Rte_ModeType_DcmModeRapidPowerShutDown: category=VALUE, base-type=uint8
    Rte_ModeType_DcmCommunicationControl: category=VALUE, base-type=uint8
    Rte_ModeType_DcmControlDTCSetting: category=VALUE, base-type=uint8
    Rte_ModeType_DcmSecurityAccess: category=VALUE, base-type=uint8
