AUTOSAR XML (schema 00048)
package /S32K148
  module config Mcu: implementation-config-variant=VARIANT-POST-BUILD, post-build-variant-used=false
    CommonPublishedInformation:
      ArReleaseMajorVersion = 4
      ArReleaseMinorVersion = 7
      ArReleaseRevisionVersion = 0
      ModuleId = 101
      SwMajorVersion = 2
      SwMinorVersion = 0
      SwPatchVersion = 0
      VendorApiInfix = 
      VendorId = 43
    McuDebugConfiguration:
      McuAecResetConfigApi = 0
      McuDisableCmuApi = 0
      McuDisableDemReportErrorStatus = 0
      McuEnablePeripheralCMU = 0
      McuGetClockFrequencyApi = 1
      McuGetMidrStructureApi = 0
      McuGetPowerModeStatetApi = 0
      McuPmcAeConfigApi = 0
      McuSRAMRetentionConfigApi = 0
    McuGeneralConfiguration:
      McuCalloutBeforePerformReset = 0
      McuCmuErrorIsrUsed = 0
      McuDevErrorDetect = 1
      McuDisablePmcInit = 0
      McuDisableRcmInit = 0
      McuDisableSmcInit = 0
      McuEnableModeChangeNotification = 0
      McuEnableUserModeSupport = 0
      McuEnterLowPowerMode = 0
      McuGetRamStateApi = 0
      McuInitClock = 1
      McuNoPll = 0
      McuPerformResetApi = 1
      McuPerformResetCallout = NULL_PTR
      McuRegisterValuesOptimization = DISABLED
      McuTimeout = 50000
      McuTimeoutMethod = OSIF_COUNTER_DUMMY
      McuVersionInfoApi = 0
    McuModuleConfiguration_0 (McuModuleConfiguration):
      McuClockSrcFailureNotification = DISABLED
      McuNumberOfMcuModes = 1
      McuRTC_CLKINFrequencyHz = 32768.0
      McuRamSectors = 0
      McuResetSetting = 1
      McuTCLK{0..2}_REF_CLKFrequencyHz = 32000.0
      McuAllowedModes: McuAllowHighSpeedRunMode=1, McuAllowVeryLowPowerModes=0
      McuClockSettingConfig_0 (McuClockSettingConfig): index=0, McuClockSettingId=0, McuScgClkOutSelect=SLOW_CLK, McuSysClockUnderMcuControl=1
        McuClkMonitor: index=0
          McuClkMonitor_0: McuAsyncFHHInterruptEn=0, McuAsyncFLLInterruptEn=0, McuClkMonitorEn=0, McuClockMonitorUnderMcuControl=0, McuCmuName=CMU_FC_0_FIRC_MON1_CLK
          McuClkMonitor_1: McuClkMonitorEn=0, McuClockMonitorUnderMcuControl=0, McuCmuName=CMU_FC_1_FIRC_MON2_CLK, McuSyncFHHInterruptEn=0, McuSyncFLLInterruptEn=0
        4 x McuClockReferencePoint:
          McuClockReferencePoint_RUN_SYS_CLK: index=0, McuClockFrequencySelect=RUN_SYS_CLK, McuClockReferencePointFrequency=8.0E7
          McuClockReferencePoint_SOSC_CLK: index=1, McuClockFrequencySelect=SOSC_CLK, McuClockReferencePointFrequency=8000000.0
          McuClockReferencePoint_LPIT0_CLK: index=2, McuClockFrequencySelect=LPIT0_CLK, McuClockReferencePointFrequency=4.0E7
          McuClockReferencePoint_FTM0_CLK: index=3, McuClockFrequencySelect=FTM0_CLK, McuClockReferencePointFrequency=8000000.0
        McuFIRCClockConfig:
          McuFIRCDiv1 = 1
          McuFIRCDiv1Frequency = 4.8E7
          McuFIRCDiv2 = 2
          McuFIRCDiv2Frequency = 2.4E7
          McuFIRCEnable = 1
          McuFIRCFrequency = 4.8E7
          McuFIRCRangeSelect = TRIMMED_TO_48MHZ
          McuFIRCRegulatorEnable = 1
          McuFIRCUnderMcuControl = 1
        McuHsrunClockConfig:
          McuBusClockDivider = 2
          McuBusClockFrequency = 4.0E7
          McuCoreClockDivider = 2
          McuCoreClockFrequency = 8.0E7
          McuFlashClockFrequency = 2.0E7
          McuPreDivSystemClockFrequency = 1.6E8
          McuScgClkOutFrequency = 2.0E7
          McuSlowClockDivider = 4
          McuSystemClockFrequency = 8.0E7
          McuSystemClockSwitch = SPLL_CLK
        41 x McuPeripheralClockConfig, all with McuPeripheralClockDivider=1, McuPeripheralClockUnderMcuControl=1, McuPeripheralFractionalDivider=1:
          McuPeripheralClockConfig_0: index=0, McuPerName=FTFC, McuPeripheralClockEnable=1, McuPeripheralClockFrequency=0.0, McuPeripheralClockSelect=CLOCK_IS_OFF
          McuPeripheralClockConfig_1: index=1, McuPerName=DMAMUX0, McuPeripheralClockEnable=1, McuPeripheralClockFrequency=0.0, McuPeripheralClockSelect=CLOCK_IS_OFF
          McuPeripheralClockConfig_2: index=2, McuPerName=FLEXCAN0, McuPeripheralClockEnable=1, McuPeripheralClockFrequency=0.0, McuPeripheralClockSelect=CLOCK_IS_OFF
          McuPeripheralClockConfig_3: index=3, McuPerName=FLEXCAN1, McuPeripheralClockEnable=1, McuPeripheralClockFrequency=0.0, McuPeripheralClockSelect=CLOCK_IS_OFF
          McuPeripheralClockConfig_4: index=4, McuPerName=FTM3, McuPeripheralClockEnable=1, McuPeripheralClockFrequency=32000.0, McuPeripheralClockSelect=CLOCK_IS_OFF
          McuPeripheralClockConfig_5: index=5, McuPerName=ADC1, McuPeripheralClockEnable=0, McuPeripheralClockFrequency=0.0, McuPeripheralClockSelect=CLOCK_IS_OFF
          McuPeripheralClockConfig_6: index=6, McuPerName=FLEXCAN2, McuPeripheralClockEnable=1, McuPeripheralClockFrequency=0.0, McuPeripheralClockSelect=CLOCK_IS_OFF
          McuPeripheralClockConfig_7: index=7, McuPerName=LPSPI0, McuPeripheralClockEnable=1, McuPeripheralClockFrequency=0.0, McuPeripheralClockSelect=CLOCK_IS_OFF
          McuPeripheralClockConfig_8: index=8, McuPerName=LPSPI1, McuPeripheralClockEnable=1, McuPeripheralClockFrequency=0.0, McuPeripheralClockSelect=CLOCK_IS_OFF
          McuPeripheralClockConfig_9: index=9, McuPerName=LPSPI2, McuPeripheralClockEnable=1, McuPeripheralClockFrequency=0.0, McuPeripheralClockSelect=CLOCK_IS_OFF
          McuPeripheralClockConfig_10: index=10, McuPerName=PDB1, McuPeripheralClockEnable=1, McuPeripheralClockFrequency=0.0, McuPeripheralClockSelect=CLOCK_IS_OFF
          McuPeripheralClockConfig_11: index=11, McuPerName=CRC0, McuPeripheralClockEnable=1, McuPeripheralClockFrequency=0.0, McuPeripheralClockSelect=CLOCK_IS_OFF
          McuPeripheralClockConfig_12: index=12, McuPerName=PDB0, McuPeripheralClockEnable=1, McuPeripheralClockFrequency=0.0, McuPeripheralClockSelect=CLOCK_IS_OFF
          McuPeripheralClockConfig_13: index=13, McuPerName=LPIT0, McuPeripheralClockEnable=1, McuPeripheralClockFrequency=4.0E7, McuPeripheralClockSelect=SPLL
          McuPeripheralClockConfig_14: index=14, McuPerName=FTM0, McuPeripheralClockEnable=1, McuPeripheralClockFrequency=8000000.0, McuPeripheralClockSelect=SIRC
          McuPeripheralClockConfig_15: index=15, McuPerName=FTM1, McuPeripheralClockEnable=1, McuPeripheralClockFrequency=32000.0, McuPeripheralClockSelect=CLOCK_IS_OFF
          McuPeripheralClockConfig_16: index=16, McuPerName=FTM2, McuPeripheralClockEnable=1, McuPeripheralClockFrequency=32000.0, McuPeripheralClockSelect=CLOCK_IS_OFF
          McuPeripheralClockConfig_17: index=17, McuPerName=ADC0, McuPeripheralClockEnable=0, McuPeripheralClockFrequency=0.0, McuPeripheralClockSelect=CLOCK_IS_OFF
          McuPeripheralClockConfig_18: index=18, McuPerName=RTC0, McuPeripheralClockEnable=1, McuPeripheralClockFrequency=0.0, McuPeripheralClockSelect=CLOCK_IS_OFF
          McuPeripheralClockConfig_19: index=19, McuPerName=LPTMR0, McuPeripheralClockEnable=1, McuPeripheralClockFrequency=0.0, McuPeripheralClockSelect=CLOCK_IS_OFF
          McuPeripheralClockConfig_20: index=20, McuPerName=PORTA, McuPeripheralClockEnable=1, McuPeripheralClockFrequency=0.0, McuPeripheralClockSelect=CLOCK_IS_OFF
          McuPeripheralClockConfig_21: index=21, McuPerName=PORTB, McuPeripheralClockEnable=1, McuPeripheralClockFrequency=0.0, McuPeripheralClockSelect=CLOCK_IS_OFF
          McuPeripheralClockConfig_22: index=22, McuPerName=PORTC, McuPeripheralClockEnable=1, McuPeripheralClockFrequency=0.0, McuPeripheralClockSelect=CLOCK_IS_OFF
          McuPeripheralClockConfig_23: index=23, McuPerName=PORTD, McuPeripheralClockEnable=1, McuPeripheralClockFrequency=0.0, McuPeripheralClockSelect=CLOCK_IS_OFF
          McuPeripheralClockConfig_24: index=24, McuPerName=PORTE, McuPeripheralClockEnable=1, McuPeripheralClockFrequency=0.0, McuPeripheralClockSelect=CLOCK_IS_OFF
          McuPeripheralClockConfig_25: index=25, McuPerName=SAI0, McuPeripheralClockEnable=1, McuPeripheralClockFrequency=0.0, McuPeripheralClockSelect=CLOCK_IS_OFF
          McuPeripheralClockConfig_26: index=26, McuPerName=SAI1, McuPeripheralClockEnable=1, McuPeripheralClockFrequency=0.0, McuPeripheralClockSelect=CLOCK_IS_OFF
          McuPeripheralClockConfig_27: index=27, McuPerName=FlexIO, McuPeripheralClockEnable=1, McuPeripheralClockFrequency=0.0, McuPeripheralClockSelect=CLOCK_IS_OFF
          McuPeripheralClockConfig_28: index=28, McuPerName=EWM0, McuPeripheralClockEnable=1, McuPeripheralClockFrequency=0.0, McuPeripheralClockSelect=CLOCK_IS_OFF
          McuPeripheralClockConfig_29: index=29, McuPerName=LPI2C0, McuPeripheralClockEnable=1, McuPeripheralClockFrequency=0.0, McuPeripheralClockSelect=CLOCK_IS_OFF
          McuPeripheralClockConfig_30: index=30, McuPerName=LPI2C1, McuPeripheralClockEnable=1, McuPeripheralClockFrequency=0.0, McuPeripheralClockSelect=CLOCK_IS_OFF
          McuPeripheralClockConfig_31: index=31, McuPerName=LPUART0, McuPeripheralClockEnable=1, McuPeripheralClockFrequency=0.0, McuPeripheralClockSelect=CLOCK_IS_OFF
          McuPeripheralClockConfig_32: index=32, McuPerName=LPUART1, McuPeripheralClockEnable=1, McuPeripheralClockFrequency=0.0, McuPeripheralClockSelect=CLOCK_IS_OFF
          McuPeripheralClockConfig_33: index=33, McuPerName=LPUART2, McuPeripheralClockEnable=1, McuPeripheralClockFrequency=0.0, McuPeripheralClockSelect=CLOCK_IS_OFF
          McuPeripheralClockConfig_34: index=34, McuPerName=FTM4, McuPeripheralClockEnable=1, McuPeripheralClockFrequency=32000.0, McuPeripheralClockSelect=CLOCK_IS_OFF
          McuPeripheralClockConfig_35: index=35, McuPerName=FTM5, McuPeripheralClockEnable=1, McuPeripheralClockFrequency=32000.0, McuPeripheralClockSelect=CLOCK_IS_OFF
          McuPeripheralClockConfig_36: index=36, McuPerName=FTM6, McuPeripheralClockEnable=1, McuPeripheralClockFrequency=32000.0, McuPeripheralClockSelect=CLOCK_IS_OFF
          McuPeripheralClockConfig_37: index=37, McuPerName=FTM7, McuPeripheralClockEnable=1, McuPeripheralClockFrequency=32000.0, McuPeripheralClockSelect=CLOCK_IS_OFF
          McuPeripheralClockConfig_38: index=38, McuPerName=CMP0, McuPeripheralClockEnable=1, McuPeripheralClockFrequency=0.0, McuPeripheralClockSelect=CLOCK_IS_OFF
          McuPeripheralClockConfig_39: index=39, McuPerName=QSPI, McuPeripheralClockEnable=1, McuPeripheralClockFrequency=0.0, McuPeripheralClockSelect=CLOCK_IS_OFF
          McuPeripheralClockConfig_40: index=40, McuPerName=ENET, McuPeripheralClockEnable=1, McuPeripheralClockFrequency=0.0, McuPeripheralClockSelect=CLOCK_IS_OFF
        McuRunClockConfig:
          McuBusClockDivider = 2
          McuBusClockFrequency = 4.0E7
          McuCoreClockDivider = 2
          McuCoreClockFrequency = 8.0E7
          McuFlashClockFrequency = 2.6666666E7
          McuPreDivSystemClockFrequency = 1.6E8
          McuScgClkOutFrequency = 2.6666666E7
          McuSlowClockDivider = 3
          McuSystemClockFrequency = 8.0E7
          McuSystemClockSwitch = SPLL_CLK
        McuSIMClockConfig:
          McuDMAClockGatingEnable = 1
          McuEIMClockGatingEnable = 1
          McuERMClockGatingEnable = 1
          McuGPIOClockGatingEnable = 0
          McuMPUClockGatingEnable = 1
          McuMSCMClockGatingEnable = 1
          McuSIMUnderMcuControl = 1
          McuSimChipConfiguration:
            McuCLKOUTDivider = 5
            McuCLKOUTEnable = 0
            McuCLKOUTSelect = HCLK
            McuDebugTraceDividerEnable = 1
            McuTRACECLKDivider = 1
            McuTRACECLKFraction = 1
            McuTRACECLKSelect = CORE_CLK
          McuSimFtmConfiguration:
            McuFTM{0..7}ExternalClockPinSelect = TCLK0_PIN
          McuSimLpoConfiguration: McuLPOClkSelect=LPO_128K_CLK, McuLPO_1KClockEnable=1, McuLPO_32KClockEnable=1, McuRTCClkSelect=SOSCDIV1_CLK
        McuSIRCClockConfig:
          McuSIRCDiv1 = 1
          McuSIRCDiv1Frequency = 8000000.0
          McuSIRCDiv2 = 2
          McuSIRCDiv2Frequency = 4000000.0
          McuSIRCEnable = 1
          McuSIRCFrequency = 8000000.0
          McuSIRCLowPowerEnable = 1
          McuSIRCRangeSelect = HIGH_RANGE_CLOCK
          McuSIRCStopEnable = 0
          McuSIRCUnderMcuControl = 1
        McuSystemOSCClockConfig:
          McuSOSCClockMonitorEnable = 0
          McuSOSCClockMonitorResetEnable = 0
          McuSOSCDiv1 = 1
          McuSOSCDiv1Frequency = 8000000.0
          McuSOSCDiv2 = 1
          McuSOSCDiv2Frequency = 8000000.0
          McuSOSCEnable = 1
          McuSOSCExternalReferenceSelect = 0
          McuSOSCFrequency = 8000000.0
          McuSOSCHighGainOscillatorSelect = 0
          McuSOSCRangeSelect = HIGH_FREQ_RANGE
          McuSOSCUnderMcuControl = 1
        McuSystemPll:
          McuSPLLClockMonitorEnable = 0
          McuSPLLClockMonitorResetEnable = 0
          McuSPLLDiv1 = 2
          McuSPLLDiv1Frequency = 8.0E7
          McuSPLLDiv2 = 4
          McuSPLLDiv2Frequency = 4.0E7
          McuSPLLEnable = 1
          McuSPLLFrequency = 1.6E8
          McuSPLLInputClkPreDivider = 1
          McuSPLLInputFrequency = 8000000.0
          McuSPLLMultiplier = 40
          McuSPLLReferenceFrequency = 8000000.0
          McuSPLLSelectSourceClock = SOSC_CLK
          McuSystemPllUnderMcuControl = 1
        McuVlprClockConfig:
          McuBusClockDivider = 2
          McuBusClockFrequency = 2000000.0
          McuCoreClockDivider = 2
          McuCoreClockFrequency = 4000000.0
          McuFlashClockFrequency = 1000000.0
          McuPreDivSystemClockFrequency = 8000000.0
          McuScgClkOutFrequency = 1000000.0
          McuSlowClockDivider = 4
          McuSystemClockFrequency = 4000000.0
          McuSystemClockSwitch = SIRC_CLK
      McuInterruptEvents: McuAlternateResetEvent=0, McuVoltageErrorEvent=0
      McuModeSettingConf_0 (McuModeSettingConf): index=0, McuEnableSleepOnExit=0, McuMode=0, McuPowerMode=RUN
      McuPowerControl
        McuPMC_AE_Config:
          McuHighVoltageDetectInterruptOnVDDEnable = 0
          McuHighVoltageDetectInterruptOnVDDINTAndVDD15Enable = 0
          McuLinphySupplyEnable = 1
          McuLinphySupplySelect = VSUP_PIN
          McuLowVoltageDetectInterruptsOnVDDCEnable = 0
          McuLowVoltageDetectInterruptsOnVLSEnable = 0
          McuLvdVlsSelect = LVD_6_5V
          McuVDDCEnable = 0
          McuVddVoltageLevelSelect = VDD_3_3V
        McuPMC_Config:
          McuClockBiasDisable = 0
          McuLPODisable = 0
          McuLowPowerBiasEnable = 0
          McuLowVoltageDetectInterruptEnable = 0
          McuLowVoltageDetectResetEnable = 0
          McuLowVoltageWarningInterruptEnable = 0
      McuResetConfig: McuResetPinFilterBusClockSelect=0, McuResetPinFilterInRunAndWait=ALL_FILTERING_DISABLE, McuResetPinFilterInStopMode=ALL_FILTERING_DISABLE
        McuResetGeneratorConfiguration:
          McuCanPhyReset = 0
          McuCxpiReset = 0
          McuDpgaReset = 0
          McuGduReset = 0
          McuHviReset = 0
          McuLinPhyHpReset = 0
          McuLinPhyLpReset = 0
          McuRegsOtpReset = 1
          McuTempsensorReset = 0
        McuSystemInterruptEnable:
          McuCMULossOfClockResetInterrupt = 0
          McuCoreLockupInterrupt = 0
          McuExternalResetPinInterrupt = 0
          McuGlobalInterrupt = 0
          McuJTAGResetInterrupt = 0
          McuLossOfClockInterrupt = 0
          McuLossOfLockInterrupt = 0
          McuMDMAPSystemResetInterrupt = 0
          McuResetDelayTime = DELAY_10_LPO_CYCLES
          McuSoftwareInterrupt = 0
          McuStopAcknowledgeErrorInterrupt = 0
          McuWatchdogInterrupt = 0
    McuPublishedInformation
      15 x McuResetReasonConf:
        MCU_STOP_ACKNOWLEDGE_ERROR_RESET: index=0, McuResetReason=0
        MCU_MDM_AP_SYSTEM_RESET: index=1, McuResetReason=1
        MCU_SW_RESET: index=2, McuResetReason=2
        MCU_CORE_LOCKUP_RESET: index=3, McuResetReason=3
        MCU_JTAG_RESET: index=4, McuResetReason=4
        MCU_POWER_ON_RESET: index=5, McuResetReason=5
        MCU_EXTERNAL_PIN_RESET: index=6, McuResetReason=6
        MCU_WATCHDOG_RESET: index=7, McuResetReason=7
        MCU_CMU_LOSS_OF_CLOCK_RESET: index=8, McuResetReason=8
        MCU_LOSS_OF_LOCK_RESET: index=9, McuResetReason=9
        MCU_LOSS_OF_CLOCK_RESET: index=10, McuResetReason=10
        MCU_LOW_OR_HIGH_VOLTAGE_DETECT_RESET: index=11, McuResetReason=11
        MCU_NO_RESET_REASON: index=12, McuResetReason=12
        MCU_MULTIPLE_RESET_REASON: index=13, McuResetReason=13
        MCU_RESET_UNDEFINED: index=14, McuResetReason=14
