AUTOSAR XML (schema 00048)
package /S32K148
  module config Dem
    DemGeneral:
      DemAvailabilitySupport = DEM_EVENT_AVAILABILITY
      DemClearDTCBehavior = DEM_CLRRESP_NONVOLATILE_FINISH
      DemClearDTCLimitation = DEM_ALL_SUPPORTED_DTCS
      DemDataElementDefaultEndianness = BIG_ENDIAN
      DemDebounceCounterBasedSupport = true
      DemDebounceTimeBasedSupport = true
      DemDevErrorDetect = true
      DemEventCombinationSupport = DEM_EVCOMB_DISABLED
      DemGeneralInterfaceSupport = false
      DemMaxNumberPrestoredFF = 0
      DemOBDSupport = DEM_OBD_NO_OBD_SUPPORT
      DemResetConfirmedBitOnOverflow = true
      DemStatusBitHandlingTestFailedSinceLastClear = DEM_STATUS_BIT_NORMAL
      DemStatusBitStorageTestFailed = false
      DemSuppressionSupport = DEM_DTC_SUPPRESSION
      DemTaskTime = 0.01
      DemTriggerFiMReports = false
      DemTriggerMonitorInitBeforeClearOk = false
      DemVersionInfoApi = false
      DemBswErrorBufferSize = 3
      DemAgingRequiresNotFailedCycle = true
      DemAgingRequiresTestedCycle = false
      DemResetPendingBitOnOverflow = true
      DEMPOWER (DemOperationCycle): DemOperationCycleId=0
      DidClass_0x0110 (DemDidClass): DemDidIdentifier=272, DemDidDataElementClassRef=DemDataElementClass_0x0110
      DidClass_0x0111 (DemDidClass): DemDidIdentifier=273, DemDidDataElementClassRef=DemDataElementClass_0x0111
      ExtendedDataClass_DTCExtendedDataRecordNumber (DemExtendedDataClass):
        DemExtendedDataRecordClassRef = ExtendedDataRecordClass_0x000001
        DemExtendedDataRecordClassRef = ExtendedDataRecordClass_0x{000003..000008}
      ExtendedDataRecordClass_0x000001 (DemExtendedDataRecordClass):
        DemExtendedDataRecordNumber = 1
        DemExtendedDataRecordTrigger = DEM_TRIGGER_ON_TEST_FAILED
        DemExtendedDataRecordUpdate = DEM_UPDATE_RECORD_YES
        DemDataElementClassRef = DemDataElementClass_FailedCycles
        DemDataElementClassRef = DemDataElementClass_OccurrenceCounter
      DemFreezeFrameRecNumClass_01 (DemFreezeFrameRecNumClass): DemFreezeFrameRecordClassRef=DemFreezeFrameRecordClass_01, DemFreezeFrameRecordClassRef=DemFreezeFrameRecordClass_02
      DemFreezeFrameRecordClass_01 (DemFreezeFrameRecordClass): DemFreezeFrameRecordNumber=1, DemFreezeFrameRecordTrigger=DEM_TRIGGER_ON_TEST_FAILED, DemFreezeFrameRecordUpdate=DEM_UPDATE_RECORD_YES
      FreezeFrameClass_ENVDATA (DemFreezeFrameClass): DemDidClassRef=DidClass_0x0110, DemDidClassRef=DidClass_0x0111
      3 x DemEnableCondition, all with DemEnableConditionStatus=true:
        DemEnableCondition_UnequalDriveMode: DemEnableConditionId=0
        DemEnableCondition_9VTp16V: DemEnableConditionId=1
        DemEnableCondition_DiagEnable3000ms: DemEnableConditionId=2
      DemEnableConditionGroup_0 (DemEnableConditionGroup):
        DemEnableConditionRef = DemEnableCondition_UnequalDriveMode
        DemEnableConditionRef = DemEnableCondition_9VTp16V
        DemEnableConditionRef = DemEnableCondition_DiagEnable3000ms
      DemFreezeFrameRecordClass_02 (DemFreezeFrameRecordClass): DemFreezeFrameRecordNumber=2, DemFreezeFrameRecordTrigger=DEM_TRIGGER_ON_TEST_FAILED, DemFreezeFrameRecordUpdate=DEM_UPDATE_RECORD_NO
      6 x DemExtendedDataRecordClass, all with DemExtendedDataRecordUpdate=DEM_UPDATE_RECORD_YES:
        ExtendedDataRecordClass_0x000003: DemExtendedDataRecordNumber=3, DemExtendedDataRecordTrigger=DEM_TRIGGER_ON_TEST_FAILED, DemDataElementClassRef=DemDataElementClass_CyclesFirstFailed
        ExtendedDataRecordClass_0x000004: DemExtendedDataRecordNumber=4, DemExtendedDataRecordTrigger=DEM_TRIGGER_ON_TEST_FAILED, DemDataElementClassRef=DemDataElementClass_CyclesLastFailed
        ExtendedDataRecordClass_0x000005: DemExtendedDataRecordNumber=5, DemExtendedDataRecordTrigger=DEM_TRIGGER_ON_TEST_FAILED, DemDataElementClassRef=DemDataElementClass_AgingCounter
        ExtendedDataRecordClass_0x000006: DemExtendedDataRecordNumber=6, DemExtendedDataRecordTrigger=DEM_TRIGGER_ON_FDC_THRESHOLD, DemDataElementClassRef=DemDataElementClass_MAXFDCCurrentCycle
        ExtendedDataRecordClass_0x000007: DemExtendedDataRecordNumber=7, DemExtendedDataRecordTrigger=DEM_TRIGGER_ON_FDC_THRESHOLD, DemDataElementClassRef=DemDataElementClass_MAXFDCLastClear
        ExtendedDataRecordClass_0x000008: DemExtendedDataRecordNumber=8, DemExtendedDataRecordTrigger=DEM_TRIGGER_ON_FDC_THRESHOLD, DemDataElementClassRef=DemDataElementClass_CurrentFDC
      DemClient: DemClientFunctionality=DEM_CLIENT_USES_FULL_FUNCTIONALITY, DemClientId=0, DemClientUsesRte=false, DemEventMemorySetRef=DemEventMemorySet
      DemEventMemorySet: DemMaxNumberEventEntryPermanent=0, DemTypeOfDTCSupported=DEM_DTC_TRANSLATION_ISO14229_1
        DemPrimaryMemory:
          DemDtcStatusAvailabilityMask = 127
          DemEventDisplacementStrategy = DEM_DISPLACEMENT_FULL
          DemEventMemoryEntryStorageTrigger = DEM_TRIGGER_ON_FDC_THRESHOLD
          DemMaxNumberEventEntryPrimary = 17
          DemOccurrenceCounterProcessing = DEM_PROCESS_OCCCTR_TF
          DemTypeOfFreezeFrameRecordNumeration = DEM_FF_RECNUM_CONFIGURED
      10 x DemDataElementClass:
        DemDataElementClass_0x0110: DemDataElementUsePort=USE_DATA_CLIENT_SERVER_PORT, DemDataElementDataSize=1, DemDataElementDataType=UINT8_N, DemDataElementEndianness=BIG_ENDIAN
        DemDataElementClass_0x0111: DemDataElementUsePort=USE_DATA_CLIENT_SERVER_PORT, DemDataElementDataSize=3, DemDataElementDataType=UINT8_N, DemDataElementEndianness=BIG_ENDIAN
        DemDataElementClass_AgingCounter: DemDataElementUsePort=USE_DATA_INTERNAL, DemDataElementDataSize=1, DemInternalDataElement=DEM_AGINGCTR_UPCNT
        DemDataElementClass_CurrentFDC: DemDataElementUsePort=USE_DATA_INTERNAL, DemDataElementDataSize=1, DemInternalDataElement=DEM_CURRENT_FDC
        DemDataElementClass_CyclesFirstFailed: DemDataElementUsePort=USE_DATA_INTERNAL, DemDataElementDataSize=1, DemInternalDataElement=DEM_CYCLES_SINCE_FIRST_FAILED
        DemDataElementClass_CyclesLastFailed: DemDataElementUsePort=USE_DATA_INTERNAL, DemDataElementDataSize=1, DemInternalDataElement=DEM_CYCLES_SINCE_LAST_FAILED
        DemDataElementClass_FailedCycles: DemDataElementUsePort=USE_DATA_INTERNAL, DemDataElementDataSize=1, DemInternalDataElement=DEM_FAILED_CYCLES
        DemDataElementClass_MAXFDCCurrentCycle: DemDataElementUsePort=USE_DATA_INTERNAL, DemDataElementDataSize=1, DemInternalDataElement=DEM_MAX_FDC_DURING_CURRENT_CYCLE
        DemDataElementClass_MAXFDCLastClear: DemDataElementUsePort=USE_DATA_INTERNAL, DemDataElementDataSize=1, DemInternalDataElement=DEM_MAX_FDC_SINCE_LAST_CLEAR
        DemDataElementClass_OccurrenceCounter: DemDataElementUsePort=USE_DATA_INTERNAL, DemDataElementDataSize=1, DemInternalDataElement=DEM_OCCCTR
      19 x DemNvRamBlockId:
        DemNvRamBlockId_Primary_{0..16}: DemNvRamBlockIdRef=NvMBlock_Primary_{0..16}
        DemNvRamBlockId_AdminData: DemNvRamBlockIdRef=NvMBlock_AdminData
        DemNvRamBlockId_EventStatusData: DemNvRamBlockIdRef=NvMBlock_EventStatusData
    DemConfigSet
      DTC_0xC07388 (DemDTC): DemDtcValue=12612488, DemDTCSeverity=DEM_SEVERITY_NO_SEVERITY, DemDTCFunctionalUnit=255, DemDTCAttributesRef=DTCAttributes_P1Aged_FDC13
      DTC_0xC18787 (DemDTC): DemDtcValue=12683143, DemDTCSeverity=DEM_SEVERITY_NO_SEVERITY, DemDTCFunctionalUnit=255, DemDTCAttributesRef=DTCAttributes_P1Aged_FDC26
      DemDebounceCounterBasedClass_Up10Down1 (DemDebounceCounterBasedClass):
        DemDebounceBehavior = DEM_DEBOUNCE_RESET
        DemDebounceCounterDecrementStepSize = 128
        DemDebounceCounterFailedThreshold = 127
        DemDebounceCounterIncrementStepSize = 13
        DemDebounceCounterJumpDown = true
        DemDebounceCounterJumpDownValue = 0
        DemDebounceCounterJumpUp = true
        DemDebounceCounterJumpUpValue = 0
        DemDebounceCounterPassedThreshold = -128
        DemDebounceCounterStorage = false
        DemCounterBasedFdcThresholdStorageValue = 13
      DTCAttributes_P1Aged_FDC26 (DemDTCAttributes):
        DemDTCPriority = 1
        DemDTCSignificance = DEM_EVENT_SIGNIFICANCE_FAULT
        DemAgingCycleCounterThreshold = 40
        DemMemoryDestinationRef = DemPrimaryMemory
        DemAgingCycleRef = DEMPOWER
        DemFreezeFrameRecNumClassRef = DemFreezeFrameRecNumClass_01
        DemFreezeFrameClassRef = FreezeFrameClass_ENVDATA
        DemExtendedDataClassRef = ExtendedDataClass_DTCExtendedDataRecordNumber
      DemDebounceCounterBasedClass_Up5Down1 (DemDebounceCounterBasedClass):
        DemDebounceBehavior = DEM_DEBOUNCE_RESET
        DemDebounceCounterDecrementStepSize = 128
        DemDebounceCounterFailedThreshold = 127
        DemDebounceCounterIncrementStepSize = 26
        DemDebounceCounterJumpDown = true
        DemDebounceCounterJumpDownValue = 0
        DemDebounceCounterJumpUp = true
        DemDebounceCounterJumpUpValue = 0
        DemDebounceCounterPassedThreshold = -128
        DemDebounceCounterStorage = false
        DemCounterBasedFdcThresholdStorageValue = 26
      5 x DemDTCAttributes, all with DemDTCSignificance=DEM_EVENT_SIGNIFICANCE_FAULT, DemMemoryDestinationRef=DemPrimaryMemory, DemFreezeFrameRecNumClassRef=DemFreezeFrameRecNumClass_01, DemFreezeFrameClassRef=FreezeFrameClass_ENVDATA, DemExtendedDataClassRef=ExtendedDataClass_DTCExtendedDataRecordNumber:
        DTCAttributes_P1Aged_FDC13: DemDTCPriority=1, DemAgingCycleCounterThreshold=40, DemAgingCycleRef=DEMPOWER
        DTCAttributes_P1NoAged_FDC8: DemDTCPriority=1
        DTCAttributes_P2Aged_FDC1: DemDTCPriority=2, DemAgingCycleCounterThreshold=40, DemAgingCycleRef=DEMPOWER
        DTCAttributes_P3Aged_FDC6: DemDTCPriority=3, DemAgingCycleCounterThreshold=40, DemAgingCycleRef=DEMPOWER
        DTCAttributes_P4Aged_FDC43: DemDTCPriority=4, DemAgingCycleCounterThreshold=40, DemAgingCycleRef=DEMPOWER
      15 x DemDTC, all with DemDTCSeverity=DEM_SEVERITY_NO_SEVERITY, DemDTCFunctionalUnit=255:
        DTC_0xC10001: DemDtcValue=12648449, DemDTCAttributesRef=DTCAttributes_P1NoAged_FDC8
        DTC_0xC10002: DemDtcValue=12648450, DemDTCAttributesRef=DTCAttributes_P1NoAged_FDC8
        DTC_0xC10003: DemDtcValue=12648451, DemDTCAttributesRef=DTCAttributes_P1NoAged_FDC8
        DTC_0xC10004: DemDtcValue=12648452, DemDTCAttributesRef=DTCAttributes_P2Aged_FDC1
        DTC_0xC10005: DemDtcValue=12648453, DemDTCAttributesRef=DTCAttributes_P2Aged_FDC1
        DTC_0xC10006: DemDtcValue=12648454, DemDTCAttributesRef=DTCAttributes_P2Aged_FDC1
        DTC_0xC10007: DemDtcValue=12648455, DemDTCAttributesRef=DTCAttributes_P2Aged_FDC1
        DTC_0xC10008: DemDtcValue=12648456, DemDTCAttributesRef=DTCAttributes_P2Aged_FDC1
        DTC_0xC10009: DemDtcValue=12648457, DemDTCAttributesRef=DTCAttributes_P3Aged_FDC6
        DTC_0xC1000A: DemDtcValue=12648458, DemDTCAttributesRef=DTCAttributes_P3Aged_FDC6
        DTC_0xC1000B: DemDtcValue=12648459, DemDTCAttributesRef=DTCAttributes_P3Aged_FDC6
        DTC_0xC1000C: DemDtcValue=12648460, DemDTCAttributesRef=DTCAttributes_P3Aged_FDC6
        DTC_0xC1000D: DemDtcValue=12648461, DemDTCAttributesRef=DTCAttributes_P4Aged_FDC43
        DTC_0xC1000E: DemDtcValue=12648462, DemDTCAttributesRef=DTCAttributes_P4Aged_FDC43
        DTC_0xC1000F: DemDtcValue=12648463, DemDTCAttributesRef=DTCAttributes_P4Aged_FDC43
      3 x DemDebounceCounterBasedClass, all with DemDebounceBehavior=DEM_DEBOUNCE_RESET, DemDebounceCounterJumpDown=true, DemDebounceCounterJumpDownValue=0, DemDebounceCounterJumpUp=true, DemDebounceCounterJumpUpValue=0, DemDebounceCounterPassedThreshold=-128, DemDebounceCounterStorage=false:
        DemDebounceCounterBasedClass_Up32Down32: DemDebounceCounterDecrementStepSize=4, DemDebounceCounterFailedThreshold=127, DemDebounceCounterIncrementStepSize=4, DemCounterBasedFdcThresholdStorageValue=8
        DemDebounceCounterBasedClass_Up20Down3: DemDebounceCounterDecrementStepSize=43, DemDebounceCounterFailedThreshold=20, DemDebounceCounterIncrementStepSize=1, DemCounterBasedFdcThresholdStorageValue=1
        DemDebounceCounterBasedClass_Up3Down1: DemDebounceCounterDecrementStepSize=128, DemDebounceCounterFailedThreshold=127, DemDebounceCounterIncrementStepSize=43, DemCounterBasedFdcThresholdStorageValue=43
      DemDebounceTimeBaseClass_Fail2000Pass2000 (DemDebounceTimeBasedClass):
        DemDebounceBehavior = DEM_DEBOUNCE_RESET
        DemDebounceTimeFailedThreshold = 2.0
        DemDebounceTimePassedThreshold = 2.0
        DemTimeBasedFdcThresholdStorageValue = 1.0
      17 x DemEventParameter, all with DemEventAvailable=true, DemFFPrestorageSupported=false, DemEventConfirmationThreshold=1, DemEventReportingType=STANDARD_REPORTING, DemEventRecoverableInSameOperationCycle=true, DemOperationCycleRef=DEMPOWER, DemEnableConditionGroupRef=DemEnableConditionGroup_0:
        EventParameter_0xC07388: DemEventId=1, DemEventKind=DEM_EVENT_KIND_BSW, DemReportBehavior=REPORT_BEFORE_INIT, DemDTCRef=DTC_0xC07388
          DemDebounceAlgorithmClass
            DebounceCounterBased_0xC07388 (DemDebounceCounterBased): DemDebounceCounterBasedClassRef=DemDebounceCounterBasedClass_Up10Down1
        EventParameter_0xC18787: DemEventId=2, DemEventKind=DEM_EVENT_KIND_SWC, DemDTCRef=DTC_0xC18787
          DemDebounceAlgorithmClass
            DebounceCounterBased_0xC18787 (DemDebounceCounterBased): DemDebounceCounterBasedClassRef=DemDebounceCounterBasedClass_Up5Down1
        EventParameter_0xC10001: DemEventId=3, DemEventKind=DEM_EVENT_KIND_SWC, DemDTCRef=DTC_0xC10001
          DemDebounceAlgorithmClass
            DemDebounceCounterBased: DemDebounceCounterBasedClassRef=DemDebounceCounterBasedClass_Up32Down32
        EventParameter_0xC10002: DemEventId=4, DemEventKind=DEM_EVENT_KIND_SWC, DemDTCRef=DTC_0xC10002
          DemDebounceAlgorithmClass
            DemDebounceCounterBased: DemDebounceCounterBasedClassRef=DemDebounceCounterBasedClass_Up32Down32
        EventParameter_0xC10003: DemEventId=5, DemEventKind=DEM_EVENT_KIND_SWC, DemDTCRef=DTC_0xC10003
          DemDebounceAlgorithmClass
            DemDebounceCounterBased: DemDebounceCounterBasedClassRef=DemDebounceCounterBasedClass_Up32Down32
        EventParameter_0xC10004: DemEventId=6, DemEventKind=DEM_EVENT_KIND_SWC, DemDTCRef=DTC_0xC10004
          DemDebounceAlgorithmClass
            DemDebounceTimeBased: DemDebounceTimeBasedClassRef=DemDebounceTimeBaseClass_Fail2000Pass2000
        EventParameter_0xC10005: DemEventId=7, DemEventKind=DEM_EVENT_KIND_SWC, DemDTCRef=DTC_0xC10005
          DemDebounceAlgorithmClass
            DemDebounceTimeBased: DemDebounceTimeBasedClassRef=DemDebounceTimeBaseClass_Fail2000Pass2000
        EventParameter_0xC10006: DemEventId=8, DemEventKind=DEM_EVENT_KIND_SWC, DemDTCRef=DTC_0xC10006
          DemDebounceAlgorithmClass
            DemDebounceTimeBased: DemDebounceTimeBasedClassRef=DemDebounceTimeBaseClass_Fail2000Pass2000
        EventParameter_0xC10007: DemEventId=9, DemEventKind=DEM_EVENT_KIND_SWC, DemDTCRef=DTC_0xC10007
          DemDebounceAlgorithmClass
            DemDebounceTimeBased: DemDebounceTimeBasedClassRef=DemDebounceTimeBaseClass_Fail2000Pass2000
        EventParameter_0xC10008: DemEventId=10, DemEventKind=DEM_EVENT_KIND_SWC, DemDTCRef=DTC_0xC10008
          DemDebounceAlgorithmClass
            DemDebounceTimeBased: DemDebounceTimeBasedClassRef=DemDebounceTimeBaseClass_Fail2000Pass2000
        EventParameter_0xC10009: DemEventId=11, DemEventKind=DEM_EVENT_KIND_SWC, DemDTCRef=DTC_0xC10009
          DemDebounceAlgorithmClass
            DemDebounceCounterBased: DemDebounceCounterBasedClassRef=DemDebounceCounterBasedClass_Up20Down3
        EventParameter_0xC1000A: DemEventId=12, DemEventKind=DEM_EVENT_KIND_SWC, DemDTCRef=DTC_0xC1000A
          DemDebounceAlgorithmClass
            DemDebounceCounterBased: DemDebounceCounterBasedClassRef=DemDebounceCounterBasedClass_Up20Down3
        EventParameter_0xC1000B: DemEventId=13, DemEventKind=DEM_EVENT_KIND_SWC, DemDTCRef=DTC_0xC1000B
          DemDebounceAlgorithmClass
            DemDebounceCounterBased: DemDebounceCounterBasedClassRef=DemDebounceCounterBasedClass_Up20Down3
        EventParameter_0xC1000C: DemEventId=14, DemEventKind=DEM_EVENT_KIND_SWC, DemDTCRef=DTC_0xC1000C
          DemDebounceAlgorithmClass
            DemDebounceCounterBased: DemDebounceCounterBasedClassRef=DemDebounceCounterBasedClass_Up20Down3
        EventParameter_0xC1000D: DemEventId=15, DemEventKind=DEM_EVENT_KIND_SWC, DemDTCRef=DTC_0xC1000D
          DemDebounceAlgorithmClass
            DemDebounceCounterBased: DemDebounceCounterBasedClassRef=DemDebounceCounterBasedClass_Up3Down1
        EventParameter_0xC1000E: DemEventId=16, DemEventKind=DEM_EVENT_KIND_SWC, DemDTCRef=DTC_0xC1000E
          DemDebounceAlgorithmClass
            DemDebounceCounterBased: DemDebounceCounterBasedClassRef=DemDebounceCounterBasedClass_Up3Down1
        EventParameter_0xC1000F: DemEventId=17, DemEventKind=DEM_EVENT_KIND_SWC, DemDTCRef=DTC_0xC1000F
          DemDebounceAlgorithmClass
            DemDebounceCounterBased: DemDebounceCounterBasedClassRef=DemDebounceCounterBasedClass_Up3Down1
