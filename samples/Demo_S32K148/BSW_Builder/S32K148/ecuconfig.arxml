AUTOSAR XML (schema 00048)
package /S32K148
  ecuc value collection S32K148
    ecuc-values:
      Port
      Gpt
      WdgM
      Wdg
      Fee
      Dio
      WdgIf
      Can
      Mcu
      PduR
      iRte
      Os
      Xfrm
      Com
      NvM
      ComM
      EcuC
      Dem
      Dcm
      CanIf
      CanTp
      Det
      CanNm
      PduR
      Crc
      EcuM
      CanSM
      BswM
      MemIf
      Nm
      MemMap
      MemLayout
