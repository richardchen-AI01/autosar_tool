AUTOSAR XML (schema 00048)
package /S32K148
  module config Crc
    CrcGeneral: Crc16Mode=CRC_16_TABLE, Crc8H2FMode=CRC_8H2F_TABLE, Crc64Mode=CRC_64_TABLE, Crc32P4Mode=CRC_32P4_TABLE, Crc32Mode=CRC_32_TABLE, Crc8Mode=CRC_8_TABLE
