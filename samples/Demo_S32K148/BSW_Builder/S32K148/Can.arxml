AUTOSAR XML (schema 00048)
package /S32K148
  module config Can: implementation-config-variant=VARIANT-POST-BUILD, post-build-variant-used=false
    CanConfigSet
      CanController_0 (CanController):
        index = 0
        CanAutoBusOffRecovery = 0
        CanBusoffProcessing = INTERRUPT
        CanClockFromBus = 0
        CanControllerActivation = 1
        CanControllerBaseAddress = 0
        CanControllerEdgeFilter = 0
        CanControllerFdISO = 1
        CanControllerId = 0
        CanControllerPrExcEn = 0
        CanHwChannel = FLEXCAN_0
        CanLoopBackMode = 0
        CanRxProcessing = INTERRUPT
        CanTrippleSamplingEnable = 0
        CanTxProcessing = INTERRUPT
        CanWakeupFunctionalityAPI = 0
        CanWakeupProcessing = INTERRUPT
        CanWakeupSupport = 0
        CanControllerDefaultBaudrate = CanControllerBaudrateConfig_500k
        CanCpuClockRef = McuClockReferencePoint_SOSC_CLK
        CanCpuClockRefAlternate = (unset)
        CanControllerBaudrateConfig_500k (CanControllerBaudrateConfig):
          CanAdvancedSetting = 0
          CanBusLength = 40
          CanControllerBaudRate = 500.0
          CanControllerBaudRateConfigID = 0
          CanControllerPrescaller = 1
          CanControllerPrescallerAlternate = 10
          CanControllerPropSeg = 4
          CanControllerSeg1 = 8
          CanControllerSeg2 = 3
          CanControllerSyncJumpWidth = 2
          CanControllerSyncSeg = 1
          CanPropDelayTranceiver = 150.0
          CanTxArbitrationStartDelay = 5
      19 x CanHardwareObject, all with CanFdPaddingValue=0, CanHwObjectCount=1, CanIdType=STANDARD, CanTriggerTransmitEnable=0, CanControllerRef=CanController_0:
        CanHardwareObject_CAN0_Rx_0x200_Cyclic: index=0, CanHandleType=FULL, CanObjectId=0, CanObjectType=RECEIVE
          CanHwFilter_0 (CanHwFilter): index=0, CanHwFilterCode=512, CanHwFilterMask=2047
          CanTTHardwareObjectTrigger_0 (CanTTHardwareObjectTrigger):
            CanTTHardwareObjectBaseCycle = 0
            CanTTHardwareObjectCycleRepetition = 1
            CanTTHardwareObjectTimeMark = 0
            CanTTHardwareObjectTriggerId = 0
            CanTTHardwareObjectTriggerType = CAN_TT_RX_TRIGGER
        CanHardwareObject_CAN0_Rx_0x201_Event: index=1, CanHandleType=FULL, CanObjectId=1, CanObjectType=RECEIVE
          CanHwFilter_0 (CanHwFilter): index=0, CanHwFilterCode=513, CanHwFilterMask=2047
          CanTTHardwareObjectTrigger_0 (CanTTHardwareObjectTrigger):
            CanTTHardwareObjectBaseCycle = 0
            CanTTHardwareObjectCycleRepetition = 1
            CanTTHardwareObjectTimeMark = 0
            CanTTHardwareObjectTriggerId = 0
            CanTTHardwareObjectTriggerType = CAN_TT_RX_TRIGGER
        CanHardwareObject_CAN0_Rx_0x202_Mixed: index=2, CanHandleType=FULL, CanObjectId=2, CanObjectType=RECEIVE
          CanHwFilter_0 (CanHwFilter): index=0, CanHwFilterCode=514, CanHwFilterMask=2047
          CanTTHardwareObjectTrigger_0 (CanTTHardwareObjectTrigger):
            CanTTHardwareObjectBaseCycle = 0
            CanTTHardwareObjectCycleRepetition = 1
            CanTTHardwareObjectTimeMark = 0
            CanTTHardwareObjectTriggerId = 0
            CanTTHardwareObjectTriggerType = CAN_TT_RX_TRIGGER
        CanHardwareObject_CAN0_Rx_0x203_Cyclic_Counter: index=3, CanHandleType=FULL, CanObjectId=3, CanObjectType=RECEIVE
          CanHwFilter_0 (CanHwFilter): index=0, CanHwFilterCode=515, CanHwFilterMask=2047
          CanTTHardwareObjectTrigger_0 (CanTTHardwareObjectTrigger):
            CanTTHardwareObjectBaseCycle = 0
            CanTTHardwareObjectCycleRepetition = 1
            CanTTHardwareObjectTimeMark = 0
            CanTTHardwareObjectTriggerId = 0
            CanTTHardwareObjectTriggerType = CAN_TT_RX_TRIGGER
        CanHardwareObject_CAN0_Rx_0x250_Cyclic_PN17: index=4, CanHandleType=FULL, CanObjectId=4, CanObjectType=RECEIVE
          CanHwFilter_0 (CanHwFilter): index=0, CanHwFilterCode=592, CanHwFilterMask=2047
          CanTTHardwareObjectTrigger_0 (CanTTHardwareObjectTrigger):
            CanTTHardwareObjectBaseCycle = 0
            CanTTHardwareObjectCycleRepetition = 1
            CanTTHardwareObjectTimeMark = 0
            CanTTHardwareObjectTriggerId = 0
            CanTTHardwareObjectTriggerType = CAN_TT_RX_TRIGGER
        CanHardwareObject_CAN0_Rx_0x251_Cyclic_PN29: index=5, CanHandleType=FULL, CanObjectId=5, CanObjectType=RECEIVE
          CanHwFilter_0 (CanHwFilter): index=0, CanHwFilterCode=593, CanHwFilterMask=2047
          CanTTHardwareObjectTrigger_0 (CanTTHardwareObjectTrigger):
            CanTTHardwareObjectBaseCycle = 0
            CanTTHardwareObjectCycleRepetition = 1
            CanTTHardwareObjectTimeMark = 0
            CanTTHardwareObjectTriggerId = 0
            CanTTHardwareObjectTriggerType = CAN_TT_RX_TRIGGER
        CanHardwareObject_CAN0_Rx_0x260_E2E_P01: index=6, CanHandleType=FULL, CanObjectId=6, CanObjectType=RECEIVE
          CanHwFilter_0 (CanHwFilter): index=0, CanHwFilterCode=608, CanHwFilterMask=2047
          CanTTHardwareObjectTrigger_0 (CanTTHardwareObjectTrigger):
            CanTTHardwareObjectBaseCycle = 0
            CanTTHardwareObjectCycleRepetition = 1
            CanTTHardwareObjectTimeMark = 0
            CanTTHardwareObjectTriggerId = 0
            CanTTHardwareObjectTriggerType = CAN_TT_RX_TRIGGER
        CanHardwareObject_CAN0_Rx_0x5xx_NM_ECU: index=7, CanHandleType=BASIC, CanObjectId=7, CanObjectType=RECEIVE
          CanHwFilter_0 (CanHwFilter): index=0, CanHwFilterCode=1280, CanHwFilterMask=1792
          CanTTHardwareObjectTrigger_0 (CanTTHardwareObjectTrigger):
            CanTTHardwareObjectBaseCycle = 0
            CanTTHardwareObjectCycleRepetition = 1
            CanTTHardwareObjectTimeMark = 0
            CanTTHardwareObjectTriggerId = 0
            CanTTHardwareObjectTriggerType = CAN_TT_RX_TRIGGER
        CanHardwareObject_CAN0_Rx_0x708_Diag_Phy_Request: index=8, CanHandleType=FULL, CanObjectId=8, CanObjectType=RECEIVE
          CanHwFilter_0 (CanHwFilter): index=0, CanHwFilterCode=1800, CanHwFilterMask=2047
          CanTTHardwareObjectTrigger_0 (CanTTHardwareObjectTrigger):
            CanTTHardwareObjectBaseCycle = 0
            CanTTHardwareObjectCycleRepetition = 1
            CanTTHardwareObjectTimeMark = 0
            CanTTHardwareObjectTriggerId = 0
            CanTTHardwareObjectTriggerType = CAN_TT_RX_TRIGGER
        CanHardwareObject_CAN0_Rx_0x7df_Diag_Fun_Request: index=9, CanHandleType=FULL, CanObjectId=9, CanObjectType=RECEIVE
          CanHwFilter_0 (CanHwFilter): index=0, CanHwFilterCode=2015, CanHwFilterMask=2047
          CanTTHardwareObjectTrigger_0 (CanTTHardwareObjectTrigger):
            CanTTHardwareObjectBaseCycle = 0
            CanTTHardwareObjectCycleRepetition = 1
            CanTTHardwareObjectTimeMark = 0
            CanTTHardwareObjectTriggerId = 0
            CanTTHardwareObjectTriggerType = CAN_TT_RX_TRIGGER
        CanHardwareObject_CAN0_Tx_0x300_Cyclic: index=10, CanHandleType=FULL, CanObjectId=10, CanObjectType=TRANSMIT
          CanHwFilter_0 (CanHwFilter): index=0, CanHwFilterCode=0, CanHwFilterMask=0
          CanTTHardwareObjectTrigger_0 (CanTTHardwareObjectTrigger):
            CanTTHardwareObjectBaseCycle = 0
            CanTTHardwareObjectCycleRepetition = 1
            CanTTHardwareObjectTimeMark = 0
            CanTTHardwareObjectTriggerId = 0
            CanTTHardwareObjectTriggerType = CAN_TT_TX_TRIGGER_SINGLE
        CanHardwareObject_CAN0_Tx_0x301_Event: index=11, CanHandleType=FULL, CanObjectId=11, CanObjectType=TRANSMIT
          CanHwFilter_0 (CanHwFilter): index=0, CanHwFilterCode=0, CanHwFilterMask=0
          CanTTHardwareObjectTrigger_0 (CanTTHardwareObjectTrigger):
            CanTTHardwareObjectBaseCycle = 0
            CanTTHardwareObjectCycleRepetition = 1
            CanTTHardwareObjectTimeMark = 0
            CanTTHardwareObjectTriggerId = 0
            CanTTHardwareObjectTriggerType = CAN_TT_TX_TRIGGER_SINGLE
        CanHardwareObject_CAN0_Tx_0x302_Mixed: index=12, CanHandleType=FULL, CanObjectId=12, CanObjectType=TRANSMIT
          CanHwFilter_0 (CanHwFilter): index=0, CanHwFilterCode=0, CanHwFilterMask=0
          CanTTHardwareObjectTrigger_0 (CanTTHardwareObjectTrigger):
            CanTTHardwareObjectBaseCycle = 0
            CanTTHardwareObjectCycleRepetition = 1
            CanTTHardwareObjectTimeMark = 0
            CanTTHardwareObjectTriggerId = 0
            CanTTHardwareObjectTriggerType = CAN_TT_TX_TRIGGER_SINGLE
        CanHardwareObject_CAN0_Tx_0x303_Cyclic_Counter: index=13, CanHandleType=FULL, CanObjectId=13, CanObjectType=TRANSMIT
          CanHwFilter_0 (CanHwFilter): index=0, CanHwFilterCode=0, CanHwFilterMask=0
          CanTTHardwareObjectTrigger_0 (CanTTHardwareObjectTrigger):
            CanTTHardwareObjectBaseCycle = 0
            CanTTHardwareObjectCycleRepetition = 1
            CanTTHardwareObjectTimeMark = 0
            CanTTHardwareObjectTriggerId = 0
            CanTTHardwareObjectTriggerType = CAN_TT_TX_TRIGGER_SINGLE
        CanHardwareObject_CAN0_Tx_0x350_Cyclic_PN17: index=14, CanHandleType=FULL, CanObjectId=14, CanObjectType=TRANSMIT
          CanHwFilter_0 (CanHwFilter): index=0, CanHwFilterCode=0, CanHwFilterMask=0
          CanTTHardwareObjectTrigger_0 (CanTTHardwareObjectTrigger):
            CanTTHardwareObjectBaseCycle = 0
            CanTTHardwareObjectCycleRepetition = 1
            CanTTHardwareObjectTimeMark = 0
            CanTTHardwareObjectTriggerId = 0
            CanTTHardwareObjectTriggerType = CAN_TT_TX_TRIGGER_SINGLE
        CanHardwareObject_CAN0_Tx_0x351_Cyclic_PN29: index=15, CanHandleType=FULL, CanObjectId=15, CanObjectType=TRANSMIT
          CanHwFilter_0 (CanHwFilter): index=0, CanHwFilterCode=0, CanHwFilterMask=0
          CanTTHardwareObjectTrigger_0 (CanTTHardwareObjectTrigger):
            CanTTHardwareObjectBaseCycle = 0
            CanTTHardwareObjectCycleRepetition = 1
            CanTTHardwareObjectTimeMark = 0
            CanTTHardwareObjectTriggerId = 0
            CanTTHardwareObjectTriggerType = CAN_TT_TX_TRIGGER_SINGLE
        CanHardwareObject_CAN0_Tx_0x360_E2E_P01: index=16, CanHandleType=FULL, CanObjectId=16, CanObjectType=TRANSMIT
          CanHwFilter_0 (CanHwFilter): index=0, CanHwFilterCode=0, CanHwFilterMask=0
          CanTTHardwareObjectTrigger_0 (CanTTHardwareObjectTrigger):
            CanTTHardwareObjectBaseCycle = 0
            CanTTHardwareObjectCycleRepetition = 1
            CanTTHardwareObjectTimeMark = 0
            CanTTHardwareObjectTriggerId = 0
            CanTTHardwareObjectTriggerType = CAN_TT_TX_TRIGGER_SINGLE
        CanHardwareObject_CAN0_Tx_0x501_NM_ECU: index=17, CanHandleType=FULL, CanObjectId=17, CanObjectType=TRANSMIT
          CanHwFilter_0 (CanHwFilter): index=0, CanHwFilterCode=0, CanHwFilterMask=0
          CanTTHardwareObjectTrigger_0 (CanTTHardwareObjectTrigger):
            CanTTHardwareObjectBaseCycle = 0
            CanTTHardwareObjectCycleRepetition = 1
            CanTTHardwareObjectTimeMark = 0
            CanTTHardwareObjectTriggerId = 0
            CanTTHardwareObjectTriggerType = CAN_TT_TX_TRIGGER_SINGLE
        CanHardwareObject_CAN0_Tx_0x709_Diag_Phy_Response: index=18, CanHandleType=FULL, CanObjectId=18, CanObjectType=TRANSMIT
          CanHwFilter_0 (CanHwFilter): index=0, CanHwFilterCode=0, CanHwFilterMask=0
          CanTTHardwareObjectTrigger_0 (CanTTHardwareObjectTrigger):
            CanTTHardwareObjectBaseCycle = 0
            CanTTHardwareObjectCycleRepetition = 1
            CanTTHardwareObjectTimeMark = 0
            CanTTHardwareObjectTriggerId = 0
            CanTTHardwareObjectTriggerType = CAN_TT_TX_TRIGGER_SINGLE
    Can_43_FLEXCAN (CanGeneral):
      CanDevErrorDetect = 1
      CanEnableDualClockMode = 0
      CanEnableSecurityEventReporting = 0
      CanEnableUserModeSupport = 0
      CanGlobalTimeSupport = 0
      CanIndex = 0
      CanMBCountExtensionSupport = 1
      CanMainFunctionModePeriod = 0.005
      CanMulticoreSupport = 0
      CanMultiplexedTransmission = 0
      CanTimeoutDuration = 10.0
      CanTimeoutMethod = OSIF_COUNTER_DUMMY
      CanVersionInfoApi = 1
      CanSupportTTCANRef = (unset)
      CanMainFunctionRWPeriods_0 (CanMainFunctionRWPeriods): index=0, CanMainFunctionPeriod=0.001
    CommonPublishedInformation:
      ArReleaseMajorVersion = 4
      ArReleaseMinorVersion = 7
      ArReleaseRevisionVersion = 0
      ModuleId = 80
      SwMajorVersion = 2
      SwMinorVersion = 0
      SwPatchVersion = 0
      VendorApiInfix = FLEXCAN
      VendorId = 43
