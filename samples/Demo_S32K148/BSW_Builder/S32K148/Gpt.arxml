AUTOSAR XML (schema 00048)
package /S32K148
  module config Gpt: implementation-config-variant=VARIANT-POST-BUILD
    CommonPublishedInformation:
      ArReleaseMajorVersion = 4
      ArReleaseMinorVersion = 7
      ArReleaseRevisionVersion = 0
      ModuleId = 100
      SwMajorVersion = 2
      SwMinorVersion = 0
      SwPatchVersion = 0
      VendorId = 43
    GptAutosarExt: ChainModeApi=0, GptChangeNextTimeoutValueApi=0, GptEnableDualClockMode=0, GptEnableTriggers=0, GptEnableUserModeSupport=0, GptStandbyWakeupSupport=0
    GptChannelConfigSet
      GptChannelConfiguration_0 (GptChannelConfiguration):
        index = 0
        GptChannelId = 0
        GptChannelMode = GPT_CH_MODE_CONTINUOUS
        GptChannelTickFrequency = 4.0E7
        GptChannelTickValueMax = 4294967295
        GptEnableWakeup = 0
        GptHwIp = LPIT
        GptNotification = GptNotification_1ms
        GptChannelClkSrcRef = GptClockReferencePoint_0
        GptModuleRef = GptLpitChannels_0
      GptChannelConfiguration_1 (GptChannelConfiguration):
        index = 1
        GptChannelId = 1
        GptChannelMode = GPT_CH_MODE_CONTINUOUS
        GptChannelTickFrequency = 62500.0
        GptChannelTickValueMax = 65535
        GptEnableWakeup = 0
        GptHwIp = FTM
        GptNotification = Wdg_Cbk_GptNotification0
        GptChannelClkSrcRef = GptClockReferencePoint_1
        GptModuleRef = GptFtmChannels_0
      GptFtm_0 (GptFtm):
        FtmFreezeEnable = 1
        GptFtmAlternatePrescaler = 1
        GptFtmChannelClkSrc = FTM_GPT_IP_CLOCK_SOURCE_FIXED_FREQUENCY
        GptFtmCountingMode = FTM_GPT_IP_MODE_UP_TIMER
        GptFtmModule = FTM_0
        GptFtmPrescaler = 128
        GptFtmChannels_0 (GptFtmChannels): index=0, FtmAbsoluteCounting=0, GptFtmChannel=CH_1
      GptLpit_0 (GptLpit): GptLpitModule=LPIT_0, LpitDozeEnable=0, LpitFreezeEnable=0
        GptLpitChannels_0 (GptLpitChannels): ChainMode=0, GptLpitChannel=CH_0, LPitExternalTrigger=0, LPitReloadOnTrigger=0, LPitStartOnTrigger=0, LPitStopOnInterrupt=0
    GptConfigurationOfOptApiServices:
      GptDeinitApi = 1
      GptEnableDisableNotificationApi = 1
      GptPredefTimerFunctionalityApi = 0
      GptTimeElapsedApi = 1
      GptTimeRemainingApi = 0
      GptVersionInfoApi = 0
      GptWakeupFunctionalityApi = 0
    GptDriverConfiguration:
      GptDevErrorDetect = 0
      GptMulticoreSupport = 0
      GptPredefTimer100us32bitEnable = 0
      GptPredefTimer1usEnablingGrade = GPT_PREDEF_TIMER_1US_DISABLED
      GptReportWakeupSource = 1
      GptTimeoutDuration = 800
      GptTimeoutMethod = OSIF_COUNTER_DUMMY
      GptClockReferencePoint_0 (GptClockReferencePoint): GptClockReference=McuClockReferencePoint_LPIT0_CLK
      GptClockReferencePoint_1 (GptClockReferencePoint): GptClockReference=McuClockReferencePoint_FTM0_CLK
    78 x GptHwConfiguration:
      GptHwConfiguration_0: index=0, GptChannelIsUsed=1, GptIsrEnable=1, GptIsrHwId=LPIT_0_CH_0
      GptHwConfiguration_{1..3}: index={1..3}, GptChannelIsUsed=0, GptIsrEnable=0, GptIsrHwId=LPIT_0_CH_{1..3}
      GptHwConfiguration_4: index=4, GptChannelIsUsed=0, GptIsrEnable=0, GptIsrHwId=FTM_0_CH_0
      GptHwConfiguration_5: index=5, GptChannelIsUsed=1, GptIsrEnable=1, GptIsrHwId=FTM_0_CH_1
      GptHwConfiguration_6: index=6, GptChannelIsUsed=0, GptIsrEnable=0, GptIsrHwId=FTM_0_CH_2
      GptHwConfiguration_7: index=7, GptChannelIsUsed=0, GptIsrEnable=0, GptIsrHwId=FTM_0_CH_3
      GptHwConfiguration_8: index=8, GptChannelIsUsed=0, GptIsrEnable=0, GptIsrHwId=FTM_0_CH_4
      GptHwConfiguration_9: index=9, GptChannelIsUsed=0, GptIsrEnable=0, GptIsrHwId=FTM_0_CH_5
      GptHwConfiguration_10: index=10, GptChannelIsUsed=0, GptIsrEnable=0, GptIsrHwId=FTM_0_CH_6
      GptHwConfiguration_11: index=11, GptChannelIsUsed=0, GptIsrEnable=0, GptIsrHwId=FTM_0_CH_7
      GptHwConfiguration_12: index=12, GptChannelIsUsed=0, GptIsrEnable=0, GptIsrHwId=FTM_1_CH_0
      GptHwConfiguration_13: index=13, GptChannelIsUsed=0, GptIsrEnable=0, GptIsrHwId=FTM_1_CH_1
      GptHwConfiguration_14: index=14, GptChannelIsUsed=0, GptIsrEnable=0, GptIsrHwId=FTM_1_CH_2
      GptHwConfiguration_15: index=15, GptChannelIsUsed=0, GptIsrEnable=0, GptIsrHwId=FTM_1_CH_3
      GptHwConfiguration_16: index=16, GptChannelIsUsed=0, GptIsrEnable=0, GptIsrHwId=FTM_1_CH_4
      GptHwConfiguration_17: index=17, GptChannelIsUsed=0, GptIsrEnable=0, GptIsrHwId=FTM_1_CH_5
      GptHwConfiguration_18: index=18, GptChannelIsUsed=0, GptIsrEnable=0, GptIsrHwId=FTM_1_CH_6
      GptHwConfiguration_19: index=19, GptChannelIsUsed=0, GptIsrEnable=0, GptIsrHwId=FTM_1_CH_7
      GptHwConfiguration_20: index=20, GptChannelIsUsed=0, GptIsrEnable=0, GptIsrHwId=FTM_2_CH_0
      GptHwConfiguration_21: index=21, GptChannelIsUsed=0, GptIsrEnable=0, GptIsrHwId=FTM_2_CH_1
      GptHwConfiguration_22: index=22, GptChannelIsUsed=0, GptIsrEnable=0, GptIsrHwId=FTM_2_CH_2
      GptHwConfiguration_23: index=23, GptChannelIsUsed=0, GptIsrEnable=0, GptIsrHwId=FTM_2_CH_3
      GptHwConfiguration_24: index=24, GptChannelIsUsed=0, GptIsrEnable=0, GptIsrHwId=FTM_2_CH_4
      GptHwConfiguration_25: index=25, GptChannelIsUsed=0, GptIsrEnable=0, GptIsrHwId=FTM_2_CH_5
      GptHwConfiguration_26: index=26, GptChannelIsUsed=0, GptIsrEnable=0, GptIsrHwId=FTM_2_CH_6
      GptHwConfiguration_27: index=27, GptChannelIsUsed=0, GptIsrEnable=0, GptIsrHwId=FTM_2_CH_7
      GptHwConfiguration_28: index=28, GptChannelIsUsed=0, GptIsrEnable=0, GptIsrHwId=FTM_3_CH_0
      GptHwConfiguration_29: index=29, GptChannelIsUsed=0, GptIsrEnable=0, GptIsrHwId=FTM_3_CH_1
      GptHwConfiguration_30: index=30, GptChannelIsUsed=0, GptIsrEnable=0, GptIsrHwId=FTM_3_CH_2
      GptHwConfiguration_31: index=31, GptChannelIsUsed=0, GptIsrEnable=0, GptIsrHwId=FTM_3_CH_3
      GptHwConfiguration_32: index=32, GptChannelIsUsed=0, GptIsrEnable=0, GptIsrHwId=FTM_3_CH_4
      GptHwConfiguration_33: index=33, GptChannelIsUsed=0, GptIsrEnable=0, GptIsrHwId=FTM_3_CH_5
      GptHwConfiguration_34: index=34, GptChannelIsUsed=0, GptIsrEnable=0, GptIsrHwId=FTM_3_CH_6
      GptHwConfiguration_35: index=35, GptChannelIsUsed=0, GptIsrEnable=0, GptIsrHwId=FTM_3_CH_7
      GptHwConfiguration_36: index=36, GptChannelIsUsed=0, GptIsrEnable=0, GptIsrHwId=FTM_4_CH_0
      GptHwConfiguration_37: index=37, GptChannelIsUsed=0, GptIsrEnable=0, GptIsrHwId=FTM_4_CH_1
      GptHwConfiguration_38: index=38, GptChannelIsUsed=0, GptIsrEnable=0, GptIsrHwId=FTM_4_CH_2
      GptHwConfiguration_39: index=39, GptChannelIsUsed=0, GptIsrEnable=0, GptIsrHwId=FTM_4_CH_3
      GptHwConfiguration_40: index=40, GptChannelIsUsed=0, GptIsrEnable=0, GptIsrHwId=FTM_4_CH_4
      GptHwConfiguration_41: index=41, GptChannelIsUsed=0, GptIsrEnable=0, GptIsrHwId=FTM_4_CH_5
      GptHwConfiguration_42: index=42, GptChannelIsUsed=0, GptIsrEnable=0, GptIsrHwId=FTM_4_CH_6
      GptHwConfiguration_43: index=43, GptChannelIsUsed=0, GptIsrEnable=0, GptIsrHwId=FTM_4_CH_7
      GptHwConfiguration_44: index=44, GptChannelIsUsed=0, GptIsrEnable=0, GptIsrHwId=FTM_5_CH_0
      GptHwConfiguration_45: index=45, GptChannelIsUsed=0, GptIsrEnable=0, GptIsrHwId=FTM_5_CH_1
      GptHwConfiguration_46: index=46, GptChannelIsUsed=0, GptIsrEnable=0, GptIsrHwId=FTM_5_CH_2
      GptHwConfiguration_47: index=47, GptChannelIsUsed=0, GptIsrEnable=0, GptIsrHwId=FTM_5_CH_3
      GptHwConfiguration_48: index=48, GptChannelIsUsed=0, GptIsrEnable=0, GptIsrHwId=FTM_5_CH_4
      GptHwConfiguration_49: index=49, GptChannelIsUsed=0, GptIsrEnable=0, GptIsrHwId=FTM_5_CH_5
      GptHwConfiguration_50: index=50, GptChannelIsUsed=0, GptIsrEnable=0, GptIsrHwId=FTM_5_CH_6
      GptHwConfiguration_51: index=51, GptChannelIsUsed=0, GptIsrEnable=0, GptIsrHwId=FTM_5_CH_7
      GptHwConfiguration_52: index=52, GptChannelIsUsed=0, GptIsrEnable=0, GptIsrHwId=FTM_6_CH_0
      GptHwConfiguration_53: index=53, GptChannelIsUsed=0, GptIsrEnable=0, GptIsrHwId=FTM_6_CH_1
      GptHwConfiguration_54: index=54, GptChannelIsUsed=0, GptIsrEnable=0, GptIsrHwId=FTM_6_CH_2
      GptHwConfiguration_55: index=55, GptChannelIsUsed=0, GptIsrEnable=0, GptIsrHwId=FTM_6_CH_3
      GptHwConfiguration_56: index=56, GptChannelIsUsed=0, GptIsrEnable=0, GptIsrHwId=FTM_6_CH_4
      GptHwConfiguration_57: index=57, GptChannelIsUsed=0, GptIsrEnable=0, GptIsrHwId=FTM_6_CH_5
      GptHwConfiguration_58: index=58, GptChannelIsUsed=0, GptIsrEnable=0, GptIsrHwId=FTM_6_CH_6
      GptHwConfiguration_59: index=59, GptChannelIsUsed=0, GptIsrEnable=0, GptIsrHwId=FTM_6_CH_7
      GptHwConfiguration_60: index=60, GptChannelIsUsed=0, GptIsrEnable=0, GptIsrHwId=FTM_7_CH_0
      GptHwConfiguration_61: index=61, GptChannelIsUsed=0, GptIsrEnable=0, GptIsrHwId=FTM_7_CH_1
      GptHwConfiguration_62: index=62, GptChannelIsUsed=0, GptIsrEnable=0, GptIsrHwId=FTM_7_CH_2
      GptHwConfiguration_63: index=63, GptChannelIsUsed=0, GptIsrEnable=0, GptIsrHwId=FTM_7_CH_3
      GptHwConfiguration_64: index=64, GptChannelIsUsed=0, GptIsrEnable=0, GptIsrHwId=FTM_7_CH_4
      GptHwConfiguration_65: index=65, GptChannelIsUsed=0, GptIsrEnable=0, GptIsrHwId=FTM_7_CH_5
      GptHwConfiguration_66: index=66, GptChannelIsUsed=0, GptIsrEnable=0, GptIsrHwId=FTM_7_CH_6
      GptHwConfiguration_67: index=67, GptChannelIsUsed=0, GptIsrEnable=0, GptIsrHwId=FTM_7_CH_7
      GptHwConfiguration_68: index=68, GptChannelIsUsed=0, GptIsrEnable=0, GptIsrHwId=LPTMR_0_CH_0
      GptHwConfiguration_69: index=69, GptChannelIsUsed=0, GptIsrEnable=0, GptIsrHwId=SRTC_0_CH_0
      GptHwConfiguration_70: index=70, GptChannelIsUsed=0, GptIsrEnable=0, GptIsrHwId=FTM_0_PREDEF
      GptHwConfiguration_71: index=71, GptChannelIsUsed=0, GptIsrEnable=0, GptIsrHwId=FTM_1_PREDEF
      GptHwConfiguration_72: index=72, GptChannelIsUsed=0, GptIsrEnable=0, GptIsrHwId=FTM_2_PREDEF
      GptHwConfiguration_73: index=73, GptChannelIsUsed=0, GptIsrEnable=0, GptIsrHwId=FTM_3_PREDEF
      GptHwConfiguration_74: index=74, GptChannelIsUsed=0, GptIsrEnable=0, GptIsrHwId=FTM_4_PREDEF
      GptHwConfiguration_75: index=75, GptChannelIsUsed=0, GptIsrEnable=0, GptIsrHwId=FTM_5_PREDEF
      GptHwConfiguration_76: index=76, GptChannelIsUsed=0, GptIsrEnable=0, GptIsrHwId=FTM_6_PREDEF
      GptHwConfiguration_77: index=77, GptChannelIsUsed=0, GptIsrEnable=0, GptIsrHwId=FTM_7_PREDEF
    GptPredefTimerConfiguration
