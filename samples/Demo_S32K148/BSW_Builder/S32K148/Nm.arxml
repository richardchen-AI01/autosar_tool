AUTOSAR XML (schema 00048)
package /S32K148
  module config Nm
    NmChCfg_ECU (NmChannelConfig):
      NmChannelSleepMaster = false
      NmPassiveModeEnabled = false
      NmPncBitVectorLength = 2
      NmStateReportEnabled = false
      NmSynchronizingNetwork = false
      NmPnEraCalcEnabled = false
      NmPnEnabled = true
      NmComMChannelRef = ComMCh_ECU
      NmBusType
        NmStandardBusNmConfig: NmStandardBusType=NM_BUSNM_CANNM
      NmPnFilterMaskByte_0 (NmPnFilterMaskByte): NmPnFilterMaskByteIndex=0, NmPnFilterMaskByteValue=2
      NmPnFilterMaskByte_1 (NmPnFilterMaskByte): NmPnFilterMaskByteIndex=1, NmPnFilterMaskByteValue=32
    NmGlobalConfig
      NmGlobalConstants: NmNumberOfChannels=1
      NmGlobalFeatures:
        NmBusSynchronizationEnabled = false
        NmCarWakeUpRxEnabled = false
        NmComControlEnabled = true
        NmCoordinatorSupportEnabled = false
        NmCoordinatorSyncSupport = false
        NmDynamicPncToChannelMappingSupport = false
        NmPduRxIndicationEnabled = false
        NmRemoteSleepIndEnabled = false
        NmStateChangeIndEnabled = true
        NmUserDataEnabled = false
        NmPartialNetworkSupportEnabled = true
      NmGlobalProperties: NmDevErrorDetect=false, NmVersionInfoApi=false, NmCycletimeMainFunction=0.005, NmPnEiraCalcEnabled=true, NmPnResetTime=2.5, NmPncBitVectorOffset=2
