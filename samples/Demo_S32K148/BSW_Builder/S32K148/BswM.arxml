AUTOSAR XML (schema 00048)
package /S32K148
  module config BswM
    BswMGeneral:
      BswMCanSMEnabled = true
      BswMComMEnabled = true
      BswMDcmEnabled = true
      BswMDevErrorDetect = true
      BswMEcuMEnabled = true
      BswMEthSMEnabled = false
      BswMFrSMEnabled = false
      BswMGenericRequestEnabled = true
      BswMJ1939DcmEnabled = false
      BswMJ1939NmEnabled = false
      BswMLinSMEnabled = false
      BswMLinTPEnabled = false
      BswMNmEnabled = true
      BswMNvMEnabled = false
      BswMSdEnabled = false
      BswMVersionInfoApi = false
      BswMMainFunctionPeriod = 0.01
      BswMEthIfEnabled = false
      BswMSdControlEnabled = false
      BswMCloneVariableSupport = false
      BswMUserIncludeFiles: BswMUserIncludeFile=BswM_Ext.h
    BswMConfig
      BswMArbitration
        10 x BswMLogicalExpression:
          LE_NO_COM_CanChannel_0: BswMArgumentRef=Cond_CanSMIndication_CanChannel_0_EQ_CANSM_BSWM_NO_COMMUNICATION
          LE_BUSOFF_SILENT_CanChannel_0: BswMLogicalOperator=BSWM_OR, BswMArgumentRef=Cond_CanSMIndication_CanChannel_0_EQ_CANSM_BSWM_BUS_OFF, BswMArgumentRef=Cond_CanSMIndication_CanChannel_0_EQ_CANSM_BSWM_SILENT_COMMUNICATION
          LE_EcuM_RequestStatus_RUN_REQUEST: BswMArgumentRef=Cond_EcuMWakeupIndication_EcuMRequstRun_EQ_ECUM_RUNSTATUS_REQUESTED
          LE_EcuM_RequestStatus_RUN_RELEASE: BswMArgumentRef=Cond_EcuMWakeupIndication_EcuMRequstRun_EQ_ECUM_RUNSTATUS_RELEASED
          LE_EcuM_RequestStatus_POSTRUN_REQ_AND_RUN_REL: BswMLogicalOperator=BSWM_AND, BswMArgumentRef=Cond_EcuMWakeupIndication_EcuMRequstPostRun_EQ_ECUM_RUNSTATUS_REQUESTED, BswMArgumentRef=Cond_EcuMWakeupIndication_EcuMRequstRun_EQ_ECUM_RUNSTATUS_RELEASED
          LE_RX_CanChannel_0: BswMArgumentRef=Cond_CanSMIndication_CanChannel_0_NEQ_CANSM_BSWM_NO_COMMUNICATION
          LE_RX_DM_CanChannel_0: BswMArgumentRef=Cond_CanSMIndication_CanChannel_0_EQ_CANSM_BSWM_FULL_COMMUNICATION
          LE_TX_DISABLE_CanChannel_0: BswMArgumentRef=Cond_CanSMIndication_CanChannel_0_NEQ_CANSM_BSWM_FULL_COMMUNICATION
          LE_TX_ENABLE_CanChannel_0: BswMLogicalOperator=BSWM_AND, BswMArgumentRef=Cond_CanSMIndication_CanChannel_0_EQ_CANSM_BSWM_FULL_COMMUNICATION, BswMArgumentRef=Cond_GerericCanSMBusOff_CanChannel_0_EQ_GENERIC_CANSMBUSOFF_BUSOFF_SILENT
          LE_TX_ENABLE_REINIT_CanChannel_0: BswMLogicalOperator=BSWM_AND, BswMArgumentRef=Cond_CanSMIndication_CanChannel_0_EQ_CANSM_BSWM_FULL_COMMUNICATION, BswMArgumentRef=Cond_GerericCanSMBusOff_CanChannel_0_EQ_GENERIC_CANSMBUSOFF_NO_COM
        15 x BswMModeCondition:
          Cond_CanSMIndication_CanChannel_0_EQ_CANSM_BSWM_BUS_OFF: BswMConditionType=BSWM_EQUALS, BswMConditionMode=ReqPort_CanSm_CanChannel_0
            BswMConditionValue
              BswMBswMode: BswModeCompareValue=CANSM_BSWM_BUS_OFF
          Cond_CanSMIndication_CanChannel_0_EQ_CANSM_BSWM_NO_COMMUNICATION: BswMConditionType=BSWM_EQUALS, BswMConditionMode=ReqPort_CanSm_CanChannel_0
            BswMConditionValue
              BswMBswMode: BswModeCompareValue=CANSM_BSWM_NO_COMMUNICATION
          Cond_CanSMIndication_CanChannel_0_EQ_CANSM_BSWM_SILENT_COMMUNICATION: BswMConditionType=BSWM_EQUALS, BswMConditionMode=ReqPort_CanSm_CanChannel_0
            BswMConditionValue
              BswMBswMode: BswModeCompareValue=CANSM_BSWM_SILENT_COMMUNICATION
          Cond_CanSMIndication_CanChannel_0_EQ_CANSM_BSWM_FULL_COMMUNICATION: BswMConditionType=BSWM_EQUALS, BswMConditionMode=ReqPort_CanSm_CanChannel_0
            BswMConditionValue
              BswMBswMode: BswModeCompareValue=CANSM_BSWM_FULL_COMMUNICATION
          Cond_CanSMIndication_CanChannel_0_NEQ_CANSM_BSWM_FULL_COMMUNICATION: BswMConditionType=BSWM_EQUALS_NOT, BswMConditionMode=ReqPort_CanSm_CanChannel_0
            BswMConditionValue
              BswMBswMode: BswModeCompareValue=CANSM_BSWM_FULL_COMMUNICATION
          Cond_CanSMIndication_CanChannel_0_NEQ_CANSM_BSWM_NO_COMMUNICATION: BswMConditionType=BSWM_EQUALS_NOT, BswMConditionMode=ReqPort_CanSm_CanChannel_0
            BswMConditionValue
              BswMBswMode: BswModeCompareValue=CANSM_BSWM_NO_COMMUNICATION
          Cond_GerericCanSMBusOff_CanChannel_0_EQ_GENERIC_CANSMBUSOFF_NO_COM: BswMConditionType=BSWM_EQUALS, BswMConditionMode=ReqPort_GenericCanSmBusOff_CanChannel_0
            BswMConditionValue
              BswMBswMode: BswMBswRequestedMode=0
          Cond_GerericCanSMBusOff_CanChannel_0_EQ_GENERIC_CANSMBUSOFF_BUSOFF_SILENT: BswMConditionType=BSWM_EQUALS, BswMConditionMode=ReqPort_GenericCanSmBusOff_CanChannel_0
            BswMConditionValue
              BswMBswMode: BswMBswRequestedMode=1
          Cond_EcuMWakeupIndication_EcuMWakeupSource_CAN_HCML_EQ_ECUM_WKSTATUS_NONE: BswMConditionType=BSWM_EQUALS, BswMConditionMode=ReqPort_EcuM_EcuMWakeupSource_CAN
            BswMConditionValue
              BswMBswMode: BswModeCompareValue=ECUM_WKSTATUS_NONE
          Cond_EcuMWakeupIndication_EcuMWakeupSource_CAN_HCML_EQ_ECUM_WKSTATUS_PENDING: BswMConditionType=BSWM_EQUALS, BswMConditionMode=ReqPort_EcuM_EcuMWakeupSource_CAN
            BswMConditionValue
              BswMBswMode: BswModeCompareValue=ECUM_WKSTATUS_PENDING
          Cond_EcuMWakeupIndication_EcuMWakeupSource_CAN_HCML_EQ_ECUM_WKSTATUS_VALIDATED: BswMConditionType=BSWM_EQUALS, BswMConditionMode=ReqPort_EcuM_EcuMWakeupSource_CAN
            BswMConditionValue
              BswMBswMode: BswModeCompareValue=ECUM_WKSTATUS_VALIDATED
          Cond_EcuMWakeupIndication_EcuMWakeupSource_CAN_HCML_EQ_ECUM_WKSTATUS_EXPIRED: BswMConditionType=BSWM_EQUALS, BswMConditionMode=ReqPort_EcuM_EcuMWakeupSource_CAN
            BswMConditionValue
              BswMBswMode: BswModeCompareValue=ECUM_WKSTATUS_EXPIRED
          Cond_EcuMWakeupIndication_EcuMRequstPostRun_EQ_ECUM_RUNSTATUS_REQUESTED: BswMConditionType=BSWM_EQUALS, BswMConditionMode=ReqPort_EcuM_ReqPostRun
            BswMConditionValue
              BswMBswMode: BswModeCompareValue=ECUM_RUNSTATUS_REQUESTED
          Cond_EcuMWakeupIndication_EcuMRequstPostRun_EQ_ECUM_RUNSTATUS_RELEASED: BswMConditionType=BSWM_EQUALS, BswMConditionMode=ReqPort_EcuM_ReqPostRun
            BswMConditionValue
              BswMBswMode: BswModeCompareValue=ECUM_RUNSTATUS_RELEASED
          Cond_EcuMWakeupIndication_EcuMRequstRun_EQ_ECUM_RUNSTATUS_REQUESTED: BswMConditionType=BSWM_EQUALS, BswMConditionMode=ReqPort_EcuM_ReqRun
            BswMConditionValue
              BswMBswMode: BswModeCompareValue=ECUM_RUNSTATUS_REQUESTED
        6 x BswMModeRequestPort:
          ReqPort_CanSm_CanChannel_0: BswMRequestProcessing=BSWM_IMMEDIATE
            BswMModeRequestSource
              BswMCanSMIndication: BswMCanSMChannelRef=ComMCh_ECU
          ReqPort_GenericCanSmBusOff_CanChannel_0: BswMRequestProcessing=BSWM_IMMEDIATE
            BswMModeRequestSource
              BswMGenericRequest: BswMModeRequesterId=240
          ReqPort_EcuM_EcuMWakeupSource_CAN: BswMRequestProcessing=BSWM_DEFERRED
            BswMModeRequestSource
              BswMEcuMWakeupSource: BswMEcuMWakeupSrcRef=EcuMWakeupSource_CAN
          ReqPort_EcuM_ReqPostRun: BswMRequestProcessing=BSWM_IMMEDIATE
            BswMModeRequestSource
              BswMEcuMRUNRequestIndication: BswMEcuMRUNRequestProtocolPort=BSWM_ECUM_STATE_APP_POST_RUN
          ReqPort_EcuM_ReqRun: BswMRequestProcessing=BSWM_IMMEDIATE
            BswMModeRequestSource
              BswMEcuMRUNRequestIndication: BswMEcuMRUNRequestProtocolPort=BSWM_ECUM_STATE_APP_RUN
          ReqPort_ComM_CanChannel_0: BswMRequestProcessing=BSWM_IMMEDIATE
            BswMModeRequestSource
              BswMComMIndication: BswMComMChannelRef=ComMCh_ECU
        5 x BswMRule, all with BswMNestedExecutionOnly=false:
          Rule_EcuM_RequestStatus_RUN: BswMRuleInitState=BSWM_FALSE, BswMRuleExpressionRef=LE_EcuM_RequestStatus_RUN_REQUEST, BswMRuleTrueActionList=AL_EcuM_RequestStatus_RUN
          Rule_EcuM_RequestStatus_POSTRUN: BswMRuleInitState=BSWM_FALSE, BswMRuleExpressionRef=LE_EcuM_RequestStatus_POSTRUN_REQ_AND_RUN_REL
          Rule_RX_CanChannel_0: BswMRuleInitState=BSWM_FALSE, BswMRuleExpressionRef=LE_RX_CanChannel_0, BswMRuleFalseActionList=AL_RxDisableGroupSwitch_CanChannel_0, BswMRuleTrueActionList=AL_RxEnableGroupSwitch_CanChannel_0
          Rule_RX_DM_CanChannel_0: BswMRuleInitState=BSWM_FALSE, BswMRuleExpressionRef=LE_RX_DM_CanChannel_0, BswMRuleFalseActionList=AL_RxDisableDM_CanChannel_0, BswMRuleTrueActionList=AL_RxEnableDM_CanChannel_0
          Rule_NO_COM_CanChannel_0: BswMRuleInitState=BSWM_TRUE, BswMRuleExpressionRef=LE_NO_COM_CanChannel_0, BswMRuleTrueActionList=AL_GenericCanSmBusOff_NO_COM_CanChannel_0
        RepPort_GerericComControl (BswMModeRequestPort): BswMRequestProcessing=BSWM_IMMEDIATE
          BswMModeRequestSource
            BswMGenericRequest: BswMModeRequesterId=66
        BswMModeInitValue:
          BswMCanSMIndicationInitState = CANSM_BSWM_NO_COMMUNICATION
          BswMGenericRequestInitMode = 0
          BswMComMIndicationInitMode = COMM_NO_COMMUNICATION
          BswMDcmComModeRequestInitMode = DCM_ENABLE_RX_TX_NORM_NM
          BswMEcuMWakeupSourceInitstate = ECUM_WKSTATUS_NONE
          BswMEcuMRUNRequestIndicationInitStatus = ECUM_RUNSTATUS_RELEASED
          BswMComMPncRequestInitMode = COMM_PNC_NO_COMMUNICATION
        3 x BswMModeCondition, all with BswMConditionType=BSWM_EQUALS:
          Cond_EcuMWakeupIndication_EcuMRequstRun_EQ_ECUM_RUNSTATUS_RELEASED: BswMConditionMode=ReqPort_EcuM_ReqRun
            BswMConditionValue
              BswMBswMode: BswModeCompareValue=ECUM_RUNSTATUS_RELEASED
          Cond_ComMIndication_CanChannel_0_EQ_COMM_NO_COMMUNICATION: BswMConditionMode=ReqPort_ComM_CanChannel_0
            BswMConditionValue
              BswMBswMode: BswModeCompareValue=COMM_NO_COMMUNICATION
          Cond_Generic_EQ_GENERIC_COMCONTROL_ON: BswMConditionMode=RepPort_GerericComControl
            BswMConditionValue
              BswMBswMode: BswMBswRequestedMode=1
        3 x BswMLogicalExpression:
          LE_EcuM_ClearExpiredWakeUpSource_CAN: BswMLogicalOperator=BSWM_AND, BswMArgumentRef=Cond_CanSMIndication_CanChannel_0_EQ_CANSM_BSWM_NO_COMMUNICATION, BswMArgumentRef=Cond_EcuMWakeupIndication_EcuMWakeupSource_CAN_HCML_EQ_ECUM_WKSTATUS_EXPIRED
          LE_ComM_AllChanel_NO_COM: BswMArgumentRef=Cond_CanSMIndication_CanChannel_0_EQ_CANSM_BSWM_NO_COMMUNICATION
          LE_GenericComControl: BswMArgumentRef=Cond_Generic_EQ_GENERIC_COMCONTROL_ON
        4 x BswMRule, all with BswMNestedExecutionOnly=false:
          Rule_BUSOFF_SILENT_CanChannel_0: BswMRuleInitState=BSWM_FALSE, BswMRuleExpressionRef=LE_BUSOFF_SILENT_CanChannel_0, BswMRuleTrueActionList=AL_GenericCanSmBusOff_BUSOFF_SILENT_CanChannel_0
          Rule_ComM_AllChanel_NO_COM: BswMRuleInitState=BSWM_TRUE, BswMRuleExpressionRef=LE_ComM_AllChanel_NO_COM, BswMRuleTrueActionList=AL_ComM_AllChanel_NO_COM
          Rule_EcuM_ClearExpiredWakeUpSource_CAN: BswMRuleInitState=BSWM_FALSE, BswMRuleExpressionRef=LE_EcuM_ClearExpiredWakeUpSource_CAN, BswMRuleTrueActionList=AL_EcuM_ClearExpiredWakeUpSource_CAN
          Rule_Generic_ComControl: BswMRuleInitState=BSWM_TRUE, BswMRuleExpressionRef=LE_GenericComControl, BswMRuleFalseActionList=AL_ComControl_OFF, BswMRuleTrueActionList=AL_ComControl_ON
        BswMEventRequestPort_0 (BswMEventRequestPort): BswMEventRequestProcessing=BSWM_IMMEDIATE
          BswMEventRequestSource
            BswMComMInitiateReset
        ReqPort_BswMTimer (BswMModeRequestPort): BswMRequestProcessing=BSWM_DEFERRED
          BswMModeRequestSource
            BswMTimer
        Cond_WriteAll_Timer_EQ_EXPIRED (BswMModeCondition): BswMConditionType=BSWM_EQUALS, BswMConditionMode=ReqPort_BswMTimer
          BswMConditionValue
            BswMBswMode: BswModeCompareValue=BSWM_TIMER_EXPIRED
        Rule_BSW_Module_Init (BswMRule): BswMNestedExecutionOnly=false, BswMRuleInitState=BSWM_FALSE, BswMRuleExpressionRef=LE_BSW_Module_Init, BswMRuleTrueActionList=AL_StartUp
        ReqPort_EcuMStateIndication (BswMModeRequestPort): BswMRequestProcessing=BSWM_IMMEDIATE
          BswMModeRequestSource
            BswMEcuMIndication
        Cond_EcuMState_EQ_STARTUP (BswMModeCondition): BswMConditionType=BSWM_EQUALS, BswMConditionMode=ReqPort_EcuMStateIndication
          BswMConditionValue
            BswMBswMode: BswModeCompareValue=ECUM_STATE_STARTUP
        LE_BSW_Module_Init (BswMLogicalExpression): BswMArgumentRef=Cond_EcuMState_EQ_STARTUP
        Cond_ReadAll_Timer_EQ_EXPIRED (BswMModeCondition): BswMConditionType=BSWM_EQUALS, BswMConditionMode=ReqPort_BswMTimer
          BswMConditionValue
            BswMBswMode: BswModeCompareValue=BSWM_TIMER_EXPIRED
        5 x BswMLogicalExpression:
          LE_RX_ComMPnc_29_CanChannel_0: BswMLogicalOperator=BSWM_AND, BswMArgumentRef=Cond_ComMIndication_ComMPnc_29_NEQ_COMM_PNC_NO_COMMUNICATION, BswMArgumentRef=Cond_CanSMIndication_CanChannel_0_NEQ_CANSM_BSWM_NO_COMMUNICATION
          LE_RX_DM_ComMPnc_29_CanChannel_0: BswMLogicalOperator=BSWM_AND, BswMArgumentRef=Cond_ComMIndication_ComMPnc_29_NEQ_COMM_PNC_NO_COMMUNICATION, BswMArgumentRef=Cond_CanSMIndication_CanChannel_0_EQ_CANSM_BSWM_FULL_COMMUNICATION
          LE_TX_DISABLE_ComMPnc_29_CanChannel_0: BswMArgumentRef=Cond_ComMIndication_ComMPnc_29_EQ_COMM_PNC_NO_COMMUNICATION
          LE_TX_ENABLE_ComMPnc_29_CanChannel_0: BswMLogicalOperator=BSWM_AND, BswMArgumentRef=Cond_ComMIndication_ComMPnc_29_NEQ_COMM_PNC_NO_COMMUNICATION, BswMArgumentRef=Cond_CanSMIndication_CanChannel_0_EQ_CANSM_BSWM_FULL_COMMUNICATION, BswMArgumentRef=Cond_GerericCanSMBusOff_CanChannel_0_EQ_GENERIC_CANSMBUSOFF_BUSOFF_SILENT
          LE_TX_ENABLE_REINIT_ComMPnc_29_CanChannel_0: BswMLogicalOperator=BSWM_AND, BswMArgumentRef=Cond_ComMIndication_ComMPnc_29_NEQ_COMM_PNC_NO_COMMUNICATION, BswMArgumentRef=Cond_CanSMIndication_CanChannel_0_EQ_CANSM_BSWM_FULL_COMMUNICATION, BswMArgumentRef=Cond_GerericCanSMBusOff_CanChannel_0_EQ_GENERIC_CANSMBUSOFF_NO_COM
        Cond_ComMIndication_ComMPnc_29_EQ_COMM_PNC_NO_COMMUNICATION (BswMModeCondition): BswMConditionType=BSWM_EQUALS, BswMConditionMode=ReqPort_ComM_Pnc_ComMPnc_29
          BswMConditionValue
            BswMBswMode: BswModeCompareValue=COMM_PNC_NO_COMMUNICATION
        Cond_ComMIndication_ComMPnc_29_NEQ_COMM_PNC_NO_COMMUNICATION (BswMModeCondition): BswMConditionType=BSWM_EQUALS_NOT, BswMConditionMode=ReqPort_ComM_Pnc_ComMPnc_29
          BswMConditionValue
            BswMBswMode: BswModeCompareValue=COMM_PNC_NO_COMMUNICATION
        ReqPort_ComM_Pnc_ComMPnc_29 (BswMModeRequestPort): BswMRequestProcessing=BSWM_DEFERRED
          BswMModeRequestSource
            BswMComMPncRequest: BswMComMPncRef=ComMPnc_29
        5 x BswMRule, all with BswMNestedExecutionOnly=false, BswMRuleInitState=BSWM_FALSE:
          Rule_RX_ComMPnc_29: BswMRuleExpressionRef=LE_RX_ComMPnc_29_CanChannel_0, BswMRuleFalseActionList=AL_RxDisable_ComMPnc_29, BswMRuleTrueActionList=AL_RxEnable_ComMPnc_29
          Rule_RX_DM_ComMPnc_29: BswMRuleExpressionRef=LE_RX_DM_ComMPnc_29_CanChannel_0, BswMRuleFalseActionList=AL_RxDMDisable_ComMPnc_29, BswMRuleTrueActionList=AL_RxDMEnable_ComMPnc_29
          Rule_TX_DISABLE_ComMPnc_29: BswMRuleExpressionRef=LE_TX_DISABLE_ComMPnc_29_CanChannel_0, BswMRuleTrueActionList=AL_TxDisable_ComMPnc_29
          Rule_TX_ENABLE_ComMPnc_29: BswMRuleExpressionRef=LE_TX_ENABLE_ComMPnc_29_CanChannel_0, BswMRuleTrueActionList=AL_TxEnable_ComMPnc_29
          Rule_TX_ENABLE_REINIT_ComMPnc_29: BswMRuleExpressionRef=LE_TX_ENABLE_REINIT_ComMPnc_29_CanChannel_0, BswMRuleTrueActionList=AL_TxEnableReInit_ComMPnc_29
        6 x BswMLogicalExpression:
          LE_RX_ComMPnc_17_CanChannel_0: BswMLogicalOperator=BSWM_AND, BswMArgumentRef=Cond_ComMIndication_ComMPnc_17_NEQ_COMM_PNC_NO_COMMUNICATION, BswMArgumentRef=Cond_CanSMIndication_CanChannel_0_NEQ_CANSM_BSWM_NO_COMMUNICATION
          LE_RX_DM_ComMPnc_17_CanChannel_0: BswMLogicalOperator=BSWM_AND, BswMArgumentRef=Cond_ComMIndication_ComMPnc_17_NEQ_COMM_PNC_NO_COMMUNICATION, BswMArgumentRef=Cond_CanSMIndication_CanChannel_0_EQ_CANSM_BSWM_FULL_COMMUNICATION
          LE_TX_DISABLE_ComMPnc_17_CanChannel_0: BswMArgumentRef=Cond_ComMIndication_ComMPnc_17_EQ_COMM_PNC_NO_COMMUNICATION
          LE_TX_ENABLE_ComMPnc_17_CanChannel_0: BswMLogicalOperator=BSWM_AND, BswMArgumentRef=Cond_ComMIndication_ComMPnc_17_NEQ_COMM_PNC_NO_COMMUNICATION, BswMArgumentRef=Cond_CanSMIndication_CanChannel_0_EQ_CANSM_BSWM_FULL_COMMUNICATION, BswMArgumentRef=Cond_GerericCanSMBusOff_CanChannel_0_EQ_GENERIC_CANSMBUSOFF_BUSOFF_SILENT
          LE_TX_ENABLE_REINIT_ComMPnc_17_CanChannel_0: BswMLogicalOperator=BSWM_AND, BswMArgumentRef=Cond_ComMIndication_ComMPnc_17_NEQ_COMM_PNC_NO_COMMUNICATION, BswMArgumentRef=Cond_CanSMIndication_CanChannel_0_EQ_CANSM_BSWM_FULL_COMMUNICATION, BswMArgumentRef=Cond_GerericCanSMBusOff_CanChannel_0_EQ_GENERIC_CANSMBUSOFF_NO_COM
          LE_ComM_AllChanel_FULL_COM: BswMArgumentRef=Cond_CanSMIndication_CanChannel_0_EQ_CANSM_BSWM_FULL_COMMUNICATION
        5 x BswMModeCondition:
          Cond_ComMIndication_ComMPnc_17_EQ_COMM_PNC_NO_COMMUNICATION: BswMConditionType=BSWM_EQUALS, BswMConditionMode=ReqPort_ComM_Pnc_ComMPnc_17
            BswMConditionValue
              BswMBswMode: BswModeCompareValue=COMM_PNC_NO_COMMUNICATION
          Cond_ComMIndication_ComMPnc_17_NEQ_COMM_PNC_NO_COMMUNICATION: BswMConditionType=BSWM_EQUALS_NOT, BswMConditionMode=ReqPort_ComM_Pnc_ComMPnc_17
            BswMConditionValue
              BswMBswMode: BswModeCompareValue=COMM_PNC_NO_COMMUNICATION
          Cond_Generic_EQ_ECU_SLEEP_Allowed: BswMConditionType=BSWM_EQUALS, BswMConditionMode=RepPort_ECUSleepControl
            BswMConditionValue
              BswMBswMode: BswMBswRequestedMode=1
          Cond_EcuMState_EQ_ECUM_STATE_POSTRUN: BswMConditionType=BSWM_EQUALS, BswMConditionMode=ReqPort_EcuMStateIndication
            BswMConditionValue
              BswMBswMode: BswModeCompareValue=ECUM_STATE_APP_POST_RUN
          Cond_EcuMState_EQ_ECUM_STATE_SHUTDOWN: BswMConditionType=BSWM_EQUALS, BswMConditionMode=ReqPort_EcuMStateIndication
            BswMConditionValue
              BswMBswMode: BswModeCompareValue=ECUM_STATE_SHUTDOWN
        ReqPort_ComM_Pnc_ComMPnc_17 (BswMModeRequestPort): BswMRequestProcessing=BSWM_DEFERRED
          BswMModeRequestSource
            BswMComMPncRequest: BswMComMPncRef=ComMPnc_17
        RepPort_ECUSleepControl (BswMModeRequestPort): BswMRequestProcessing=BSWM_IMMEDIATE
          BswMModeRequestSource
            BswMGenericRequest: BswMModeRequesterId=95
        9 x BswMRule, all with BswMNestedExecutionOnly=false, BswMRuleInitState=BSWM_FALSE:
          Rule_RX_ComMPnc_17: BswMRuleExpressionRef=LE_RX_ComMPnc_17_CanChannel_0, BswMRuleFalseActionList=AL_RxDisable_ComMPnc_17, BswMRuleTrueActionList=AL_RxEnable_ComMPnc_17
          Rule_RX_DM_ComMPnc_17: BswMRuleExpressionRef=LE_RX_DM_ComMPnc_17_CanChannel_0, BswMRuleFalseActionList=AL_RxDMDisable_ComMPnc_17, BswMRuleTrueActionList=AL_RxDMEnable_ComMPnc_17
          Rule_TX_DISABLE_ComMPnc_17: BswMRuleExpressionRef=LE_TX_DISABLE_ComMPnc_17_CanChannel_0, BswMRuleTrueActionList=AL_TxDisable_ComMPnc_17
          Rule_TX_ENABLE_ComMPnc_17: BswMRuleExpressionRef=LE_TX_ENABLE_ComMPnc_17_CanChannel_0, BswMRuleTrueActionList=AL_TxEnable_ComMPnc_17
          Rule_TX_ENABLE_REINIT_ComMPnc_17: BswMRuleExpressionRef=LE_TX_ENABLE_REINIT_ComMPnc_17_CanChannel_0, BswMRuleTrueActionList=AL_TxEnableReInit_ComMPnc_17
          Rule_ComM_AllChanel_FULL_COM: BswMRuleExpressionRef=LE_ComM_AllChanel_FULL_COM
          Rule_TX_DISABLE_CanChannel_0: BswMRuleExpressionRef=LE_TX_DISABLE_CanChannel_0, BswMRuleTrueActionList=AL_TxDisable_CanChannel_0
          Rule_TX_ENABLE_CanChannel_0: BswMRuleExpressionRef=LE_TX_ENABLE_CanChannel_0, BswMRuleTrueActionList=AL_TxEnable_CanChannel_0
          Rule_TX_ENABLE_REINIT_CanChannel_0: BswMRuleExpressionRef=LE_TX_ENABLE_REINIT_CanChannel_0, BswMRuleTrueActionList=AL_TxEnableReInit_CanChannel_0
        4 x BswMLogicalExpression, all with BswMLogicalOperator=BSWM_OR:
          LE_DCM_Normal_Rx_Enable_CanChannel_0: BswMArgumentRef=Cond_DcmIndication_CanChannel_0_EQ_DCM_ENABLE_RX_TX_NORM, BswMArgumentRef=Cond_DcmIndication_CanChannel_0_EQ_DCM_ENABLE_RX_DISABLE_TX_NORM, BswMArgumentRef=Cond_DcmIndication_CanChannel_0_EQ_DCM_ENABLE_RX_TX_NORM_NM, BswMArgumentRef=Cond_DcmIndication_CanChannel_0_EQ_DCM_ENABLE_RX_DISABLE_TX_NORM_NM
          LE_DCM_Normal_Rx_Disable_CanChannel_0: BswMArgumentRef=Cond_DcmIndication_CanChannel_0_EQ_DCM_DISABLE_RX_ENABLE_TX_NORM, BswMArgumentRef=Cond_DcmIndication_CanChannel_0_EQ_DCM_DISABLE_RX_TX_NORMAL, BswMArgumentRef=Cond_DcmIndication_CanChannel_0_EQ_DCM_DISABLE_RX_ENABLE_TX_NORM_NM, BswMArgumentRef=Cond_DcmIndication_CanChannel_0_EQ_DCM_DISABLE_RX_TX_NORM_NM
          LE_DCM_Normal_Tx_Enable_CanChannel_0: BswMArgumentRef=Cond_DcmIndication_CanChannel_0_EQ_DCM_ENABLE_RX_TX_NORM, BswMArgumentRef=Cond_DcmIndication_CanChannel_0_EQ_DCM_DISABLE_RX_ENABLE_TX_NORM, BswMArgumentRef=Cond_DcmIndication_CanChannel_0_EQ_DCM_ENABLE_RX_TX_NORM_NM, BswMArgumentRef=Cond_DcmIndication_CanChannel_0_EQ_DCM_DISABLE_RX_ENABLE_TX_NORM_NM
          LE_DCM_Normal_Tx_Disable_CanChannel_0: BswMArgumentRef=Cond_DcmIndication_CanChannel_0_EQ_DCM_ENABLE_RX_DISABLE_TX_NORM, BswMArgumentRef=Cond_DcmIndication_CanChannel_0_EQ_DCM_DISABLE_RX_TX_NORMAL, BswMArgumentRef=Cond_DcmIndication_CanChannel_0_EQ_DCM_ENABLE_RX_DISABLE_TX_NORM_NM, BswMArgumentRef=Cond_DcmIndication_CanChannel_0_EQ_DCM_DISABLE_RX_TX_NORM_NM
        ReqPort_Dcm_CanChannel_0 (BswMModeRequestPort): BswMRequestProcessing=BSWM_IMMEDIATE
          BswMModeRequestSource
            BswMDcmComModeRequest: BswMDcmComMChannelRef=ComMCh_ECU
        LE_DCM_Nm_Tx_Enable_CanChannel_0 (BswMLogicalExpression):
          BswMLogicalOperator = BSWM_OR
          BswMArgumentRef = Cond_DcmIndication_CanChannel_0_EQ_DCM_ENABLE_RX_TX_NM
          BswMArgumentRef = Cond_DcmIndication_CanChannel_0_EQ_DCM_DISABLE_RX_ENABLE_TX_NM
          BswMArgumentRef = Cond_DcmIndication_CanChannel_0_EQ_DCM_ENABLE_RX_TX_NORM_NM
          BswMArgumentRef = Cond_DcmIndication_CanChannel_0_EQ_DCM_DISABLE_RX_ENABLE_TX_NORM_NM
        12 x BswMModeCondition, all with BswMConditionType=BSWM_EQUALS, BswMConditionMode=ReqPort_Dcm_CanChannel_0:
          Cond_DcmIndication_CanChannel_0_EQ_DCM_ENABLE_RX_TX_NORM
            BswMConditionValue
              BswMBswMode: BswModeCompareValue=DCM_ENABLE_RX_TX_NORM
          Cond_DcmIndication_CanChannel_0_EQ_DCM_ENABLE_RX_DISABLE_TX_NORM
            BswMConditionValue
              BswMBswMode: BswModeCompareValue=DCM_ENABLE_RX_DISABLE_TX_NORM
          Cond_DcmIndication_CanChannel_0_EQ_DCM_DISABLE_RX_ENABLE_TX_NORM
            BswMConditionValue
              BswMBswMode: BswModeCompareValue=DCM_DISABLE_RX_ENABLE_TX_NORM
          Cond_DcmIndication_CanChannel_0_EQ_DCM_DISABLE_RX_TX_NORMAL
            BswMConditionValue
              BswMBswMode: BswModeCompareValue=DCM_DISABLE_RX_TX_NORMAL
          Cond_DcmIndication_CanChannel_0_EQ_DCM_ENABLE_RX_TX_NM
            BswMConditionValue
              BswMBswMode: BswModeCompareValue=DCM_ENABLE_RX_TX_NM
          Cond_DcmIndication_CanChannel_0_EQ_DCM_ENABLE_RX_DISABLE_TX_NM
            BswMConditionValue
              BswMBswMode: BswModeCompareValue=DCM_ENABLE_RX_DISABLE_TX_NM
          Cond_DcmIndication_CanChannel_0_EQ_DCM_DISABLE_RX_ENABLE_TX_NM
            BswMConditionValue
              BswMBswMode: BswModeCompareValue=DCM_DISABLE_RX_ENABLE_TX_NM
          Cond_DcmIndication_CanChannel_0_EQ_DCM_DISABLE_RX_TX_NM
            BswMConditionValue
              BswMBswMode: BswModeCompareValue=DCM_DISABLE_RX_TX_NM
          Cond_DcmIndication_CanChannel_0_EQ_DCM_ENABLE_RX_TX_NORM_NM
            BswMConditionValue
              BswMBswMode: BswModeCompareValue=DCM_ENABLE_RX_TX_NORM_NM
          Cond_DcmIndication_CanChannel_0_EQ_DCM_ENABLE_RX_DISABLE_TX_NORM_NM
            BswMConditionValue
              BswMBswMode: BswModeCompareValue=DCM_ENABLE_RX_DISABLE_TX_NORM_NM
          Cond_DcmIndication_CanChannel_0_EQ_DCM_DISABLE_RX_ENABLE_TX_NORM_NM
            BswMConditionValue
              BswMBswMode: BswModeCompareValue=DCM_DISABLE_RX_ENABLE_TX_NORM_NM
          Cond_DcmIndication_CanChannel_0_EQ_DCM_DISABLE_RX_TX_NORM_NM
            BswMConditionValue
              BswMBswMode: BswModeCompareValue=DCM_DISABLE_RX_TX_NORM_NM
        LE_DCM_Nm_Tx_Disable_CanChannel_0 (BswMLogicalExpression):
          BswMLogicalOperator = BSWM_OR
          BswMArgumentRef = Cond_DcmIndication_CanChannel_0_EQ_DCM_ENABLE_RX_DISABLE_TX_NM
          BswMArgumentRef = Cond_DcmIndication_CanChannel_0_EQ_DCM_DISABLE_RX_TX_NM
          BswMArgumentRef = Cond_DcmIndication_CanChannel_0_EQ_DCM_ENABLE_RX_DISABLE_TX_NORM_NM
          BswMArgumentRef = Cond_DcmIndication_CanChannel_0_EQ_DCM_DISABLE_RX_TX_NORM_NM
        6 x BswMRule, all with BswMNestedExecutionOnly=false, BswMRuleInitState=BSWM_FALSE:
          Rule_DCM_Normal_Rx_Enable_CanChannel_0: BswMRuleExpressionRef=LE_DCM_Normal_Rx_Enable_CanChannel_0, BswMRuleTrueActionList=AL_DCM_Normal_Rx_Enable_CanChannel_0
          Rule_DCM_Normal_Rx_Disable_CanChannel_0: BswMRuleExpressionRef=LE_DCM_Normal_Rx_Disable_CanChannel_0, BswMRuleTrueActionList=AL_DCM_Normal_Rx_Disable_CanChannel_0
          Rule_DCM_Normal_Tx_Enable_CanChannel_0: BswMRuleExpressionRef=LE_DCM_Normal_Tx_Enable_CanChannel_0, BswMRuleTrueActionList=AL_DCM_Normal_Tx_Enable_CanChannel_0
          Rule_DCM_Normal_Tx_Disable_CanChannel_0: BswMRuleExpressionRef=LE_DCM_Normal_Tx_Disable_CanChannel_0, BswMRuleTrueActionList=AL_DCM_Normal_Tx_Disable_CanChannel_0
          Rule_DCM_Nm_Tx_Enable_CanChannel_0: BswMRuleExpressionRef=LE_DCM_Nm_Tx_Enable_CanChannel_0, BswMRuleTrueActionList=AL_DCM_Nm_Tx_Enable_CanChannel_0
          Rule_DCM_Nm_Tx_Disable_CanChannel_0: BswMRuleExpressionRef=LE_DCM_Nm_Tx_Disable_CanChannel_0, BswMRuleTrueActionList=AL_DCM_Nm_Tx_Disable_CanChannel_0
        Cond_ComMIndication_ComMPnc_29_EQ_COMM_PNC_FULL_COMMUNICATION (BswMModeCondition): BswMConditionType=BSWM_EQUALS, BswMConditionMode=ReqPort_ComM_Pnc_ComMPnc_29
          BswMConditionValue
            BswMBswMode: BswModeCompareValue=COMM_PNC_REQUESTED
        Cond_ComMIndication_ComMPnc_17_EQ_COMM_PNC_FULL_COMMUNICATION (BswMModeCondition): BswMConditionType=BSWM_EQUALS, BswMConditionMode=ReqPort_ComM_Pnc_ComMPnc_17
          BswMConditionValue
            BswMBswMode: BswModeCompareValue=COMM_PNC_REQUESTED
        8 x BswMLogicalExpression, all with BswMLogicalOperator=BSWM_AND:
          LE_DCM_Normal_Rx_Enable_Pnc_17: BswMArgumentRef=LE_DCM_Normal_Rx_Enable_CanChannel_0, BswMArgumentRef=Cond_ComMIndication_ComMPnc_17_NEQ_COMM_PNC_NO_COMMUNICATION
          LE_DCM_Normal_Rx_Disable_Pnc_17: BswMArgumentRef=LE_DCM_Normal_Rx_Disable_CanChannel_0, BswMArgumentRef=Cond_ComMIndication_ComMPnc_17_NEQ_COMM_PNC_NO_COMMUNICATION
          LE_DCM_Normal_Tx_Enable_Pnc_17: BswMArgumentRef=LE_DCM_Normal_Tx_Enable_CanChannel_0, BswMArgumentRef=Cond_ComMIndication_ComMPnc_17_NEQ_COMM_PNC_NO_COMMUNICATION
          LE_DCM_Normal_Tx_Disable_Pnc_17: BswMArgumentRef=LE_DCM_Normal_Tx_Disable_CanChannel_0, BswMArgumentRef=Cond_ComMIndication_ComMPnc_17_NEQ_COMM_PNC_NO_COMMUNICATION
          LE_DCM_Normal_Rx_Enable_Pnc_29: BswMArgumentRef=LE_DCM_Normal_Rx_Enable_CanChannel_0, BswMArgumentRef=Cond_ComMIndication_ComMPnc_29_NEQ_COMM_PNC_NO_COMMUNICATION
          LE_DCM_Normal_Rx_Disable_Pnc_29: BswMArgumentRef=LE_DCM_Normal_Rx_Disable_CanChannel_0, BswMArgumentRef=Cond_ComMIndication_ComMPnc_29_NEQ_COMM_PNC_NO_COMMUNICATION
          LE_DCM_Normal_Tx_Enable_Pnc_29: BswMArgumentRef=LE_DCM_Normal_Tx_Enable_CanChannel_0, BswMArgumentRef=Cond_ComMIndication_ComMPnc_29_NEQ_COMM_PNC_NO_COMMUNICATION
          LE_DCM_Normal_Tx_Disable_Pnc_29: BswMArgumentRef=LE_DCM_Normal_Tx_Disable_CanChannel_0, BswMArgumentRef=Cond_ComMIndication_ComMPnc_29_NEQ_COMM_PNC_NO_COMMUNICATION
        8 x BswMRule, all with BswMNestedExecutionOnly=false, BswMRuleInitState=BSWM_FALSE:
          Rule_DCM_Normal_Rx_Enable_Pnc_17: BswMRuleExpressionRef=LE_DCM_Normal_Rx_Enable_Pnc_17, BswMRuleTrueActionList=AL_DCM_Normal_Rx_Enable_Pnc_17
          Rule_DCM_Normal_Rx_Disable_Pnc_17: BswMRuleExpressionRef=LE_DCM_Normal_Rx_Disable_Pnc_17, BswMRuleTrueActionList=AL_DCM_Normal_Rx_Disable_Pnc_17
          Rule_DCM_Normal_Tx_Enable_Pnc_17: BswMRuleExpressionRef=LE_DCM_Normal_Tx_Enable_Pnc_17, BswMRuleTrueActionList=AL_DCM_Normal_Tx_Enable_Pnc_17
          Rule_DCM_Normal_Tx_Disable_Pnc_17: BswMRuleExpressionRef=LE_DCM_Normal_Tx_Disable_Pnc_17, BswMRuleTrueActionList=AL_DCM_Normal_Tx_Disable_Pnc_17
          Rule_DCM_Normal_Rx_Enable_Pnc_29: BswMRuleExpressionRef=LE_DCM_Normal_Rx_Enable_Pnc_29, BswMRuleTrueActionList=AL_DCM_Normal_Rx_Enable_Pnc_29
          Rule_DCM_Normal_Rx_Disable_Pnc_29: BswMRuleExpressionRef=LE_DCM_Normal_Rx_Disable_Pnc_29, BswMRuleTrueActionList=AL_DCM_Normal_Rx_Disable_Pnc_29
          Rule_DCM_Normal_Tx_Enable_Pnc_29: BswMRuleExpressionRef=LE_DCM_Normal_Tx_Enable_Pnc_29, BswMRuleTrueActionList=AL_DCM_Normal_Tx_Enable_Pnc_29
          Rule_DCM_Normal_Tx_Disable_Pnc_29: BswMRuleExpressionRef=LE_DCM_Normal_Tx_Disable_Pnc_29, BswMRuleTrueActionList=AL_DCM_Normal_Tx_Disable_Pnc_29
        ReqPort_EcuM_EcuMWakeupSource_Local (BswMModeRequestPort): BswMRequestProcessing=BSWM_IMMEDIATE
          BswMModeRequestSource
            BswMEcuMWakeupSource: BswMEcuMWakeupSrcRef=EcuMWakeupSource_Local
        4 x BswMModeCondition, all with BswMConditionType=BSWM_EQUALS, BswMConditionMode=ReqPort_EcuM_EcuMWakeupSource_Local:
          Cond_EcuMWakeupIndication_EcuMWakeupSource_LOCAL_HCML_EQ_ECUM_WKSTATUS_NONE
            BswMConditionValue
              BswMBswMode: BswModeCompareValue=ECUM_WKSTATUS_NONE
          Cond_EcuMWakeupIndication_EcuMWakeupSource_LOCAL_HCML_EQ_ECUM_WKSTATUS_PENDING
            BswMConditionValue
              BswMBswMode: BswModeCompareValue=ECUM_WKSTATUS_PENDING
          Cond_EcuMWakeupIndication_EcuMWakeupSource_LOCAL_HCML_EQ_ECUM_WKSTATUS_VALIDATED
            BswMConditionValue
              BswMBswMode: BswModeCompareValue=ECUM_WKSTATUS_VALIDATED
          Cond_EcuMWakeupIndication_EcuMWakeupSource_LOCAL_HCML_EQ_ECUM_WKSTATUS_EXPIRED
            BswMConditionValue
              BswMBswMode: BswModeCompareValue=ECUM_WKSTATUS_EXPIRED
        LE_EcuM_AnyWakeupSourceValidated (BswMLogicalExpression):
          BswMLogicalOperator = BSWM_OR
          BswMArgumentRef = Cond_EcuMWakeupIndication_EcuMWakeupSource_CAN_HCML_EQ_ECUM_WKSTATUS_VALIDATED
          BswMArgumentRef = Cond_EcuMWakeupIndication_EcuMWakeupSource_LOCAL_HCML_EQ_ECUM_WKSTATUS_VALIDATED
        Cond_EcuMState_EQ_ECUM_STATE_RUN (BswMModeCondition): BswMConditionType=BSWM_EQUALS, BswMConditionMode=ReqPort_EcuMStateIndication
          BswMConditionValue
            BswMBswMode: BswModeCompareValue=ECUM_STATE_RUN
        Rule_EcuM_StateChange_RunToAppRun (BswMRule):
          BswMNestedExecutionOnly = false
          BswMRuleInitState = BSWM_FALSE
          BswMRuleExpressionRef = LE_EcuM_AnyWakeupSourceValidated
          BswMRuleTrueActionList = AL_EcuM_RequestRun
        Rule_EcuM_State_AppRun (BswMRule): BswMNestedExecutionOnly=false, BswMRuleInitState=BSWM_FALSE, BswMRuleExpressionRef=LE_EcuM_State_AppRun, BswMRuleTrueActionList=AL_EcuM_ComMAllow
        Cond_EcuMState_EQ_ECUM_STATE_APP_RUN (BswMModeCondition): BswMConditionType=BSWM_EQUALS, BswMConditionMode=ReqPort_EcuMStateIndication
          BswMConditionValue
            BswMBswMode: BswModeCompareValue=ECUM_STATE_APP_RUN
        LE_EcuM_State_AppRun (BswMLogicalExpression): BswMArgumentRef=Cond_EcuMState_EQ_ECUM_STATE_APP_RUN
        Rule_EcuM_WakeupSourceClear_Validated (BswMRule):
          BswMNestedExecutionOnly = false
          BswMRuleInitState = BSWM_FALSE
          BswMRuleExpressionRef = LE_EcuM_ValidatedWakeupSourceShouldClear
          BswMRuleTrueActionList = AL_EcuM_WakeupSourceClear_Validated
        3 x BswMLogicalExpression:
          LE_EcuM_ValidatedWakeupSourceShouldClear: BswMLogicalOperator=BSWM_AND, BswMArgumentRef=Cond_EcuMState_EQ_ECUM_STATE_APP_RUN, BswMArgumentRef=LE_EcuM_AnyWakeupSourceValidated
          LE_EcuM_State_Sleep: BswMArgumentRef=Cond_EcuMState_EQ_ECUM_STATE_SLEEP
          LE_EcuM_WakeupSourceClear_EcuMWakeupSource_LOCAL: BswMArgumentRef=Cond_EcuMWakeupIndication_EcuMWakeupSource_LOCAL_HCML_EQ_ECUM_WKSTATUS_VALIDATED
        Cond_EcuMState_EQ_ECUM_STATE_SLEEP (BswMModeCondition): BswMConditionType=BSWM_EQUALS, BswMConditionMode=ReqPort_EcuMStateIndication
          BswMConditionValue
            BswMBswMode: BswModeCompareValue=ECUM_STATE_SLEEP
        Rule_EcuM_State_Sleep (BswMRule): BswMNestedExecutionOnly=false, BswMRuleInitState=BSWM_FALSE, BswMRuleExpressionRef=LE_EcuM_State_Sleep, BswMRuleTrueActionList=AL_EcuM_State_Sleep
        Rule_EcuM_WakeupSourceClear_EcuMWakeupSource_Local (BswMRule):
          BswMNestedExecutionOnly = false
          BswMRuleInitState = BSWM_FALSE
          BswMRuleExpressionRef = LE_EcuM_WakeupSourceClear_EcuMWakeupSource_LOCAL
          BswMRuleTrueActionList = AL_EcuM_ClearWakeUpSource_EcuMWakeupSource_Local
      BswMModeControl
        14 x BswMAction:
          BswMAction_RxEnableDM_CanChannel_0
            BswMAvailableActions
              BswMDeadlineMonitoringControl: BswMEnabledDMPduGroupRef=Com_RxPduGroup_CAN_CONTROLLER_0_ECU_ECU
          BswMAction_RxDisableDM_CanChannel_0
            BswMAvailableActions
              BswMDeadlineMonitoringControl: BswMDisabledDMPduGroupRef=Com_RxPduGroup_CAN_CONTROLLER_0_ECU_ECU
          BswMAction_RxEnableGroupSwitch_CanChannel_0
            BswMAvailableActions
              BswMPduGroupSwitch: BswMPduGroupSwitchReinit=false, BswMEnabledPduGroupRef=Com_RxPduGroup_CAN_CONTROLLER_0_ECU_ECU
          BswMAction_RxDisableGroupSwitch_CanChannel_0
            BswMAvailableActions
              BswMPduGroupSwitch: BswMPduGroupSwitchReinit=false, BswMDisabledPduGroupRef=Com_RxPduGroup_CAN_CONTROLLER_0_ECU_ECU
          BswMAction_GenericCanSmBusOff_NO_COM_CanChannel_0
            BswMAvailableActions
              BswMUserCallout: BswMUserCalloutFunction=GenericSwitch_CanSmBusOff_NoCom_CanChannel_0
          BswMAction_GenericCanSmBusOff_BUSOFF_SILENT_CanChannel_0
            BswMAvailableActions
              BswMUserCallout: BswMUserCalloutFunction=GenericSwitch_CanSmBusOff_BusOffSilent_CanChannel_0
          BswMAction_EcuM_SetStatus_RUN
            BswMAvailableActions
              BswMEcuMStateSwitch: BswMEcuMState=BSWM_ECUM_STATE_APP_RUN
          BswMAction_EcuM_SetStatus_POST_RUN
            BswMAvailableActions
              BswMEcuMStateSwitch: BswMEcuMState=BSWM_ECUM_STATE_APP_POST_RUN
          BswMAction_EcuM_SetStatus_SLEEP
            BswMAvailableActions
              BswMEcuMStateSwitch: BswMEcuMState=BSWM_ECUM_STATE_SLEEP
          BswMAction_EcuM_SetStatus_SHUTDOWN
            BswMAvailableActions
              BswMEcuMStateSwitch: BswMEcuMState=BSWM_ECUM_STATE_SHUTDOWN
          BswMAction_EcuM_GoHalt
            BswMAvailableActions
              BswMEcuMGoDownHaltPoll: BswMEcuMUserIdRef=EcuMFlexUserConfig
          BswMAction_EcuM_RequestRun
            BswMAvailableActions
              BswMUserCallout: BswMUserCalloutFunction=BswM_EcuM_RequestRun
          BswMAction_EcuM_ReleaseRun
            BswMAvailableActions
              BswMUserCallout: BswMUserCalloutFunction=BswM_EcuM_ReleaseRun
          BswMAction_ComMAllow_CanChannel_0
            BswMAvailableActions
              BswMComMAllowCom: BswMComAllowed=true, BswMComMAllowChannelRef=ComMCh_ECU
        14 x BswMActionList, all with BswMActionListExecution=BSWM_TRIGGER:
          AL_GenericCanSmBusOff_NO_COM_CanChannel_0
            Item_Action_GenericCanSmBusOff_NO_COM_CanChannel_0 (BswMActionListItem): BswMAbortOnFail=false, BswMActionListItemIndex=0, BswMActionListItemRef=BswMAction_GenericCanSmBusOff_NO_COM_CanChannel_0
          AL_GenericCanSmBusOff_BUSOFF_SILENT_CanChannel_0
            Item_Action_GenericCanSmBusOff_BUSOFF_SILENT_CanChannel_0 (BswMActionListItem): BswMAbortOnFail=false, BswMActionListItemIndex=0, BswMActionListItemRef=BswMAction_GenericCanSmBusOff_BUSOFF_SILENT_CanChannel_0
          AL_EcuM_RequestStatus_RUN
            Item_Action_EcuM_SetStatus_RUN (BswMActionListItem): BswMAbortOnFail=false, BswMActionListItemIndex=0, BswMActionListItemRef=BswMAction_EcuM_SetStatus_RUN
            Item_Action_WakeupSourceDisable (BswMActionListItem): BswMAbortOnFail=false, BswMActionListItemIndex=1, BswMActionListItemRef=BswMAction_DisableWakeup
          AL_EcuM_RequestStatus_POSTRUN
            Item_Action_EcuM_SetStatus_POST_RUN (BswMActionListItem): BswMAbortOnFail=false, BswMActionListItemIndex=0, BswMActionListItemRef=BswMAction_EcuM_SetStatus_POST_RUN
          AL_ComM_AllChanel_NO_COM
            3 x BswMActionListItem, all with BswMAbortOnFail=false:
              Item_Action_EnableWakeup: BswMActionListItemIndex=0, BswMActionListItemRef=BswMAction_EnableWakeup
              Item_Action_EcuM_ReleaseRun: BswMActionListItemIndex=1, BswMActionListItemRef=BswMAction_EcuM_ReleaseRun
              Item_Action_EcuM_GoHalt: BswMActionListItemIndex=2, BswMActionListItemRef=BswMAction_EcuM_GoHalt
          AL_NmCtrol_Enable_CanChannel_0
            Item_Action_NmCtrol_Enable_CanChannel_0 (BswMActionListItem): BswMAbortOnFail=false, BswMActionListItemIndex=0, BswMActionListItemRef=BswMAction_NmCtrol_Enable_CanChannel_0
          AL_NmCtrol_Disable_CanChannel_0
            Item_Action_NmCtrol_Disable_CanChannel_0 (BswMActionListItem): BswMAbortOnFail=false, BswMActionListItemIndex=0, BswMActionListItemRef=BswMAction_NmCtrol_Disable_CanChannel_0
          AL_DCM_Normal_Rx_Enable_CanChannel_0
            Item_Action_RxEnableGroupSwitch_CanChannel_0 (BswMActionListItem): BswMAbortOnFail=false, BswMActionListItemIndex=0, BswMActionListItemRef=BswMAction_RxEnableGroupSwitch_CanChannel_0
          AL_DCM_Normal_Rx_Disable_CanChannel_0
            Item_Action_RxDisabledGroupSwitch_CanChannel_0 (BswMActionListItem): BswMAbortOnFail=false, BswMActionListItemIndex=0, BswMActionListItemRef=BswMAction_RxDisableGroupSwitch_CanChannel_0
          AL_DCM_Normal_Tx_Enable_CanChannel_0
            Item_Action_TxEnableGroupSwitch_CanChannel_0 (BswMActionListItem): BswMAbortOnFail=false, BswMActionListItemIndex=0, BswMActionListItemRef=BswMAction_TxEnableGroupSwitch_CanChannel_0
          AL_DCM_Normal_Tx_Disable_CanChannel_0
            Item_Action_TxDisabledGroupSwitch_CanChannel_0 (BswMActionListItem): BswMAbortOnFail=false, BswMActionListItemIndex=0, BswMActionListItemRef=BswMAction_TxDisabledGroupSwitch_CanChannel_0
          AL_DCM_Nm_Tx_Enable_CanChannel_0
            Item_Action_NmCtrol_Enable_CanChannel_0 (BswMActionListItem): BswMAbortOnFail=false, BswMActionListItemIndex=0, BswMActionListItemRef=BswMAction_NmCtrol_Enable_CanChannel_0
          AL_DCM_Nm_Tx_Disable_CanChannel_0
            Item_Action_NmCtrol_Disable_CanChannel_0 (BswMActionListItem): BswMAbortOnFail=false, BswMActionListItemIndex=0, BswMActionListItemRef=BswMAction_NmCtrol_Disable_CanChannel_0
          AL_EcuM_ClearExpiredWakeUpSource_CAN
            4 x BswMActionListItem, all with BswMAbortOnFail=false:
              Item_Action_EnableWakeup: BswMActionListItemIndex=0, BswMActionListItemRef=BswMAction_EnableWakeup
              Item_Action_EcuM_ReleaseRun: BswMActionListItemIndex=1, BswMActionListItemRef=BswMAction_EcuM_ReleaseRun
              Item_Action_EcuM_ClearWakeUpSource: BswMActionListItemIndex=2, BswMActionListItemRef=AL_EcuM_WakeupSourceClear_Expired
              Item_Action_EcuM_GoHalt: BswMActionListItemIndex=3, BswMActionListItemRef=BswMAction_EcuM_GoHalt
        5 x BswMAction:
          BswMAction_ComMDisAllow_CanChannel_0
            BswMAvailableActions
              BswMComMAllowCom: BswMComAllowed=false, BswMComMAllowChannelRef=ComMCh_ECU
          BswMAction_ComMRequestFULL_CanChannel_0
            BswMAvailableActions
              BswMComMModeSwitch: BswMComMRequestedMode=BSWM_COMM_FULL_COMMUNICATION, BswMComMUserRef=ComMUser_ECU
          BswMAction_EcuMSelectShutdownTarget
            BswMAvailableActions
              BswMEcuMSelectShutdownTarget: BswMEcuMShutdownTarget=BSWM_ECUM_SHUTDOWN_TARGET_SLEEP, BswMEcuMSleepModeRef=EcuMSleepMode
          BswMAction_NmCtrol_Enable_CanChannel_0
            BswMAvailableActions
              BswMNMControl: BswMNMAction=BSWM_NM_ENABLE, BswMComMNetworkHandleRef=ComMCh_ECU
          BswMAction_NmCtrol_Disable_CanChannel_0
            BswMAvailableActions
              BswMNMControl: BswMNMAction=BSWM_NM_DISABLE, BswMComMNetworkHandleRef=ComMCh_ECU
        6 x BswMActionList, all with BswMActionListExecution=BSWM_TRIGGER:
          AL_RxEnableDM_CanChannel_0
            Item_Action_RxEnableDM_CanChannel_0 (BswMActionListItem): BswMAbortOnFail=false, BswMActionListItemIndex=0, BswMActionListItemRef=BswMAction_RxEnableDM_CanChannel_0
          AL_RxDisableDM_CanChannel_0
            Item_Action_RxDisableDM_CanChannel_0 (BswMActionListItem): BswMAbortOnFail=false, BswMActionListItemIndex=0, BswMActionListItemRef=BswMAction_RxDisableDM_CanChannel_0
          AL_RxEnableGroupSwitch_CanChannel_0
            Item_Action_RxEnableGroupSwitch_CanChannel_0 (BswMActionListItem): BswMAbortOnFail=false, BswMActionListItemIndex=0, BswMActionListItemRef=BswMAction_RxEnableGroupSwitch_CanChannel_0
          AL_RxDisableGroupSwitch_CanChannel_0
            Item_Action_RxDisabledGroupSwitch_CanChannel_0 (BswMActionListItem): BswMAbortOnFail=false, BswMActionListItemIndex=0, BswMActionListItemRef=BswMAction_RxDisableGroupSwitch_CanChannel_0
          AL_ComControl_ON
            3 x BswMActionListItem, all with BswMAbortOnFail=false:
              Item_Action_RxEnableGroupSwitch_CanChannel_0: BswMActionListItemIndex=0, BswMActionListItemRef=BswMAction_RxEnableGroupSwitch_CanChannel_0
              Item_Action_RxEnableDM_CanChannel_0: BswMActionListItemIndex=1, BswMActionListItemRef=BswMAction_RxEnableDM_CanChannel_0
              Item_Action_TxEnableGroupSwitch_CanChannel_0: BswMActionListItemIndex=2, BswMActionListItemRef=BswMAction_TxEnableGroupSwitch_CanChannel_0
          AL_ComControl_OFF
            3 x BswMActionListItem, all with BswMAbortOnFail=false:
              Item_Action_RxDisabledGroupSwitch_CanChannel_0: BswMActionListItemIndex=0, BswMActionListItemRef=BswMAction_RxDisableGroupSwitch_CanChannel_0
              Item_Action_RxDisableDM_CanChannel_0: BswMActionListItemIndex=1, BswMActionListItemRef=BswMAction_RxDisableDM_CanChannel_0
              Item_Action_TxDisabledGroupSwitch_CanChannel_0: BswMActionListItemIndex=2, BswMActionListItemRef=BswMAction_TxDisabledGroupSwitch_CanChannel_0
        3 x BswMAction:
          BswMAction_EcuM_POST_RUN_Release
            BswMAvailableActions
              BswMUserCallout: BswMUserCalloutFunction=BswM_EcuM_ReleasePostRun
          BswMAction_EcuM_POST_RUN_Request
            BswMAvailableActions
              BswMUserCallout: BswMUserCalloutFunction=BswM_EcuM_RequestPostRun
          BswMAction_BSW_Module_Init
            BswMAvailableActions
              BswMEcuMDriverInitListBswM: BswMEcuMDriverInitListBswMRef=EcuMDriverInitListBswM_0
        AL_StartUp (BswMActionList): BswMActionListExecution=BSWM_TRIGGER
          Item_Action_BswMAction_BswMAction_BSW_Module_Init (BswMActionListItem): BswMAbortOnFail=false, BswMActionListItemIndex=0, BswMActionListItemRef=BswMAction_BSW_Module_Init
        7 x BswMAction:
          BswMAction_RxEnableDM_ComMPnc_29
            BswMAvailableActions
              BswMDeadlineMonitoringControl: BswMEnabledDMPduGroupRef=ComIPduGroup_PN29_Rx
          BswMAction_RxDisabledDM_ComMPnc_29
            BswMAvailableActions
              BswMDeadlineMonitoringControl: BswMDisabledDMPduGroupRef=ComIPduGroup_PN29_Rx
          BswMAction_RxEnableGroupSwitch_ComMPnc_29
            BswMAvailableActions
              BswMPduGroupSwitch: BswMPduGroupSwitchReinit=false, BswMEnabledPduGroupRef=ComIPduGroup_PN29_Rx
          BswMAction_RxDisabledGroupSwitch_ComMPnc_29
            BswMAvailableActions
              BswMPduGroupSwitch: BswMPduGroupSwitchReinit=false, BswMDisabledPduGroupRef=ComIPduGroup_PN29_Rx
          BswMAction_TxEnableGroupSwitch_ComMPnc_29
            BswMAvailableActions
              BswMPduGroupSwitch: BswMPduGroupSwitchReinit=false, BswMEnabledPduGroupRef=ComIPduGroup_PN29_Tx
          BswMAction_TxDisabledGroupSwitch_ComMPnc_29
            BswMAvailableActions
              BswMPduGroupSwitch: BswMPduGroupSwitchReinit=false, BswMDisabledPduGroupRef=ComIPduGroup_PN29_Tx
          BswMAction_TxEnableGroupSwitch_ReInit_ComMPnc_29
            BswMAvailableActions
              BswMPduGroupSwitch: BswMPduGroupSwitchReinit=true, BswMEnabledPduGroupRef=ComIPduGroup_PN29_Tx
        7 x BswMActionList, all with BswMActionListExecution=BSWM_TRIGGER:
          AL_RxDMEnable_ComMPnc_29
            Item_Action_RxEnableDM_ComMPnc_29 (BswMActionListItem): BswMAbortOnFail=false, BswMActionListItemIndex=0, BswMActionListItemRef=BswMAction_RxEnableDM_ComMPnc_29
          AL_RxDMDisable_ComMPnc_29
            Item_Action_RxDisabledDM_ComMPnc_29 (BswMActionListItem): BswMAbortOnFail=false, BswMActionListItemIndex=0, BswMActionListItemRef=BswMAction_RxDisabledDM_ComMPnc_29
          AL_RxEnable_ComMPnc_29
            Item_Action_RxEnableGroupSwitch_ComMPnc_29 (BswMActionListItem): BswMAbortOnFail=false, BswMActionListItemIndex=0, BswMActionListItemRef=BswMAction_RxEnableGroupSwitch_ComMPnc_29
          AL_RxDisable_ComMPnc_29
            Item_Action_RxDisabledGroupSwitch_ComMPnc_29 (BswMActionListItem): BswMAbortOnFail=false, BswMActionListItemIndex=0, BswMActionListItemRef=BswMAction_RxDisabledGroupSwitch_ComMPnc_29
          AL_TxEnable_ComMPnc_29
            Item_Action_TxEnableGroupSwitch_ComMPnc_29 (BswMActionListItem): BswMAbortOnFail=false, BswMActionListItemIndex=0, BswMActionListItemRef=BswMAction_TxEnableGroupSwitch_ComMPnc_29
          AL_TxDisable_ComMPnc_29
            Item_Action_TxDisabledGroupSwitch_ComMPnc_29 (BswMActionListItem): BswMAbortOnFail=false, BswMActionListItemIndex=0, BswMActionListItemRef=BswMAction_TxDisabledGroupSwitch_ComMPnc_29
          AL_TxEnableReInit_ComMPnc_29
            Item_Action_TxEnableGroupSwitch_ReInit_ComMPnc_29 (BswMActionListItem): BswMAbortOnFail=false, BswMActionListItemIndex=0, BswMActionListItemRef=BswMAction_TxEnableGroupSwitch_ReInit_ComMPnc_29
        9 x BswMAction:
          BswMAction_RxEnableDM_ComMPnc_17
            BswMAvailableActions
              BswMDeadlineMonitoringControl: BswMEnabledDMPduGroupRef=ComIPduGroup_PN17_Rx
          BswMAction_RxDisabledDM_ComMPnc_17
            BswMAvailableActions
              BswMDeadlineMonitoringControl: BswMDisabledDMPduGroupRef=ComIPduGroup_PN17_Rx
          BswMAction_RxEnableGroupSwitch_ComMPnc_17
            BswMAvailableActions
              BswMPduGroupSwitch: BswMPduGroupSwitchReinit=false, BswMEnabledPduGroupRef=ComIPduGroup_PN17_Rx
          BswMAction_RxDisabledGroupSwitch_ComMPnc_17
            BswMAvailableActions
              BswMPduGroupSwitch: BswMPduGroupSwitchReinit=false, BswMDisabledPduGroupRef=ComIPduGroup_PN17_Rx
          BswMAction_TxEnableGroupSwitch_ComMPnc_17
            BswMAvailableActions
              BswMPduGroupSwitch: BswMPduGroupSwitchReinit=false, BswMEnabledPduGroupRef=ComIPduGroup_PN17_Tx
          BswMAction_TxDisabledGroupSwitch_ComMPnc_17
            BswMAvailableActions
              BswMPduGroupSwitch: BswMPduGroupSwitchReinit=false, BswMDisabledPduGroupRef=ComIPduGroup_PN17_Tx
          BswMAction_TxEnableGroupSwitch_ReInit_ComMPnc_17
            BswMAvailableActions
              BswMPduGroupSwitch: BswMPduGroupSwitchReinit=true, BswMEnabledPduGroupRef=ComIPduGroup_PN17_Tx
          BswMAction_EnableWakeup
            BswMAvailableActions
              BswMUserCallout: BswMUserCalloutFunction=WakeupSource_Enable
          BswMAction_DisableWakeup
            BswMAvailableActions
              BswMUserCallout: BswMUserCalloutFunction=WakeupSource_Disable
        9 x BswMActionList, all with BswMActionListExecution=BSWM_TRIGGER:
          AL_RxDMEnable_ComMPnc_17
            Item_Action_RxEnableDM_ComMPnc_17 (BswMActionListItem): BswMAbortOnFail=false, BswMActionListItemIndex=0, BswMActionListItemRef=BswMAction_RxEnableDM_ComMPnc_17
          AL_RxDMDisable_ComMPnc_17
            Item_Action_RxDisabledDM_ComMPnc_17 (BswMActionListItem): BswMAbortOnFail=false, BswMActionListItemIndex=0, BswMActionListItemRef=BswMAction_RxDisabledDM_ComMPnc_17
          AL_RxEnable_ComMPnc_17
            Item_Action_RxEnableGroupSwitch_ComMPnc_17 (BswMActionListItem): BswMAbortOnFail=false, BswMActionListItemIndex=0, BswMActionListItemRef=BswMAction_RxEnableGroupSwitch_ComMPnc_17
          AL_RxDisable_ComMPnc_17
            Item_Action_RxDisabledGroupSwitch_ComMPnc_17 (BswMActionListItem): BswMAbortOnFail=false, BswMActionListItemIndex=0, BswMActionListItemRef=BswMAction_RxDisabledGroupSwitch_ComMPnc_17
          AL_TxEnable_ComMPnc_17
            Item_Action_TxEnableGroupSwitch_ComMPnc_17 (BswMActionListItem): BswMAbortOnFail=false, BswMActionListItemIndex=0, BswMActionListItemRef=BswMAction_TxEnableGroupSwitch_ComMPnc_17
          AL_TxDisable_ComMPnc_17
            Item_Action_TxDisabledGroupSwitch_ComMPnc_17 (BswMActionListItem): BswMAbortOnFail=false, BswMActionListItemIndex=0, BswMActionListItemRef=BswMAction_TxDisabledGroupSwitch_ComMPnc_17
          AL_TxEnableReInit_ComMPnc_17
            Item_Action_TxEnableGroupSwitch_ReInit_ComMPnc_17 (BswMActionListItem): BswMAbortOnFail=false, BswMActionListItemIndex=0, BswMActionListItemRef=BswMAction_TxEnableGroupSwitch_ReInit_ComMPnc_17
          AL_ComM_AllChanel_FULL_COM
            Item_Action_WakeupSourceDisable (BswMActionListItem): BswMAbortOnFail=false, BswMActionListItemIndex=0, BswMActionListItemRef=BswMAction_DisableWakeup
          AL_EcuM_ReleasePostRun
            Item_Action_EcuM_ReleasePostRun (BswMActionListItem): BswMAbortOnFail=false, BswMActionListItemIndex=0, BswMActionListItemRef=BswMAction_EcuM_POST_RUN_Release
            Item_Action_EcuM_GoHalt (BswMActionListItem): BswMAbortOnFail=false, BswMActionListItemIndex=1, BswMActionListItemRef=BswMAction_EcuM_GoHalt
        3 x BswMAction:
          BswMAction_TxEnableGroupSwitch_CanChannel_0
            BswMAvailableActions
              BswMPduGroupSwitch: BswMPduGroupSwitchReinit=false, BswMEnabledPduGroupRef=Com_TxPduGroup_CAN_CONTROLLER_0_ECU_ECU
          BswMAction_TxDisabledGroupSwitch_CanChannel_0
            BswMAvailableActions
              BswMPduGroupSwitch: BswMPduGroupSwitchReinit=false, BswMDisabledPduGroupRef=Com_TxPduGroup_CAN_CONTROLLER_0_ECU_ECU
          BswMAction_TxEnableGroupSwitch_ReInit_CanChannel_0
            BswMAvailableActions
              BswMPduGroupSwitch: BswMPduGroupSwitchReinit=true, BswMEnabledPduGroupRef=Com_TxPduGroup_CAN_CONTROLLER_0_ECU_ECU
        11 x BswMActionList, all with BswMActionListExecution=BSWM_TRIGGER:
          AL_TxEnable_CanChannel_0
            Item_Action_TxEnableGroupSwitch_CanChannel_0 (BswMActionListItem): BswMAbortOnFail=false, BswMActionListItemIndex=0, BswMActionListItemRef=BswMAction_TxEnableGroupSwitch_CanChannel_0
          AL_TxDisable_CanChannel_0
            Item_Action_TxDisabledGroupSwitch_CanChannel_0 (BswMActionListItem): BswMAbortOnFail=false, BswMActionListItemIndex=0, BswMActionListItemRef=BswMAction_TxDisabledGroupSwitch_CanChannel_0
          AL_TxEnableReInit_CanChannel_0
            Item_Action_TxEnableGroupSwitch_ReInit_CanChannel_0 (BswMActionListItem): BswMAbortOnFail=false, BswMActionListItemIndex=0, BswMActionListItemRef=BswMAction_TxEnableGroupSwitch_ReInit_CanChannel_0
          AL_DCM_Normal_Rx_Enable_Pnc_17
            Item_Action_RxEnableGroupSwitch_ComMPnc_17 (BswMActionListItem): BswMAbortOnFail=false, BswMActionListItemIndex=0, BswMActionListItemRef=BswMAction_RxEnableGroupSwitch_ComMPnc_17
          AL_DCM_Normal_Rx_Disable_Pnc_17
            Item_Action_RxDisabledGroupSwitch_ComMPnc_17 (BswMActionListItem): BswMAbortOnFail=false, BswMActionListItemIndex=0, BswMActionListItemRef=BswMAction_RxDisabledGroupSwitch_ComMPnc_17
          AL_DCM_Normal_Tx_Enable_Pnc_17
            Item_Action_TxEnableGroupSwitch_ComMPnc_17 (BswMActionListItem): BswMAbortOnFail=false, BswMActionListItemIndex=0, BswMActionListItemRef=BswMAction_TxEnableGroupSwitch_ComMPnc_17
          AL_DCM_Normal_Tx_Disable_Pnc_17
            Item_Action_TxDisabledGroupSwitch_ComMPnc_17 (BswMActionListItem): BswMAbortOnFail=false, BswMActionListItemIndex=0, BswMActionListItemRef=BswMAction_TxDisabledGroupSwitch_ComMPnc_17
          AL_DCM_Normal_Rx_Enable_Pnc_29
            Item_Action_RxEnableGroupSwitch_ComMPnc_29 (BswMActionListItem): BswMAbortOnFail=false, BswMActionListItemIndex=0, BswMActionListItemRef=BswMAction_RxEnableGroupSwitch_ComMPnc_29
          AL_DCM_Normal_Rx_Disable_Pnc_29
            Item_Action_RxDisabledGroupSwitch_ComMPnc_29 (BswMActionListItem): BswMAbortOnFail=false, BswMActionListItemIndex=0, BswMActionListItemRef=BswMAction_RxDisabledGroupSwitch_ComMPnc_29
          AL_DCM_Normal_Tx_Enable_Pnc_29
            Item_Action_TxEnableGroupSwitch_ComMPnc_29 (BswMActionListItem): BswMAbortOnFail=false, BswMActionListItemIndex=0, BswMActionListItemRef=BswMAction_TxEnableGroupSwitch_ComMPnc_29
          AL_DCM_Normal_Tx_Disable_Pnc_29
            Item_Action_TxDisabledGroupSwitch_ComMPnc_29 (BswMActionListItem): BswMAbortOnFail=false, BswMActionListItemIndex=0, BswMActionListItemRef=BswMAction_TxDisabledGroupSwitch_ComMPnc_29
        BswMAction_EcuM_ClearWakeUpSource_Validated (BswMAction)
          BswMAvailableActions
            BswMUserCallout: BswMUserCalloutFunction=User_EcuM_ClearWakeUpSource_Validated
        3 x BswMActionList, all with BswMActionListExecution=BSWM_TRIGGER:
          AL_EcuM_RequestRun
            Item_Action_EcuM_RequestRun (BswMActionListItem): BswMAbortOnFail=false, BswMActionListItemIndex=0, BswMActionListItemRef=BswMAction_EcuM_RequestRun
          AL_EcuM_ComMAllow
            Item_Action_ComMAllow_CanChannel_0 (BswMActionListItem): BswMAbortOnFail=false, BswMActionListItemIndex=0, BswMActionListItemRef=BswMAction_ComMAllow_CanChannel_0
          AL_EcuM_WakeupSourceClear_Validated
            Item_Action_ClearWakeupSource_Validated (BswMActionListItem): BswMAbortOnFail=false, BswMActionListItemIndex=0, BswMActionListItemRef=BswMAction_EcuM_ClearWakeUpSource_Validated
        BswMAction_EcuM_ClearWakeUpSource_Expired (BswMAction)
          BswMAvailableActions
            BswMUserCallout: BswMUserCalloutFunction=User_EcuM_ClearWakeUpSource_Expired
        3 x BswMActionList, all with BswMActionListExecution=BSWM_TRIGGER:
          AL_EcuM_WakeupSourceClear_Expired
            Item_Action_ClearWakeupSource_Expired (BswMActionListItem): BswMAbortOnFail=false, BswMActionListItemIndex=0, BswMActionListItemRef=BswMAction_EcuM_ClearWakeUpSource_Expired
          AL_EcuM_State_Sleep
            Item_Action_SetEcuMState_Sleep (BswMActionListItem): BswMAbortOnFail=false, BswMActionListItemIndex=0, BswMActionListItemRef=BswMAction_EcuM_SetStatus_SLEEP
          AL_EcuM_ClearWakeUpSource_EcuMWakeupSource_Local
            Item_Action_ClearWakeupSource_Validated (BswMActionListItem): BswMAbortOnFail=false, BswMActionListItemIndex=0, BswMActionListItemRef=BswMAction_EcuM_ClearWakeUpSource_Validated
            Item_Action_ComMRequestFULL_CanChannel_0 (BswMActionListItem): BswMAbortOnFail=false, BswMActionListItemIndex=1, BswMActionListItemRef=BswMAction_ComMRequestFULL_CanChannel_0
