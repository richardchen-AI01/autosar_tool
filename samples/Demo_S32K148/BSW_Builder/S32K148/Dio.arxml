AUTOSAR XML (schema 00048)
package /S32K148
  module config Dio: implementation-config-variant=VARIANT-PRE-COMPILE
    CommonPublishedInformation:
      ArReleaseMajorVersion = 4
      ArReleaseMinorVersion = 7
      ArReleaseRevisionVersion = 0
      ModuleId = 120
      SwMajorVersion = 2
      SwMinorVersion = 0
      SwPatchVersion = 0
      VendorId = 43
    DioConfig
      DioPort_0 (DioPort): DioPortId=0
    DioGeneral:
      DioDevErrorDetect = 0
      DioEnableUserModeSupport = 0
      DioFlipChannelApi = 0
      DioMaskedWritePortApi = 0
      DioMulticoreSupport = 0
      DioReadZeroForUndefinedPortPins = 0
      DioReversePortBits = 0
      DioVersionInfoApi = 0
      GPIODioIPDevErrorDetect = 0
