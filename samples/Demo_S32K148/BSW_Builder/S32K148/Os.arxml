AUTOSAR XML (schema 00048)
package /S32K148
  module config Os
    OsOS:
      OsMaxNumberOfCores = 1
      OsPhyIdOfCores = 0
      OsNumberOfCores = 1
      OsScalabilityClass = SC1
      Compiler = s32ds_arm_gcc
      SingleCore = 0
      OsSystemStackSize = 2048
      OsStackMonitoring = true
      OsStatus = STANDARD
      OsUseOrti = false
      OsUseGetServiceId = false
      OsUseParameterAccess = false
      OsUseResScheduler = true
      OsStackUsageMeasurement = false
      OsHooks: OsErrorHook=true, OsPostTaskHook=false, OsPreTaskHook=false, OsShutdownHook=true, OsStartupHook=true
      OsTrace: Os_Trace=false
    OSDEFAULTAPPMODE (OsAppMode)
    Counter (OsCounter)
      SystemTimer_Core_0 (SystemTimer_Core): OsCounterMaxAllowedValue=65535, OsCounterMinCycle=1, OsCounterTicksPerBase=1, OsCounterType=HARDWARE, OsSecondsPerTick=0.001
    SystemIsr
      OsTimerSourceCore_0 (OsTimerSourceCore): OsPriority=10, OsNestedEnable=false, OsSecondsTick=0.001, OsIsrStackSize=512, OsCpuFrequency=80, OsTimerSource=SysTick_ADDR
      OsTimingProtTimerSourceCore_0 (OsTimingProtTimerSourceCore):
        OsTimingProtPriority = 11
        OsTimingProtNestedEnable = false
        OsTimingProtSecondsTick = 0.001
        OsIsrStackSize = 512
        OsCpuFrequency = 40
        OsTimingProtTimerSource = NULL
      OsRemoteSource_0 (OsRemoteSource): OsRemotePriority=1, OsRemoteNestedEnable=false, OsIsrStackSize=512, OsCpuFrequency=40, OsRemoteSecondsTick=0.001, OsRemoteTimerSource=NULL
    RES_SCHEDULER_CORE0 (OsResource): OsResourceProperty=STANDARD
    4 x OsIsr, all with OsIsrCategory=CATEGORY_2:
      CAN0_ORed_ADDR
        OsIsrSettings: OsIsrStackSize=512, OsInterruptSource=CAN0_ORed_ADDR, OsInterruptSourceId=94, OsInterruptLevel=1, OsIsrNestedEnable=false
      CAN0_ORed_0_15_MB_ADDR
        OsIsrSettings: OsIsrStackSize=512, OsInterruptSource=CAN0_ORed_0_15_MB_ADDR, OsInterruptSourceId=97, OsInterruptLevel=1, OsIsrNestedEnable=false
      CAN0_ORed_16_31_MB_ADDR
        OsIsrSettings: OsIsrStackSize=512, OsInterruptSource=CAN0_ORed_16_31_MB_ADDR, OsInterruptSourceId=98, OsInterruptLevel=1, OsIsrNestedEnable=false
      FTM0_Ch0_Ch1_ADDR
        OsIsrSettings: OsIsrStackSize=512, OsInterruptSource=FTM0_Ch0_Ch1_ADDR, OsInterruptSourceId=115, OsInterruptLevel=1, OsIsrNestedEnable=false
    OsIoc
    OsMonitor
      OsInterruptMonitor: OsInterMonitorEnable=false
      OsTaskMonitor: OsTaskResponseTime=false
      OsLoadMonitor: OsLoadRatio=false
      OsScheduleMonitor: OsScheduleCountMonitor=false
      OsEventMonitor
    iSoft_Auto_OsTask_10ms_BSW (OsTask): OsTaskActivation=1, OsTaskPriority=25, OsTaskSchedule=FULL, OsTaskStackSize=1024, OsTaskPeriod=0.01, OsTaskEventRef=iSoft_Auto_OsEvent_10ms_BSW
    iSoft_Auto_OsEvent_10ms_BSW (OsEvent)
    iSoft_Auto_OsAlarm_10ms_BSW (OsAlarm): OsAlarmCounterRef=SystemTimer_Core_0
      OsAlarmAction
        OsAlarmSetEvent: OsAlarmSetEventRef=iSoft_Auto_OsEvent_10ms_BSW, OsAlarmSetEventTaskRef=iSoft_Auto_OsTask_10ms_BSW
    iSoft_Auto_OsTask_5ms_BSW (OsTask): OsTaskActivation=1, OsTaskPriority=25, OsTaskSchedule=FULL, OsTaskStackSize=1024, OsTaskPeriod=0.005, OsTaskEventRef=iSoft_Auto_OsEvent_5ms_BSW
    iSoft_Auto_OsEvent_5ms_BSW (OsEvent)
    iSoft_Auto_OsAlarm_5ms_BSW (OsAlarm): OsAlarmCounterRef=SystemTimer_Core_0
      OsAlarmAction
        OsAlarmSetEvent: OsAlarmSetEventRef=iSoft_Auto_OsEvent_5ms_BSW, OsAlarmSetEventTaskRef=iSoft_Auto_OsTask_5ms_BSW
    iSoft_Auto_OsTask_1ms_BSW (OsTask): OsTaskActivation=1, OsTaskPriority=25, OsTaskSchedule=FULL, OsTaskStackSize=256, OsTaskPeriod=0.001, OsTaskEventRef=iSoft_Auto_OsEvent_1ms_BSW
    iSoft_Auto_OsEvent_1ms_BSW (OsEvent)
    iSoft_Auto_OsAlarm_1ms_BSW (OsAlarm): OsAlarmCounterRef=SystemTimer_Core_0
      OsAlarmAction
        OsAlarmSetEvent: OsAlarmSetEventRef=iSoft_Auto_OsEvent_1ms_BSW, OsAlarmSetEventTaskRef=iSoft_Auto_OsTask_1ms_BSW
    iSoft_Auto_OsTask_SchM_0 (OsTask):
      OsTaskActivation = 1
      OsTaskPriority = 63
      OsTaskSchedule = FULL
      OsTaskStackSize = 256
      OsTaskEventRef = iSoft_Auto_OsEvent_Imp_SchM_BOIE_SchM_Service_Function_Core0
    iSoft_Auto_OsEvent_Imp_SchM_BOIE_SchM_Service_Function_Core0 (OsEvent)
    iSoft_Auto_DEFAULT_OsTask_Init (OsTask): OsTaskActivation=1, OsTaskPriority=63, OsTaskSchedule=NON, OsTaskStackSize=1024
      OsTaskAutostart: OsTaskAppModeRef=OSDEFAULTAPPMODE
