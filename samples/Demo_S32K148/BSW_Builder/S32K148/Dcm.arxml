AUTOSAR XML (schema 00048)
package /S32K148
  module config Dcm
    DcmConfigSet
      DcmDsd
        SRVTABLE_UDS_CAN (DcmDsdServiceTable): DcmDsdSidTabId=0
          12 x DcmDsdService, all with DcmDsdServiceUsed=true:
            Service_0x10_DiagnosticSessionControl: DcmDsdSidTabServiceId=16, DcmDsdSidTabSubfuncAvail=true, DcmDsdSidTabAddressingFormat=PHYANDFUNC
              3 x DcmDsdSubService, all with DcmDsdSubServiceUsed=true, DcmDsdSubServiceAddressingFormat=PHYANDFUNC:
                SubService_0x01: DcmDsdSubServiceId=1
                SubService_0x02: DcmDsdSubServiceId=2, DcmDsdSubServiceSessionLevelRef=Extended
                SubService_0x03: DcmDsdSubServiceId=3
            Service_0x11_ECUReset: DcmDsdSidTabServiceId=17, DcmDsdSidTabSubfuncAvail=true, DcmDsdSidTabAddressingFormat=PHYANDFUNC
              SubService_0x01 (DcmDsdSubService): DcmDsdSubServiceId=1, DcmDsdSubServiceUsed=true, DcmDsdSubServiceAddressingFormat=PHYANDFUNC
              SubService_0x03 (DcmDsdSubService): DcmDsdSubServiceId=3, DcmDsdSubServiceUsed=true, DcmDsdSubServiceAddressingFormat=PHYANDFUNC
            Service_0x31_RoutineControl: DcmDsdSidTabServiceId=49, DcmDsdSidTabSubfuncAvail=true, DcmDsdSidTabAddressingFormat=PHYSICAL, DcmDsdSidTabSessionLevelRef=Extended
              SubService_0x01 (DcmDsdSubService): DcmDsdSubServiceId=1, DcmDsdSubServiceUsed=true, DcmDsdSubServiceAddressingFormat=PHYANDFUNC, DcmDsdSubServiceSessionLevelRef=Extended
            Service_0x22_ReadDataByIdentifier: DcmDsdSidTabServiceId=34, DcmDsdSidTabSubfuncAvail=false, DcmDsdSidTabAddressingFormat=PHYANDFUNC
            Service_0x14_ClearDiagnosticInformation: DcmDsdSidTabServiceId=20, DcmDsdSidTabSubfuncAvail=false, DcmDsdSidTabAddressingFormat=PHYANDFUNC
            Service_0x85_ControlDTCSetting: DcmDsdSidTabServiceId=133, DcmDsdSidTabSubfuncAvail=true, DcmDsdSidTabAddressingFormat=PHYANDFUNC, DcmDsdSidTabSessionLevelRef=Extended
              SubService_0x01 (DcmDsdSubService): DcmDsdSubServiceId=1, DcmDsdSubServiceUsed=true, DcmDsdSubServiceAddressingFormat=PHYANDFUNC, DcmDsdSubServiceSessionLevelRef=Extended
              SubService_0x02 (DcmDsdSubService): DcmDsdSubServiceId=2, DcmDsdSubServiceUsed=true, DcmDsdSubServiceAddressingFormat=PHYANDFUNC, DcmDsdSubServiceSessionLevelRef=Extended
            Service_0x27_SecurityAccess: DcmDsdSidTabServiceId=39, DcmDsdSidTabSubfuncAvail=true, DcmDsdSidTabAddressingFormat=PHYSICAL, DcmDsdSidTabSessionLevelRef=Extended
              4 x DcmDsdSubService, all with DcmDsdSubServiceUsed=true, DcmDsdSubServiceAddressingFormat=PHYANDFUNC, DcmDsdSubServiceSessionLevelRef=Extended:
                SubService_0x03: DcmDsdSubServiceId=3
                SubService_0x04: DcmDsdSubServiceId=4
                SubService_0x05: DcmDsdSubServiceId=5
                SubService_0x06: DcmDsdSubServiceId=6
            Service_0x28_CommunicationControl: DcmDsdSidTabServiceId=40, DcmDsdSidTabSubfuncAvail=true, DcmDsdSidTabAddressingFormat=PHYANDFUNC, DcmDsdSidTabSessionLevelRef=Extended
              4 x DcmDsdSubService, all with DcmDsdSubServiceUsed=true, DcmDsdSubServiceAddressingFormat=PHYANDFUNC, DcmDsdSubServiceSessionLevelRef=Extended:
                SubService_0x00: DcmDsdSubServiceId=0
                SubService_0x01: DcmDsdSubServiceId=1
                SubService_0x02: DcmDsdSubServiceId=2
                SubService_0x03: DcmDsdSubServiceId=3
            Service_0x19_ReadDTCInformation: DcmDsdSidTabServiceId=25, DcmDsdSidTabSubfuncAvail=true, DcmDsdSidTabAddressingFormat=PHYANDFUNC
              5 x DcmDsdSubService, all with DcmDsdSubServiceUsed=true, DcmDsdSubServiceAddressingFormat=PHYANDFUNC:
                SubService_0x04: DcmDsdSubServiceId=4
                SubService_0x06: DcmDsdSubServiceId=6
                SubService_0x01: DcmDsdSubServiceId=1
                SubService_0x02: DcmDsdSubServiceId=2
                SubService_0x0A: DcmDsdSubServiceId=10
            Service_0x3E_TesterPresent: DcmDsdSidTabServiceId=62, DcmDsdSidTabSubfuncAvail=true, DcmDsdSidTabAddressingFormat=PHYANDFUNC
              SubService_0x00 (DcmDsdSubService): DcmDsdSubServiceId=0, DcmDsdSubServiceUsed=true, DcmDsdSubServiceAddressingFormat=PHYANDFUNC
            Service_0x2E_WriteDataByIdentifier: DcmDsdSidTabServiceId=46, DcmDsdSidTabSubfuncAvail=false, DcmDsdSidTabAddressingFormat=PHYSICAL, DcmDsdSidTabSessionLevelRef=Extended, DcmDsdSidTabSecurityLevelRef=Level_2, DcmDsdSidTabSecurityLevelRef=Level_3
            Service_0x2F_InputOutputControlByIdentifier: DcmDsdSidTabServiceId=47, DcmDsdSidTabSubfuncAvail=false, DcmDsdSidTabAddressingFormat=PHYSICAL, DcmDsdSidTabSessionLevelRef=Extended, DcmDsdSidTabSecurityLevelRef=Level_2, DcmDsdSidTabSecurityLevelRef=Level_3
      DcmDsl
        Buffer_CAN_Rx (DcmDslBuffer): DcmDslBufferSize=1024
        DcmDslDiagResp: DcmDslDiagRespOnSecondDeclinedRequest=false, DcmDslDiagRespMaxNumRespPend=255
        DcmDslProtocol
          Protocol_CAN (DcmDslProtocolRow):
            DcmDslProtocolPriority = 0
            DcmDslProtocolRowUsed = true
            DcmDslProtocolType = DCM_UDS_ON_CAN
            DcmSendRespPendOnRestart = true
            DcmTimStrP2ServerAdjust = 0.01
            DcmTimStrP2StarServerAdjust = 0.01
            DcmDemClientRef = DemClient
            DcmDslProtocolRxBufferRef = Buffer_CAN_Rx
            DcmDslProtocolSIDTable = SRVTABLE_UDS_CAN
            DcmDslProtocolTxBufferRef = Buffer_CAN_Tx
            DcmDslConnection_DcmDslMainConnection (DcmDslConnection)
              DcmDslMainConnection: DcmDslProtocolRxConnectionId=0, DcmDslProtocolComMChannelRef=ComMCh_ECU
                DcmDslProtocolRx_Func (DcmDslProtocolRx): DcmDslProtocolRxAddrType=DCM_FUNCTIONAL_TYPE, DcmDslProtocolRxPduRef=CAN_Dcm_Func_Rx
                DcmDslProtocolRx_Phys (DcmDslProtocolRx): DcmDslProtocolRxAddrType=DCM_PHYSICAL_TYPE, DcmDslProtocolRxPduRef=CAN_Dcm_Phys_Rx
                DcmDslProtocolTx_USDT (DcmDslProtocolTx): DcmDslProtocolTxPduRef=CAN_Dcm_USDT_Tx
        Buffer_CAN_Tx (DcmDslBuffer): DcmDslBufferSize=1024
      DcmPageBufferCfg: DcmPagedBufferEnabled=false
      DcmDsp: DcmDspDataDefaultEndianness=opaque, DcmDspEnableObdMirror=false, DcmDspMaxDidToRead=5
        DcmDspSecurity: DcmDspSecurityMaxAttemptCounterReadoutTime=0.0, DcmDspSecurityResetAttemptCounterOnTimeout=true
          Level_2 (DcmDspSecurityRow):
            DcmDspSecurityAttemptCounterEnabled = true
            DcmDspSecurityDelayTime = 10.0
            DcmDspSecurityDelayTimeOnBoot = 0.0
            DcmDspSecurityKeySize = 4
            DcmDspSecurityLevel = 2
            DcmDspSecuritySeedSize = 4
            DcmDspSecurityUsePort = USE_ASYNCH_CLIENT_SERVER
            DcmDspSecurityCompareKeyFnc = Rte_CompareKey_0x2
            DcmDspSecurityGetAttemptCounterFnc = Rte_GetSecurityAttemptCounter_0x2
            DcmDspSecurityGetSeedFnc = Rte_GetSeed_0x2
            DcmDspSecurityNumAttDelay = 3
            DcmDspSecuritySetAttemptCounterFnc = Rte_SetSecurityAttemptCounter_0x2
          Level_3 (DcmDspSecurityRow):
            DcmDspSecurityAttemptCounterEnabled = true
            DcmDspSecurityDelayTime = 10.0
            DcmDspSecurityDelayTimeOnBoot = 0.0
            DcmDspSecurityKeySize = 4
            DcmDspSecurityLevel = 3
            DcmDspSecuritySeedSize = 4
            DcmDspSecurityUsePort = USE_ASYNCH_CLIENT_SERVER
            DcmDspSecurityCompareKeyFnc = Rte_CompareKey_0x3
            DcmDspSecurityGetAttemptCounterFnc = Rte_GetSecurityAttemptCounter_0x3
            DcmDspSecurityGetSeedFnc = Rte_GetSeed_0x3
            DcmDspSecurityNumAttDelay = 3
            DcmDspSecuritySetAttemptCounterFnc = Rte_SetSecurityAttemptCounter_0x3
        DcmDspSession
          3 x DcmDspSessionRow, all with DcmDspSessionP2ServerMax=0.05, DcmDspSessionP2StarServerMax=5.0:
            Default: DcmDspSessionForBoot=DCM_NO_BOOT, DcmDspSessionLevel=1
            Programming: DcmDspSessionForBoot=DCM_SYS_BOOT, DcmDspSessionLevel=2
            Extended: DcmDspSessionForBoot=DCM_NO_BOOT, DcmDspSessionLevel=3
        ControlDTCSetting (DcmDspControlDTCSetting)
        DcmDspComControl
          ComControlAllChannel (DcmDspComControlAllChannel): DcmDspComControlAllChannelUsed=true, DcmDspAllComMChannelRef=ComMCh_ECU
        5 x DcmDspDidInfo, all with DcmDspDidDynamicallyDefined=false:
          DidInfo_0
            DidRead (DcmDspDidRead)
            DidWrite (DcmDspDidWrite): DcmDspDidWriteSecurityLevelRef=Level_2, DcmDspDidWriteSessionRef=Extended
          DidInfo_1
            DidRead (DcmDspDidRead)
          DidInfo_2
            DidControl (DcmDspDidControl):
              DcmDspDidControlMask = DCM_CONTROLMASK_NO
              DcmDspDidFreezeCurrentState = false
              DcmDspDidResetToDefault = true
              DcmDspDidShortTermAdjustment = true
              DcmDspDidControlSecurityLevelRef = Level_2
              DcmDspDidControlSessionRef = Extended
            DidRead (DcmDspDidRead)
          DidInfo_3
            DidControl (DcmDspDidControl):
              DcmDspDidControlMask = DCM_CONTROLMASK_NO
              DcmDspDidFreezeCurrentState = false
              DcmDspDidResetToDefault = true
              DcmDspDidShortTermAdjustment = true
              DcmDspDidControlSecurityLevelRef = Level_3
              DcmDspDidControlSessionRef = Extended
            DidRead (DcmDspDidRead)
          DidInfo_4
            DidRead (DcmDspDidRead)
            DidWrite (DcmDspDidWrite): DcmDspDidWriteSecurityLevelRef=Level_3, DcmDspDidWriteSessionRef=Extended
        Did_0xF190 (DcmDspDid): DcmDspDidIdentifier=61840, DcmDspDidUsed=true, DcmDspDidUsePort=USE_DATA_ELEMENT_SPECIFIC_INTERFACES, DcmDspDidInfoRef=DidInfo_0
          DidSignal_0xF190_DID_0xF190 (DcmDspDidSignal): DcmDspDidByteOffset=0, DcmDspDidDataRef=Data_0xF190_DID_0xF190
        Data_0xF190_DID_0xF190 (DcmDspData):
          DcmDspDataType = UINT8_N
          DcmDspDataUsePort = USE_BLOCK_ID
          DcmDspDataConditionCheckReadFncUsed = true
          DcmDspDataConditionCheckReadFnc = Rte_DcmDspDataConditionCheckReadFnc_0xF190_DID_0xF190
          DcmDspDataReadDataLengthFnc = NULL_PTR
          DcmDspDataReadFnc = Rte_DcmDspDataReadFnc_0xF190_DID_0xF190
          DcmDspDataWriteFnc = Rte_DcmDspDataWriteFnc_0xF190_DID_0xF190
          DcmDspDataFreezeCurrentStateFnc = NULL_PTR
          DcmDspDataResetToDefaultFnc = NULL_PTR
          DcmDspDataReturnControlToEcuFnc = NULL_PTR
          DcmDspDataShortTermAdjustmentFnc = NULL_PTR
          DcmDspDataGetScalingInfoFnc = NULL_PTR
          DcmDspDataByteSize = 17
          DcmDspDataBlockIdRef = NvMBlock_DIDF190
        Did_0xF183 (DcmDspDid): DcmDspDidIdentifier=61827, DcmDspDidUsed=true, DcmDspDidUsePort=USE_DATA_ELEMENT_SPECIFIC_INTERFACES, DcmDspDidInfoRef=DidInfo_4
          DidSignal_0xF183_DID_0xF183 (DcmDspDidSignal): DcmDspDidByteOffset=0, DcmDspDidDataRef=Data_0xF183_DID_0xF183
        Data_0xF183_DID_0xF183 (DcmDspData):
          DcmDspDataType = UINT8_N
          DcmDspDataUsePort = USE_BLOCK_ID
          DcmDspDataConditionCheckReadFncUsed = true
          DcmDspDataConditionCheckReadFnc = Rte_DcmDspDataConditionCheckReadFnc_0xF183_DID_0xF183
          DcmDspDataReadDataLengthFnc = NULL_PTR
          DcmDspDataReadFnc = Rte_DcmDspDataReadFnc_0xF183_DID_0xF183
          DcmDspDataWriteFnc = Rte_DcmDspDataWriteFnc_0xF183_DID_0xF183
          DcmDspDataFreezeCurrentStateFnc = NULL_PTR
          DcmDspDataResetToDefaultFnc = NULL_PTR
          DcmDspDataReturnControlToEcuFnc = NULL_PTR
          DcmDspDataShortTermAdjustmentFnc = NULL_PTR
          DcmDspDataGetScalingInfoFnc = NULL_PTR
          DcmDspDataByteSize = 4
          DcmDspDataBlockIdRef = NvMBlock_DIDF183
        Did_0xF186 (DcmDspDid): DcmDspDidIdentifier=61830, DcmDspDidUsed=true, DcmDspDidUsePort=USE_DATA_ELEMENT_SPECIFIC_INTERFACES, DcmDspDidInfoRef=DidInfo_1
          DidSignal_0xF186_DID_0xF186 (DcmDspDidSignal): DcmDspDidByteOffset=0, DcmDspDidDataRef=Data_0xF186_DID_0xF186
        Data_0xF186_DID_0xF186 (DcmDspData):
          DcmDspDataType = UINT8_N
          DcmDspDataUsePort = USE_DATA_ASYNCH_CLIENT_SERVER
          DcmDspDataConditionCheckReadFncUsed = true
          DcmDspDataConditionCheckReadFnc = Rte_DcmDspDataConditionCheckReadFnc_0xF186_DID_0xF186
          DcmDspDataReadDataLengthFnc = NULL_PTR
          DcmDspDataReadFnc = Rte_DcmDspDataReadFnc_0xF186_DID_0xF186
          DcmDspDataWriteFnc = NULL_PTR
          DcmDspDataFreezeCurrentStateFnc = NULL_PTR
          DcmDspDataResetToDefaultFnc = NULL_PTR
          DcmDspDataReturnControlToEcuFnc = NULL_PTR
          DcmDspDataShortTermAdjustmentFnc = NULL_PTR
          DcmDspDataGetScalingInfoFnc = NULL_PTR
          DcmDspDataByteSize = 1
        Did_0xF121 (DcmDspDid): DcmDspDidIdentifier=61729, DcmDspDidUsed=true, DcmDspDidUsePort=USE_DATA_ELEMENT_SPECIFIC_INTERFACES, DcmDspDidInfoRef=DidInfo_1
          DidSignal_0xF121_DID_0xF121 (DcmDspDidSignal): DcmDspDidByteOffset=0, DcmDspDidDataRef=Data_0xF121_DID_0xF121
        Did_0xF181 (DcmDspDid): DcmDspDidIdentifier=61825, DcmDspDidUsed=true, DcmDspDidUsePort=USE_DATA_ELEMENT_SPECIFIC_INTERFACES, DcmDspDidInfoRef=DidInfo_1
          DidSignal_0xF181_DID_0xF181 (DcmDspDidSignal): DcmDspDidByteOffset=0, DcmDspDidDataRef=Data_0xF181_DID_0xF181
        Data_0xF121_DID_0xF121 (DcmDspData):
          DcmDspDataType = UINT8_N
          DcmDspDataUsePort = USE_DATA_ASYNCH_CLIENT_SERVER
          DcmDspDataConditionCheckReadFncUsed = true
          DcmDspDataConditionCheckReadFnc = Rte_DcmDspDataConditionCheckReadFnc_0xF121_DID_0xF121
          DcmDspDataReadDataLengthFnc = NULL_PTR
          DcmDspDataReadFnc = Rte_DcmDspDataReadFnc_0xF121_DID_0xF121
          DcmDspDataWriteFnc = NULL_PTR
          DcmDspDataFreezeCurrentStateFnc = NULL_PTR
          DcmDspDataResetToDefaultFnc = NULL_PTR
          DcmDspDataReturnControlToEcuFnc = NULL_PTR
          DcmDspDataShortTermAdjustmentFnc = NULL_PTR
          DcmDspDataGetScalingInfoFnc = NULL_PTR
          DcmDspDataByteSize = 16
        Data_0xF181_DID_0xF181 (DcmDspData):
          DcmDspDataType = UINT8_N
          DcmDspDataUsePort = USE_DATA_ASYNCH_CLIENT_SERVER
          DcmDspDataConditionCheckReadFncUsed = true
          DcmDspDataConditionCheckReadFnc = Rte_DcmDspDataConditionCheckReadFnc_0xF181_DID_0xF181
          DcmDspDataReadDataLengthFnc = NULL_PTR
          DcmDspDataReadFnc = Rte_DcmDspDataReadFnc_0xF181_DID_0xF181
          DcmDspDataWriteFnc = NULL_PTR
          DcmDspDataFreezeCurrentStateFnc = NULL_PTR
          DcmDspDataResetToDefaultFnc = NULL_PTR
          DcmDspDataReturnControlToEcuFnc = NULL_PTR
          DcmDspDataShortTermAdjustmentFnc = NULL_PTR
          DcmDspDataGetScalingInfoFnc = NULL_PTR
          DcmDspDataByteSize = 4
        Did_0x0110 (DcmDspDid): DcmDspDidIdentifier=272, DcmDspDidUsed=true, DcmDspDidUsePort=USE_DATA_ELEMENT_SPECIFIC_INTERFACES, DcmDspDidInfoRef=DidInfo_1
          DidSignal_0x0110_DID_0x0110 (DcmDspDidSignal): DcmDspDidByteOffset=0, DcmDspDidDataRef=Data_0x0110_DID_0x0110
        Data_0x0110_DID_0x0110 (DcmDspData):
          DcmDspDataType = UINT8_N
          DcmDspDataUsePort = USE_DATA_ASYNCH_CLIENT_SERVER
          DcmDspDataConditionCheckReadFncUsed = true
          DcmDspDataConditionCheckReadFnc = Rte_DcmDspDataConditionCheckReadFnc_0x0110_DID_0x0110
          DcmDspDataReadDataLengthFnc = NULL_PTR
          DcmDspDataReadFnc = Rte_DcmDspDataReadFnc_0x0110_DID_0x0110
          DcmDspDataWriteFnc = NULL_PTR
          DcmDspDataFreezeCurrentStateFnc = NULL_PTR
          DcmDspDataResetToDefaultFnc = NULL_PTR
          DcmDspDataReturnControlToEcuFnc = NULL_PTR
          DcmDspDataShortTermAdjustmentFnc = NULL_PTR
          DcmDspDataGetScalingInfoFnc = NULL_PTR
          DcmDspDataByteSize = 1
        Did_0x0111 (DcmDspDid): DcmDspDidIdentifier=273, DcmDspDidUsed=true, DcmDspDidUsePort=USE_DATA_ELEMENT_SPECIFIC_INTERFACES, DcmDspDidInfoRef=DidInfo_1
          DidSignal_0x0111_DID_0x0111 (DcmDspDidSignal): DcmDspDidByteOffset=0, DcmDspDidDataRef=Data_0x0111_DID_0x0111
        Data_0x0111_DID_0x0111 (DcmDspData):
          DcmDspDataType = UINT8_N
          DcmDspDataUsePort = USE_DATA_ASYNCH_CLIENT_SERVER
          DcmDspDataConditionCheckReadFncUsed = true
          DcmDspDataConditionCheckReadFnc = Rte_DcmDspDataConditionCheckReadFnc_0x0111_DID_0x0111
          DcmDspDataReadDataLengthFnc = NULL_PTR
          DcmDspDataReadFnc = Rte_DcmDspDataReadFnc_0x0111_DID_0x0111
          DcmDspDataWriteFnc = NULL_PTR
          DcmDspDataFreezeCurrentStateFnc = NULL_PTR
          DcmDspDataResetToDefaultFnc = NULL_PTR
          DcmDspDataReturnControlToEcuFnc = NULL_PTR
          DcmDspDataShortTermAdjustmentFnc = NULL_PTR
          DcmDspDataGetScalingInfoFnc = NULL_PTR
          DcmDspDataByteSize = 3
        Did_0x0120 (DcmDspDid): DcmDspDidIdentifier=288, DcmDspDidUsed=true, DcmDspDidUsePort=USE_DATA_ELEMENT_SPECIFIC_INTERFACES, DcmDspDidInfoRef=DidInfo_2
          DidSignal_0x0120_DID_0x0120 (DcmDspDidSignal): DcmDspDidByteOffset=0, DcmDspDidDataRef=Data_0x0120_DID_0x0120
        Data_0x0120_DID_0x0120 (DcmDspData):
          DcmDspDataType = UINT8_N
          DcmDspDataUsePort = USE_DATA_ASYNCH_CLIENT_SERVER
          DcmDspDataConditionCheckReadFncUsed = true
          DcmDspDataConditionCheckReadFnc = Rte_DcmDspDataConditionCheckReadFnc_0x0120_DID_0x0120
          DcmDspDataReadDataLengthFnc = NULL_PTR
          DcmDspDataReadFnc = Rte_DcmDspDataReadFnc_0x0120_DID_0x0120
          DcmDspDataWriteFnc = NULL_PTR
          DcmDspDataFreezeCurrentStateFnc = NULL_PTR
          DcmDspDataResetToDefaultFnc = Rte_ResetToDefault_0x0120_DID_0x0120
          DcmDspDataReturnControlToEcuFnc = Rte_ReturnControlToECU_0x0120_DID_0x0120
          DcmDspDataShortTermAdjustmentFnc = Rte_ShortTermAdjustment_0x0120_DID_0x0120
          DcmDspDataGetScalingInfoFnc = NULL_PTR
          DcmDspDataByteSize = 1
        Did_0x0121 (DcmDspDid): DcmDspDidIdentifier=289, DcmDspDidUsed=true, DcmDspDidUsePort=USE_DATA_ELEMENT_SPECIFIC_INTERFACES, DcmDspDidInfoRef=DidInfo_3
          DidSignal_0x0121_DID_0x0121 (DcmDspDidSignal): DcmDspDidByteOffset=0, DcmDspDidDataRef=Data_0x0121_DID_0x0121
        Data_0x0121_DID_0x0121 (DcmDspData):
          DcmDspDataType = UINT8_N
          DcmDspDataUsePort = USE_DATA_ASYNCH_CLIENT_SERVER
          DcmDspDataConditionCheckReadFncUsed = true
          DcmDspDataConditionCheckReadFnc = Rte_DcmDspDataConditionCheckReadFnc_0x0121_DID_0x0121
          DcmDspDataReadDataLengthFnc = NULL_PTR
          DcmDspDataReadFnc = Rte_DcmDspDataReadFnc_0x0121_DID_0x0121
          DcmDspDataWriteFnc = NULL_PTR
          DcmDspDataFreezeCurrentStateFnc = NULL_PTR
          DcmDspDataResetToDefaultFnc = Rte_ResetToDefault_0x0121_DID_0x0121
          DcmDspDataReturnControlToEcuFnc = Rte_ReturnControlToECU_0x0121_DID_0x0121
          DcmDspDataShortTermAdjustmentFnc = Rte_ShortTermAdjustment_0x0121_DID_0x0121
          DcmDspDataGetScalingInfoFnc = NULL_PTR
          DcmDspDataByteSize = 1
        CommonAuthorization_0 (DcmDspCommonAuthorization): DcmDspCommonAuthorizationSessionRef=Extended
        Routine_0x0203 (DcmDspRoutine): DcmDspRoutineIdentifier=515, DcmDspRoutineUsed=true, DcmDspRoutineUsePort=true
          DcmDspStartRoutine_0x0203 (DcmDspStartRoutine):
            DcmDspStartRoutineRestartEnabled = true
            DcmDspStartRoutineFnc = Rte_Call_Dcm_RoutineServices_DcmDspStartRoutine_0x0203_Start
            DcmDspStartRoutineCommonAuthorizationRef = CommonAuthorization_0
            StartRoutineOut_0x0203 (DcmDspStartRoutineOut)
              StartRoutineOutSignal_0x0203_RID_0x0203_Data (DcmDspStartRoutineOutSignal): DcmDspRoutineSignalPos=0, DcmDspRoutineSignalType=UINT8_N, DcmDspRoutineParameterSize=1
        CommonAuthorization_1 (DcmDspCommonAuthorization): DcmDspCommonAuthorizationSecurityLevelRef=Level_2, DcmDspCommonAuthorizationSessionRef=Extended
        Routine_0x0200 (DcmDspRoutine): DcmDspRoutineIdentifier=512, DcmDspRoutineUsed=true, DcmDspRoutineUsePort=true
          DcmDspStartRoutine_0x0200 (DcmDspStartRoutine):
            DcmDspStartRoutineRestartEnabled = true
            DcmDspStartRoutineFnc = Rte_Call_Dcm_RoutineServices_DcmDspStartRoutine_0x0200_Start
            DcmDspStartRoutineCommonAuthorizationRef = CommonAuthorization_1
            StartRoutineIn_0x0200 (DcmDspStartRoutineIn)
              StartRoutineInSignal_0x0200_RID_0x0200_Control_Data (DcmDspStartRoutineInSignal): DcmDspRoutineSignalPos=0, DcmDspRoutineSignalType=UINT8_N, DcmDspRoutineParameterSize=1
            StartRoutineOut_0x0200 (DcmDspStartRoutineOut)
              StartRoutineOutSignal_0x0200_RID_0x0200_Status_Data (DcmDspStartRoutineOutSignal): DcmDspRoutineSignalPos=0, DcmDspRoutineSignalType=UINT8_N, DcmDspRoutineParameterSize=1
        CommonAuthorization_2 (DcmDspCommonAuthorization): DcmDspCommonAuthorizationSecurityLevelRef=Level_3, DcmDspCommonAuthorizationSessionRef=Extended
        Routine_0x0201 (DcmDspRoutine): DcmDspRoutineIdentifier=513, DcmDspRoutineUsed=true, DcmDspRoutineUsePort=true
          DcmDspStartRoutine_0x0201 (DcmDspStartRoutine):
            DcmDspStartRoutineRestartEnabled = true
            DcmDspStartRoutineFnc = Rte_Call_Dcm_RoutineServices_DcmDspStartRoutine_0x0201_Start
            DcmDspStartRoutineCommonAuthorizationRef = CommonAuthorization_2
            StartRoutineIn_0x0201 (DcmDspStartRoutineIn)
              StartRoutineInSignal_0x0201_RID_0x0201_Control_Data (DcmDspStartRoutineInSignal): DcmDspRoutineSignalPos=0, DcmDspRoutineSignalType=UINT8_N, DcmDspRoutineParameterSize=1
            StartRoutineOut_0x0201 (DcmDspStartRoutineOut)
              StartRoutineOutSignal_0x0201_RID_0x0200_Status_Data (DcmDspStartRoutineOutSignal): DcmDspRoutineSignalPos=0, DcmDspRoutineSignalType=UINT8_N, DcmDspRoutineParameterSize=1
        DcmDspEcuReset
          DcmDspEcuResetRow_01 (DcmDspEcuResetRow): DcmDspEcuResetId=1, DcmResponseToEcuReset=BEFORE_RESET
          DcmDspEcuResetRow_03 (DcmDspEcuResetRow): DcmDspEcuResetId=3, DcmResponseToEcuReset=BEFORE_RESET
    DcmGeneral:
      DcmDevErrorDetect = true
      DcmEnableSecurityEventReporting = false
      DcmRespondAllRequest = true
      DcmTaskTime = 0.005
      DcmVersionInfoApi = false
      DcmS3ServerTimeoutOverwrite = 5.0
