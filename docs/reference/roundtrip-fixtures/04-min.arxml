AUTOSAR XML (schema 00048)
package /MIN_MCU
  module config MemIf
    MemIfGeneral: MemIfNumberOfDevices=1
