AUTOSAR XML (schema 00048)
package /MAX_MCU
  module config MemIf
    MemIfGeneral: MemIfDevErrorDetect=true, MemIfNumberOfDevices=2, MemIfVersionInfoApi=true, MemIfModuleVersion=MAX_FIXTURE_v9.99-rc7
