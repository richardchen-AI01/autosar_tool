AUTOSAR XML (schema 00048)
package /S32K148
  module config MemIf
    MemIfGeneral: MemIfDevErrorDetect=false, MemIfNumberOfDevices=1, MemIfVersionInfoApi=false, MemIfModuleVersion=TEST_PROBE_42_V25_10
