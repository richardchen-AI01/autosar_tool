AUTOSAR XML (schema 00048)
package /S32K148
  module config ComM
    ComMConfigSet: ComMPncEnabled=true
      ComMUser_ECU (ComMUser): ComMUserIdentifier=0, ComMCurrentModeNotificationEnabled=false
      ComMCh_ECU (ComMChannel):
        ComMBusType = COMM_BUS_TYPE_CAN
        ComMChannelId = 0
        ComMFullCommRequestNotificationEnabled = false
        ComMMainFunctionPeriod = 0.01
        ComMNoCom = false
        ComMNoWakeup = false
        ComMPncBitVectorLength = 2
        ComMNetworkManagement: ComMNmVariant=FULL, ComMPncNmRequest=false
        ComMUserPerChannel_ECU (ComMUserPerChannel): ComMUserChannel=ComMUser_ECU
      ComMPnc_17 (ComMPnc): ComMPncId=17, ComMUserPerPnc=PNCUser_ComMPnc_17, ComMChannelPerPnc=ComMCh_ECU
      PNCUser_ComMPnc_17 (ComMUser): ComMUserIdentifier=1, ComMCurrentModeNotificationEnabled=false
      ComMPnc_29 (ComMPnc): ComMPncId=29, ComMUserPerPnc=PNCUser_ComMPnc_29, ComMChannelPerPnc=ComMCh_ECU
      PNCUser_ComMPnc_29 (ComMUser): ComMUserIdentifier=2, ComMCurrentModeNotificationEnabled=false
    ComMGeneral:
      ComMDevErrorDetect = false
      ComMEcuGroupClassification = 3
      ComMModeLimitationEnabled = false
      ComMPncSupport = true
      ComMResetAfterForcingNoComm = false
      ComMSynchronousWakeUp = false
      ComMVersionInfoApi = false
      ComMWakeupInhibitionEnabled = false
      ComMDcmEnabled = true
      ComMDirectUserMapping = true
      ComMPncPrepareSleepTimer = 0.0
