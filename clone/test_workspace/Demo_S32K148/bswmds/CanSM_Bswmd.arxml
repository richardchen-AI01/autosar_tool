AUTOSAR XML (schema 00048)
package /AUTOSAR/BswOverviews
  bsw module description CanSM: module-id=140, category=BSW_MODULE, implemented-entrys=CanSM_MainFunction_CanSMManagerNetwork_ECU
    bsw internal behavior IB_CanSM
      exclusive area Context
      bsw schedulable entity CanSM_MainFunction_CanSMManagerNetwork_ECU: implemented-entry=CanSM_MainFunction_CanSMManagerNetwork_ECU
      bsw timing event TimingEvent_CanSM_MainFunction_CanSMManagerNetwork_ECU: starts-on-event=CanSM_MainFunction_CanSMManagerNetwork_ECU, period=0.001
package /AUTOSAR/BswImplementations
  bsw implementation Imp_CanSM: programming-language=C, sw-version=2.1.0, vendor-id=62, ar-release-version=4.10.0, behavior=IB_CanSM
    resource consumption RC_CanSM
      9 x memory section:
        VAR_CLEARED_UNSPECIFIED: alignment=UNSPECIFIED, sw-addrmethod=VAR_CLEARED
        CONFIG_DATA_16: alignment=16, sw-addrmethod=CONFIG_DATA
        CONFIG_DATA_8: alignment=8, sw-addrmethod=CONFIG_DATA
        CONFIG_DATA_UNSPECIFIED: alignment=UNSPECIFIED, sw-addrmethod=CONFIG_DATA
        VAR_CLEARED_8: alignment=8, sw-addrmethod=VAR_CLEARED
        VAR_CLEARED_BOOLEAN: alignment=BOOLEAN, sw-addrmethod=VAR_CLEARED
        VAR_CLEARED_PTR: sw-addrmethod=VAR_CLEARED
        CODE: sw-addrmethod=CODE
        CONST_PTR: sw-addrmethod=CONST
package /AUTOSAR/BswInterfaces
  bsw module entry CanSM_MainFunction_CanSMManagerNetwork_ECU: call-type=SCHEDULED, execution-context=TASK, sw-service-impl-policy=STANDARD
