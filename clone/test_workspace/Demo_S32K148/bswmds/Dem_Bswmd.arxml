AUTOSAR XML (schema 00048)
package /AUTOSAR/BswOverviews
  bsw module description Dem: implemented-entrys=Dem_MainFunction
    bsw internal behavior IB_Dem
      4 x exclusive area:
        DEM_EXCLUSIVE_AREA_{0..3}
      bsw schedulable entity SE_Dem_MainFunction: reentrancy-level=NON-REENTRANT, implemented-entry=Dem_MainFunction
      bsw timing event TE_Dem_MainFunction: starts-on-event=SE_Dem_MainFunction, period=0.01
package /AUTOSAR/BswImplementations
  bsw implementation Imp_Dem: programming-language=C, sw-version=3.0.0, vendor-id=62, ar-release-version=4.9.0, behavior=IB_Dem
    resource consumption RC_Dem
      14 x memory section:
        CODE: sw-addrmethod=CODE
        CONFIG_DATA_16: sw-addrmethod=CONFIG_DATA
        CONFIG_DATA_32: sw-addrmethod=CONFIG_DATA
        CONFIG_DATA_8: sw-addrmethod=CONFIG_DATA
        CONFIG_DATA_UNSPECIFIED: sw-addrmethod=CONFIG_DATA
        CONST_UNSPECIFIED: sw-addrmethod=CONST
        VAR_CLEARED_16: sw-addrmethod=VAR_CLEARED
        VAR_CLEARED_32: sw-addrmethod=VAR_CLEARED
        VAR_CLEARED_8: sw-addrmethod=VAR_CLEARED
        VAR_CLEARED_BOOLEAN: sw-addrmethod=VAR_CLEARED
        VAR_CLEARED_UNSPECIFIED: sw-addrmethod=VAR_CLEARED
        VAR_INIT_8: sw-addrmethod=VAR_INIT
        VAR_INIT_UNSPECIFIED: sw-addrmethod=VAR_INIT
        VAR_CLEARED_UNSPECIFIED: sw-addrmethod=VAR_CLEARED
package /AUTOSAR/BswInterfaces
  bsw module entry Dem_MainFunction: is-synchronous=true, call-type=SCHEDULED, execution-context=TASK, sw-service-impl-policy=STANDARD
