AUTOSAR XML (schema 00048)
package /AUTOSAR/BswOverviews
  bsw module description CanIf: module-id=60
    bsw internal behavior IB_CanIf
      exclusive area ExclusiveArea_Channel
package /AUTOSAR/BswImplementations
  bsw implementation Imp_CanIf: programming-language=C, sw-version=2.2.0, vendor-id=62, ar-release-version=4.5.0, behavior=IB_CanIf
    code-descriptors:
      code Header: artifact-descriptors=[{short-label=Std_Types.h, category=SWHDR}, {short-label=ComStack_Cfg.h, category=SWHDR}]
    resource consumption RC_CanIf
      7 x memory section:
        CONFIG_DATA_8: alignment=8, sw-addrmethod=CONFIG_DATA
        CONFIG_DATA_16: alignment=16, sw-addrmethod=CONFIG_DATA
        CONFIG_DATA_UNSPECIFIED: alignment=UNSPECIFIED, sw-addrmethod=CONFIG_DATA
        VAR_CLEARED_PTR: alignment=PTR, sw-addrmethod=VAR_CLEARED
        VAR_CLEARED_UNSPECIFIED: alignment=UNSPECIFIED, sw-addrmethod=VAR_CLEARED
        VAR_CLEARED_8: alignment=8, sw-addrmethod=VAR_CLEARED
        CODE: sw-addrmethod=CODE
package /AUTOSAR/BswInterfaces
  bsw module entry CanIf_Transmit: service-id=5, is-synchronous=true, call-type=REGULAR, execution-context=UNSPECIFIED, sw-service-impl-policy=STANDARD
    return type result: direction=OUT, implementation-data-type=Std_ReturnType
    sw service arg CanIfTxSduId: direction=IN, implementation-data-type=PduIdType
    sw service arg PduInfoPtr: direction=INOUT, implementation-data-type=PduInfoType, sw-impl-policy=CONST
